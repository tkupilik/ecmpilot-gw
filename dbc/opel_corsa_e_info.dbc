VERSION "eCMP INFO-DIV vehicle review 2026-11-03; 125000 bit/s; PSA-RE 67f7581e7622410efdbb29c7eda3b86982b9b450; Apache-2.0"

NS_ :

BS_:

BU_: AAS AMPLI AVP BCM BGP BSG BSI BTA BTEL BTT CDC CMB CRT DIAG_TOOL EDP_C EMF FMUX IC ICSV IDVR IVC_D MATT MDS OVIP PDS_C RAD RBG SDCM VTH WLC

BO_ 1646 BSI_DiagResponse_23: 8 BSI
 SG_ FlowPadding5 m3 : 63|8@0+ (1,0) [0|255] "raw"  MDS
 SG_ FirstData6 m1 : 63|8@0+ (1,0) [0|255] "raw"  MDS
 SG_ UnknownData7 m4 : 63|8@0+ (1,0) [0|255] "raw"  MDS
 SG_ ConsecutiveData7 m2 : 63|8@0+ (1,0) [0|255] "raw"  MDS
 SG_ SingleData7 m0 : 63|8@0+ (1,0) [0|255] "raw"  MDS
 SG_ FlowPadding4 m3 : 55|8@0+ (1,0) [0|255] "raw"  MDS
 SG_ FirstData5 m1 : 55|8@0+ (1,0) [0|255] "raw"  MDS
 SG_ UnknownData6 m4 : 55|8@0+ (1,0) [0|255] "raw"  MDS
 SG_ ConsecutiveData6 m2 : 55|8@0+ (1,0) [0|255] "raw"  MDS
 SG_ SingleData6 m0 : 55|8@0+ (1,0) [0|255] "raw"  MDS
 SG_ FlowPadding3 m3 : 47|8@0+ (1,0) [0|255] "raw"  MDS
 SG_ FirstData4 m1 : 47|8@0+ (1,0) [0|255] "raw"  MDS
 SG_ UnknownData5 m4 : 47|8@0+ (1,0) [0|255] "raw"  MDS
 SG_ ConsecutiveData5 m2 : 47|8@0+ (1,0) [0|255] "raw"  MDS
 SG_ SingleData5 m0 : 47|8@0+ (1,0) [0|255] "raw"  MDS
 SG_ FlowPadding2 m3 : 39|8@0+ (1,0) [0|255] "raw"  MDS
 SG_ FirstData3 m1 : 39|8@0+ (1,0) [0|255] "raw"  MDS
 SG_ UnknownData4 m4 : 39|8@0+ (1,0) [0|255] "raw"  MDS
 SG_ ConsecutiveData4 m2 : 39|8@0+ (1,0) [0|255] "raw"  MDS
 SG_ SingleData4 m0 : 39|8@0+ (1,0) [0|255] "raw"  MDS
 SG_ FlowPadding1 m3 : 31|8@0+ (1,0) [0|255] "raw"  MDS
 SG_ FirstData2 m1 : 31|8@0+ (1,0) [0|255] "raw"  MDS
 SG_ UnknownData3 m4 : 31|8@0+ (1,0) [0|255] "raw"  MDS
 SG_ ConsecutiveData3 m2 : 31|8@0+ (1,0) [0|255] "raw"  MDS
 SG_ SingleData3 m0 : 31|8@0+ (1,0) [0|255] "raw"  MDS
 SG_ FirstData1 m1 : 23|8@0+ (1,0) [0|255] "raw"  MDS
 SG_ UnknownData2 m4 : 23|8@0+ (1,0) [0|255] "raw"  MDS
 SG_ ConsecutiveData2 m2 : 23|8@0+ (1,0) [0|255] "raw"  MDS
 SG_ SingleData2 m0 : 23|8@0+ (1,0) [0|255] "raw"  MDS
 SG_ SeparationTimeRaw m3 : 23|8@0+ (1,0) [0|255] "raw"  MDS
 SG_ UnknownData1 m4 : 15|8@0+ (1,0) [0|255] "raw"  MDS
 SG_ ConsecutiveData1 m2 : 15|8@0+ (1,0) [0|255] "raw"  MDS
 SG_ SingleData1 m0 : 15|8@0+ (1,0) [0|255] "raw"  MDS
 SG_ BlockSize m3 : 15|8@0+ (1,0) [0|255] "raw"  MDS
 SG_ UnknownPciLow m4 : 3|4@0+ (1,0) [0|15] "raw"  MDS
 SG_ FlowStatus m3 : 3|4@0+ (1,0) [0|15] "raw"  MDS
 SG_ ConsecutiveSequence m2 : 3|4@0+ (1,0) [0|15] "raw"  MDS
 SG_ FirstFrameLength m1 : 3|12@0+ (1,0) [0|4095] "raw"  MDS
 SG_ SingleFrameLength m0 : 3|4@0+ (1,0) [0|15] "raw"  MDS
 SG_ IsoTpFrameType M : 7|4@0+ (1,0) [0|15] ""  MDS

BO_ 1647 BSI_DiagResponse_24: 8 BSI
 SG_ FlowPadding5 m3 : 63|8@0+ (1,0) [0|255] "raw"  MDS
 SG_ FirstData6 m1 : 63|8@0+ (1,0) [0|255] "raw"  MDS
 SG_ UnknownData7 m4 : 63|8@0+ (1,0) [0|255] "raw"  MDS
 SG_ ConsecutiveData7 m2 : 63|8@0+ (1,0) [0|255] "raw"  MDS
 SG_ SingleData7 m0 : 63|8@0+ (1,0) [0|255] "raw"  MDS
 SG_ FlowPadding4 m3 : 55|8@0+ (1,0) [0|255] "raw"  MDS
 SG_ FirstData5 m1 : 55|8@0+ (1,0) [0|255] "raw"  MDS
 SG_ UnknownData6 m4 : 55|8@0+ (1,0) [0|255] "raw"  MDS
 SG_ ConsecutiveData6 m2 : 55|8@0+ (1,0) [0|255] "raw"  MDS
 SG_ SingleData6 m0 : 55|8@0+ (1,0) [0|255] "raw"  MDS
 SG_ FlowPadding3 m3 : 47|8@0+ (1,0) [0|255] "raw"  MDS
 SG_ FirstData4 m1 : 47|8@0+ (1,0) [0|255] "raw"  MDS
 SG_ UnknownData5 m4 : 47|8@0+ (1,0) [0|255] "raw"  MDS
 SG_ ConsecutiveData5 m2 : 47|8@0+ (1,0) [0|255] "raw"  MDS
 SG_ SingleData5 m0 : 47|8@0+ (1,0) [0|255] "raw"  MDS
 SG_ FlowPadding2 m3 : 39|8@0+ (1,0) [0|255] "raw"  MDS
 SG_ FirstData3 m1 : 39|8@0+ (1,0) [0|255] "raw"  MDS
 SG_ UnknownData4 m4 : 39|8@0+ (1,0) [0|255] "raw"  MDS
 SG_ ConsecutiveData4 m2 : 39|8@0+ (1,0) [0|255] "raw"  MDS
 SG_ SingleData4 m0 : 39|8@0+ (1,0) [0|255] "raw"  MDS
 SG_ FlowPadding1 m3 : 31|8@0+ (1,0) [0|255] "raw"  MDS
 SG_ FirstData2 m1 : 31|8@0+ (1,0) [0|255] "raw"  MDS
 SG_ UnknownData3 m4 : 31|8@0+ (1,0) [0|255] "raw"  MDS
 SG_ ConsecutiveData3 m2 : 31|8@0+ (1,0) [0|255] "raw"  MDS
 SG_ SingleData3 m0 : 31|8@0+ (1,0) [0|255] "raw"  MDS
 SG_ FirstData1 m1 : 23|8@0+ (1,0) [0|255] "raw"  MDS
 SG_ UnknownData2 m4 : 23|8@0+ (1,0) [0|255] "raw"  MDS
 SG_ ConsecutiveData2 m2 : 23|8@0+ (1,0) [0|255] "raw"  MDS
 SG_ SingleData2 m0 : 23|8@0+ (1,0) [0|255] "raw"  MDS
 SG_ SeparationTimeRaw m3 : 23|8@0+ (1,0) [0|255] "raw"  MDS
 SG_ UnknownData1 m4 : 15|8@0+ (1,0) [0|255] "raw"  MDS
 SG_ ConsecutiveData1 m2 : 15|8@0+ (1,0) [0|255] "raw"  MDS
 SG_ SingleData1 m0 : 15|8@0+ (1,0) [0|255] "raw"  MDS
 SG_ BlockSize m3 : 15|8@0+ (1,0) [0|255] "raw"  MDS
 SG_ UnknownPciLow m4 : 3|4@0+ (1,0) [0|15] "raw"  MDS
 SG_ FlowStatus m3 : 3|4@0+ (1,0) [0|15] "raw"  MDS
 SG_ ConsecutiveSequence m2 : 3|4@0+ (1,0) [0|15] "raw"  MDS
 SG_ FirstFrameLength m1 : 3|12@0+ (1,0) [0|4095] "raw"  MDS
 SG_ SingleFrameLength m0 : 3|4@0+ (1,0) [0|15] "raw"  MDS
 SG_ IsoTpFrameType M : 7|4@0+ (1,0) [0|15] ""  MDS

BO_ 1648 VTH_DiagResponse: 8 VTH
 SG_ FlowPadding5 m3 : 63|8@0+ (1,0) [0|255] "raw"  MDS,BSI
 SG_ FirstData6 m1 : 63|8@0+ (1,0) [0|255] "raw"  MDS,BSI
 SG_ UnknownData7 m4 : 63|8@0+ (1,0) [0|255] "raw"  MDS,BSI
 SG_ ConsecutiveData7 m2 : 63|8@0+ (1,0) [0|255] "raw"  MDS,BSI
 SG_ SingleData7 m0 : 63|8@0+ (1,0) [0|255] "raw"  MDS,BSI
 SG_ FlowPadding4 m3 : 55|8@0+ (1,0) [0|255] "raw"  MDS,BSI
 SG_ FirstData5 m1 : 55|8@0+ (1,0) [0|255] "raw"  MDS,BSI
 SG_ UnknownData6 m4 : 55|8@0+ (1,0) [0|255] "raw"  MDS,BSI
 SG_ ConsecutiveData6 m2 : 55|8@0+ (1,0) [0|255] "raw"  MDS,BSI
 SG_ SingleData6 m0 : 55|8@0+ (1,0) [0|255] "raw"  MDS,BSI
 SG_ FlowPadding3 m3 : 47|8@0+ (1,0) [0|255] "raw"  MDS,BSI
 SG_ FirstData4 m1 : 47|8@0+ (1,0) [0|255] "raw"  MDS,BSI
 SG_ UnknownData5 m4 : 47|8@0+ (1,0) [0|255] "raw"  MDS,BSI
 SG_ ConsecutiveData5 m2 : 47|8@0+ (1,0) [0|255] "raw"  MDS,BSI
 SG_ SingleData5 m0 : 47|8@0+ (1,0) [0|255] "raw"  MDS,BSI
 SG_ FlowPadding2 m3 : 39|8@0+ (1,0) [0|255] "raw"  MDS,BSI
 SG_ FirstData3 m1 : 39|8@0+ (1,0) [0|255] "raw"  MDS,BSI
 SG_ UnknownData4 m4 : 39|8@0+ (1,0) [0|255] "raw"  MDS,BSI
 SG_ ConsecutiveData4 m2 : 39|8@0+ (1,0) [0|255] "raw"  MDS,BSI
 SG_ SingleData4 m0 : 39|8@0+ (1,0) [0|255] "raw"  MDS,BSI
 SG_ FlowPadding1 m3 : 31|8@0+ (1,0) [0|255] "raw"  MDS,BSI
 SG_ FirstData2 m1 : 31|8@0+ (1,0) [0|255] "raw"  MDS,BSI
 SG_ UnknownData3 m4 : 31|8@0+ (1,0) [0|255] "raw"  MDS,BSI
 SG_ ConsecutiveData3 m2 : 31|8@0+ (1,0) [0|255] "raw"  MDS,BSI
 SG_ SingleData3 m0 : 31|8@0+ (1,0) [0|255] "raw"  MDS,BSI
 SG_ FirstData1 m1 : 23|8@0+ (1,0) [0|255] "raw"  MDS,BSI
 SG_ UnknownData2 m4 : 23|8@0+ (1,0) [0|255] "raw"  MDS,BSI
 SG_ ConsecutiveData2 m2 : 23|8@0+ (1,0) [0|255] "raw"  MDS,BSI
 SG_ SingleData2 m0 : 23|8@0+ (1,0) [0|255] "raw"  MDS,BSI
 SG_ SeparationTimeRaw m3 : 23|8@0+ (1,0) [0|255] "raw"  MDS,BSI
 SG_ UnknownData1 m4 : 15|8@0+ (1,0) [0|255] "raw"  MDS,BSI
 SG_ ConsecutiveData1 m2 : 15|8@0+ (1,0) [0|255] "raw"  MDS,BSI
 SG_ SingleData1 m0 : 15|8@0+ (1,0) [0|255] "raw"  MDS,BSI
 SG_ BlockSize m3 : 15|8@0+ (1,0) [0|255] "raw"  MDS,BSI
 SG_ UnknownPciLow m4 : 3|4@0+ (1,0) [0|15] "raw"  MDS,BSI
 SG_ FlowStatus m3 : 3|4@0+ (1,0) [0|15] "raw"  MDS,BSI
 SG_ ConsecutiveSequence m2 : 3|4@0+ (1,0) [0|15] "raw"  MDS,BSI
 SG_ FirstFrameLength m1 : 3|12@0+ (1,0) [0|4095] "raw"  MDS,BSI
 SG_ SingleFrameLength m0 : 3|4@0+ (1,0) [0|15] "raw"  MDS,BSI
 SG_ IsoTpFrameType M : 7|4@0+ (1,0) [0|15] ""  MDS,BSI

BO_ 1649 CDC_DiagResponse: 8 CDC
 SG_ FlowPadding5 m3 : 63|8@0+ (1,0) [0|255] "raw"  BSI,MDS
 SG_ FirstData6 m1 : 63|8@0+ (1,0) [0|255] "raw"  BSI,MDS
 SG_ UnknownData7 m4 : 63|8@0+ (1,0) [0|255] "raw"  BSI,MDS
 SG_ ConsecutiveData7 m2 : 63|8@0+ (1,0) [0|255] "raw"  BSI,MDS
 SG_ SingleData7 m0 : 63|8@0+ (1,0) [0|255] "raw"  BSI,MDS
 SG_ FlowPadding4 m3 : 55|8@0+ (1,0) [0|255] "raw"  BSI,MDS
 SG_ FirstData5 m1 : 55|8@0+ (1,0) [0|255] "raw"  BSI,MDS
 SG_ UnknownData6 m4 : 55|8@0+ (1,0) [0|255] "raw"  BSI,MDS
 SG_ ConsecutiveData6 m2 : 55|8@0+ (1,0) [0|255] "raw"  BSI,MDS
 SG_ SingleData6 m0 : 55|8@0+ (1,0) [0|255] "raw"  BSI,MDS
 SG_ FlowPadding3 m3 : 47|8@0+ (1,0) [0|255] "raw"  BSI,MDS
 SG_ FirstData4 m1 : 47|8@0+ (1,0) [0|255] "raw"  BSI,MDS
 SG_ UnknownData5 m4 : 47|8@0+ (1,0) [0|255] "raw"  BSI,MDS
 SG_ ConsecutiveData5 m2 : 47|8@0+ (1,0) [0|255] "raw"  BSI,MDS
 SG_ SingleData5 m0 : 47|8@0+ (1,0) [0|255] "raw"  BSI,MDS
 SG_ FlowPadding2 m3 : 39|8@0+ (1,0) [0|255] "raw"  BSI,MDS
 SG_ FirstData3 m1 : 39|8@0+ (1,0) [0|255] "raw"  BSI,MDS
 SG_ UnknownData4 m4 : 39|8@0+ (1,0) [0|255] "raw"  BSI,MDS
 SG_ ConsecutiveData4 m2 : 39|8@0+ (1,0) [0|255] "raw"  BSI,MDS
 SG_ SingleData4 m0 : 39|8@0+ (1,0) [0|255] "raw"  BSI,MDS
 SG_ FlowPadding1 m3 : 31|8@0+ (1,0) [0|255] "raw"  BSI,MDS
 SG_ FirstData2 m1 : 31|8@0+ (1,0) [0|255] "raw"  BSI,MDS
 SG_ UnknownData3 m4 : 31|8@0+ (1,0) [0|255] "raw"  BSI,MDS
 SG_ ConsecutiveData3 m2 : 31|8@0+ (1,0) [0|255] "raw"  BSI,MDS
 SG_ SingleData3 m0 : 31|8@0+ (1,0) [0|255] "raw"  BSI,MDS
 SG_ FirstData1 m1 : 23|8@0+ (1,0) [0|255] "raw"  BSI,MDS
 SG_ UnknownData2 m4 : 23|8@0+ (1,0) [0|255] "raw"  BSI,MDS
 SG_ ConsecutiveData2 m2 : 23|8@0+ (1,0) [0|255] "raw"  BSI,MDS
 SG_ SingleData2 m0 : 23|8@0+ (1,0) [0|255] "raw"  BSI,MDS
 SG_ SeparationTimeRaw m3 : 23|8@0+ (1,0) [0|255] "raw"  BSI,MDS
 SG_ UnknownData1 m4 : 15|8@0+ (1,0) [0|255] "raw"  BSI,MDS
 SG_ ConsecutiveData1 m2 : 15|8@0+ (1,0) [0|255] "raw"  BSI,MDS
 SG_ SingleData1 m0 : 15|8@0+ (1,0) [0|255] "raw"  BSI,MDS
 SG_ BlockSize m3 : 15|8@0+ (1,0) [0|255] "raw"  BSI,MDS
 SG_ UnknownPciLow m4 : 3|4@0+ (1,0) [0|15] "raw"  BSI,MDS
 SG_ FlowStatus m3 : 3|4@0+ (1,0) [0|15] "raw"  BSI,MDS
 SG_ ConsecutiveSequence m2 : 3|4@0+ (1,0) [0|15] "raw"  BSI,MDS
 SG_ FirstFrameLength m1 : 3|12@0+ (1,0) [0|4095] "raw"  BSI,MDS
 SG_ SingleFrameLength m0 : 3|4@0+ (1,0) [0|15] "raw"  BSI,MDS
 SG_ IsoTpFrameType M : 7|4@0+ (1,0) [0|15] ""  BSI,MDS

BO_ 1650 MATT_DiagResponse: 8 MATT
 SG_ FlowPadding5 m3 : 63|8@0+ (1,0) [0|255] "raw"  MDS,BSI
 SG_ FirstData6 m1 : 63|8@0+ (1,0) [0|255] "raw"  MDS,BSI
 SG_ UnknownData7 m4 : 63|8@0+ (1,0) [0|255] "raw"  MDS,BSI
 SG_ ConsecutiveData7 m2 : 63|8@0+ (1,0) [0|255] "raw"  MDS,BSI
 SG_ SingleData7 m0 : 63|8@0+ (1,0) [0|255] "raw"  MDS,BSI
 SG_ FlowPadding4 m3 : 55|8@0+ (1,0) [0|255] "raw"  MDS,BSI
 SG_ FirstData5 m1 : 55|8@0+ (1,0) [0|255] "raw"  MDS,BSI
 SG_ UnknownData6 m4 : 55|8@0+ (1,0) [0|255] "raw"  MDS,BSI
 SG_ ConsecutiveData6 m2 : 55|8@0+ (1,0) [0|255] "raw"  MDS,BSI
 SG_ SingleData6 m0 : 55|8@0+ (1,0) [0|255] "raw"  MDS,BSI
 SG_ FlowPadding3 m3 : 47|8@0+ (1,0) [0|255] "raw"  MDS,BSI
 SG_ FirstData4 m1 : 47|8@0+ (1,0) [0|255] "raw"  MDS,BSI
 SG_ UnknownData5 m4 : 47|8@0+ (1,0) [0|255] "raw"  MDS,BSI
 SG_ ConsecutiveData5 m2 : 47|8@0+ (1,0) [0|255] "raw"  MDS,BSI
 SG_ SingleData5 m0 : 47|8@0+ (1,0) [0|255] "raw"  MDS,BSI
 SG_ FlowPadding2 m3 : 39|8@0+ (1,0) [0|255] "raw"  MDS,BSI
 SG_ FirstData3 m1 : 39|8@0+ (1,0) [0|255] "raw"  MDS,BSI
 SG_ UnknownData4 m4 : 39|8@0+ (1,0) [0|255] "raw"  MDS,BSI
 SG_ ConsecutiveData4 m2 : 39|8@0+ (1,0) [0|255] "raw"  MDS,BSI
 SG_ SingleData4 m0 : 39|8@0+ (1,0) [0|255] "raw"  MDS,BSI
 SG_ FlowPadding1 m3 : 31|8@0+ (1,0) [0|255] "raw"  MDS,BSI
 SG_ FirstData2 m1 : 31|8@0+ (1,0) [0|255] "raw"  MDS,BSI
 SG_ UnknownData3 m4 : 31|8@0+ (1,0) [0|255] "raw"  MDS,BSI
 SG_ ConsecutiveData3 m2 : 31|8@0+ (1,0) [0|255] "raw"  MDS,BSI
 SG_ SingleData3 m0 : 31|8@0+ (1,0) [0|255] "raw"  MDS,BSI
 SG_ FirstData1 m1 : 23|8@0+ (1,0) [0|255] "raw"  MDS,BSI
 SG_ UnknownData2 m4 : 23|8@0+ (1,0) [0|255] "raw"  MDS,BSI
 SG_ ConsecutiveData2 m2 : 23|8@0+ (1,0) [0|255] "raw"  MDS,BSI
 SG_ SingleData2 m0 : 23|8@0+ (1,0) [0|255] "raw"  MDS,BSI
 SG_ SeparationTimeRaw m3 : 23|8@0+ (1,0) [0|255] "raw"  MDS,BSI
 SG_ UnknownData1 m4 : 15|8@0+ (1,0) [0|255] "raw"  MDS,BSI
 SG_ ConsecutiveData1 m2 : 15|8@0+ (1,0) [0|255] "raw"  MDS,BSI
 SG_ SingleData1 m0 : 15|8@0+ (1,0) [0|255] "raw"  MDS,BSI
 SG_ BlockSize m3 : 15|8@0+ (1,0) [0|255] "raw"  MDS,BSI
 SG_ UnknownPciLow m4 : 3|4@0+ (1,0) [0|15] "raw"  MDS,BSI
 SG_ FlowStatus m3 : 3|4@0+ (1,0) [0|15] "raw"  MDS,BSI
 SG_ ConsecutiveSequence m2 : 3|4@0+ (1,0) [0|15] "raw"  MDS,BSI
 SG_ FirstFrameLength m1 : 3|12@0+ (1,0) [0|4095] "raw"  MDS,BSI
 SG_ SingleFrameLength m0 : 3|4@0+ (1,0) [0|15] "raw"  MDS,BSI
 SG_ IsoTpFrameType M : 7|4@0+ (1,0) [0|15] ""  MDS,BSI

BO_ 1651 AVP_DiagResponse: 8 AVP
 SG_ FlowPadding5 m3 : 63|8@0+ (1,0) [0|255] "raw"  BSI,MDS
 SG_ FirstData6 m1 : 63|8@0+ (1,0) [0|255] "raw"  BSI,MDS
 SG_ UnknownData7 m4 : 63|8@0+ (1,0) [0|255] "raw"  BSI,MDS
 SG_ ConsecutiveData7 m2 : 63|8@0+ (1,0) [0|255] "raw"  BSI,MDS
 SG_ SingleData7 m0 : 63|8@0+ (1,0) [0|255] "raw"  BSI,MDS
 SG_ FlowPadding4 m3 : 55|8@0+ (1,0) [0|255] "raw"  BSI,MDS
 SG_ FirstData5 m1 : 55|8@0+ (1,0) [0|255] "raw"  BSI,MDS
 SG_ UnknownData6 m4 : 55|8@0+ (1,0) [0|255] "raw"  BSI,MDS
 SG_ ConsecutiveData6 m2 : 55|8@0+ (1,0) [0|255] "raw"  BSI,MDS
 SG_ SingleData6 m0 : 55|8@0+ (1,0) [0|255] "raw"  BSI,MDS
 SG_ FlowPadding3 m3 : 47|8@0+ (1,0) [0|255] "raw"  BSI,MDS
 SG_ FirstData4 m1 : 47|8@0+ (1,0) [0|255] "raw"  BSI,MDS
 SG_ UnknownData5 m4 : 47|8@0+ (1,0) [0|255] "raw"  BSI,MDS
 SG_ ConsecutiveData5 m2 : 47|8@0+ (1,0) [0|255] "raw"  BSI,MDS
 SG_ SingleData5 m0 : 47|8@0+ (1,0) [0|255] "raw"  BSI,MDS
 SG_ FlowPadding2 m3 : 39|8@0+ (1,0) [0|255] "raw"  BSI,MDS
 SG_ FirstData3 m1 : 39|8@0+ (1,0) [0|255] "raw"  BSI,MDS
 SG_ UnknownData4 m4 : 39|8@0+ (1,0) [0|255] "raw"  BSI,MDS
 SG_ ConsecutiveData4 m2 : 39|8@0+ (1,0) [0|255] "raw"  BSI,MDS
 SG_ SingleData4 m0 : 39|8@0+ (1,0) [0|255] "raw"  BSI,MDS
 SG_ FlowPadding1 m3 : 31|8@0+ (1,0) [0|255] "raw"  BSI,MDS
 SG_ FirstData2 m1 : 31|8@0+ (1,0) [0|255] "raw"  BSI,MDS
 SG_ UnknownData3 m4 : 31|8@0+ (1,0) [0|255] "raw"  BSI,MDS
 SG_ ConsecutiveData3 m2 : 31|8@0+ (1,0) [0|255] "raw"  BSI,MDS
 SG_ SingleData3 m0 : 31|8@0+ (1,0) [0|255] "raw"  BSI,MDS
 SG_ FirstData1 m1 : 23|8@0+ (1,0) [0|255] "raw"  BSI,MDS
 SG_ UnknownData2 m4 : 23|8@0+ (1,0) [0|255] "raw"  BSI,MDS
 SG_ ConsecutiveData2 m2 : 23|8@0+ (1,0) [0|255] "raw"  BSI,MDS
 SG_ SingleData2 m0 : 23|8@0+ (1,0) [0|255] "raw"  BSI,MDS
 SG_ SeparationTimeRaw m3 : 23|8@0+ (1,0) [0|255] "raw"  BSI,MDS
 SG_ UnknownData1 m4 : 15|8@0+ (1,0) [0|255] "raw"  BSI,MDS
 SG_ ConsecutiveData1 m2 : 15|8@0+ (1,0) [0|255] "raw"  BSI,MDS
 SG_ SingleData1 m0 : 15|8@0+ (1,0) [0|255] "raw"  BSI,MDS
 SG_ BlockSize m3 : 15|8@0+ (1,0) [0|255] "raw"  BSI,MDS
 SG_ UnknownPciLow m4 : 3|4@0+ (1,0) [0|15] "raw"  BSI,MDS
 SG_ FlowStatus m3 : 3|4@0+ (1,0) [0|15] "raw"  BSI,MDS
 SG_ ConsecutiveSequence m2 : 3|4@0+ (1,0) [0|15] "raw"  BSI,MDS
 SG_ FirstFrameLength m1 : 3|12@0+ (1,0) [0|4095] "raw"  BSI,MDS
 SG_ SingleFrameLength m0 : 3|4@0+ (1,0) [0|15] "raw"  BSI,MDS
 SG_ IsoTpFrameType M : 7|4@0+ (1,0) [0|15] ""  BSI,MDS

BO_ 1652 BSI_DiagResponse_25: 8 BSI
 SG_ FlowPadding5 m3 : 63|8@0+ (1,0) [0|255] "raw"  MDS
 SG_ FirstData6 m1 : 63|8@0+ (1,0) [0|255] "raw"  MDS
 SG_ UnknownData7 m4 : 63|8@0+ (1,0) [0|255] "raw"  MDS
 SG_ ConsecutiveData7 m2 : 63|8@0+ (1,0) [0|255] "raw"  MDS
 SG_ SingleData7 m0 : 63|8@0+ (1,0) [0|255] "raw"  MDS
 SG_ FlowPadding4 m3 : 55|8@0+ (1,0) [0|255] "raw"  MDS
 SG_ FirstData5 m1 : 55|8@0+ (1,0) [0|255] "raw"  MDS
 SG_ UnknownData6 m4 : 55|8@0+ (1,0) [0|255] "raw"  MDS
 SG_ ConsecutiveData6 m2 : 55|8@0+ (1,0) [0|255] "raw"  MDS
 SG_ SingleData6 m0 : 55|8@0+ (1,0) [0|255] "raw"  MDS
 SG_ FlowPadding3 m3 : 47|8@0+ (1,0) [0|255] "raw"  MDS
 SG_ FirstData4 m1 : 47|8@0+ (1,0) [0|255] "raw"  MDS
 SG_ UnknownData5 m4 : 47|8@0+ (1,0) [0|255] "raw"  MDS
 SG_ ConsecutiveData5 m2 : 47|8@0+ (1,0) [0|255] "raw"  MDS
 SG_ SingleData5 m0 : 47|8@0+ (1,0) [0|255] "raw"  MDS
 SG_ FlowPadding2 m3 : 39|8@0+ (1,0) [0|255] "raw"  MDS
 SG_ FirstData3 m1 : 39|8@0+ (1,0) [0|255] "raw"  MDS
 SG_ UnknownData4 m4 : 39|8@0+ (1,0) [0|255] "raw"  MDS
 SG_ ConsecutiveData4 m2 : 39|8@0+ (1,0) [0|255] "raw"  MDS
 SG_ SingleData4 m0 : 39|8@0+ (1,0) [0|255] "raw"  MDS
 SG_ FlowPadding1 m3 : 31|8@0+ (1,0) [0|255] "raw"  MDS
 SG_ FirstData2 m1 : 31|8@0+ (1,0) [0|255] "raw"  MDS
 SG_ UnknownData3 m4 : 31|8@0+ (1,0) [0|255] "raw"  MDS
 SG_ ConsecutiveData3 m2 : 31|8@0+ (1,0) [0|255] "raw"  MDS
 SG_ SingleData3 m0 : 31|8@0+ (1,0) [0|255] "raw"  MDS
 SG_ FirstData1 m1 : 23|8@0+ (1,0) [0|255] "raw"  MDS
 SG_ UnknownData2 m4 : 23|8@0+ (1,0) [0|255] "raw"  MDS
 SG_ ConsecutiveData2 m2 : 23|8@0+ (1,0) [0|255] "raw"  MDS
 SG_ SingleData2 m0 : 23|8@0+ (1,0) [0|255] "raw"  MDS
 SG_ SeparationTimeRaw m3 : 23|8@0+ (1,0) [0|255] "raw"  MDS
 SG_ UnknownData1 m4 : 15|8@0+ (1,0) [0|255] "raw"  MDS
 SG_ ConsecutiveData1 m2 : 15|8@0+ (1,0) [0|255] "raw"  MDS
 SG_ SingleData1 m0 : 15|8@0+ (1,0) [0|255] "raw"  MDS
 SG_ BlockSize m3 : 15|8@0+ (1,0) [0|255] "raw"  MDS
 SG_ UnknownPciLow m4 : 3|4@0+ (1,0) [0|15] "raw"  MDS
 SG_ FlowStatus m3 : 3|4@0+ (1,0) [0|15] "raw"  MDS
 SG_ ConsecutiveSequence m2 : 3|4@0+ (1,0) [0|15] "raw"  MDS
 SG_ FirstFrameLength m1 : 3|12@0+ (1,0) [0|4095] "raw"  MDS
 SG_ SingleFrameLength m0 : 3|4@0+ (1,0) [0|15] "raw"  MDS
 SG_ IsoTpFrameType M : 7|4@0+ (1,0) [0|15] ""  MDS

BO_ 1654 BTT_DiagResponseBtt: 8 BTT
 SG_ DiagnosticData : 7|64@0+ (1,0) [0|18446744073709551615] ""  BSI

BO_ 1656 BSI_DiagResponse_26: 8 BSI
 SG_ FlowPadding5 m3 : 63|8@0+ (1,0) [0|255] "raw"  MDS
 SG_ FirstData6 m1 : 63|8@0+ (1,0) [0|255] "raw"  MDS
 SG_ UnknownData7 m4 : 63|8@0+ (1,0) [0|255] "raw"  MDS
 SG_ ConsecutiveData7 m2 : 63|8@0+ (1,0) [0|255] "raw"  MDS
 SG_ SingleData7 m0 : 63|8@0+ (1,0) [0|255] "raw"  MDS
 SG_ FlowPadding4 m3 : 55|8@0+ (1,0) [0|255] "raw"  MDS
 SG_ FirstData5 m1 : 55|8@0+ (1,0) [0|255] "raw"  MDS
 SG_ UnknownData6 m4 : 55|8@0+ (1,0) [0|255] "raw"  MDS
 SG_ ConsecutiveData6 m2 : 55|8@0+ (1,0) [0|255] "raw"  MDS
 SG_ SingleData6 m0 : 55|8@0+ (1,0) [0|255] "raw"  MDS
 SG_ FlowPadding3 m3 : 47|8@0+ (1,0) [0|255] "raw"  MDS
 SG_ FirstData4 m1 : 47|8@0+ (1,0) [0|255] "raw"  MDS
 SG_ UnknownData5 m4 : 47|8@0+ (1,0) [0|255] "raw"  MDS
 SG_ ConsecutiveData5 m2 : 47|8@0+ (1,0) [0|255] "raw"  MDS
 SG_ SingleData5 m0 : 47|8@0+ (1,0) [0|255] "raw"  MDS
 SG_ FlowPadding2 m3 : 39|8@0+ (1,0) [0|255] "raw"  MDS
 SG_ FirstData3 m1 : 39|8@0+ (1,0) [0|255] "raw"  MDS
 SG_ UnknownData4 m4 : 39|8@0+ (1,0) [0|255] "raw"  MDS
 SG_ ConsecutiveData4 m2 : 39|8@0+ (1,0) [0|255] "raw"  MDS
 SG_ SingleData4 m0 : 39|8@0+ (1,0) [0|255] "raw"  MDS
 SG_ FlowPadding1 m3 : 31|8@0+ (1,0) [0|255] "raw"  MDS
 SG_ FirstData2 m1 : 31|8@0+ (1,0) [0|255] "raw"  MDS
 SG_ UnknownData3 m4 : 31|8@0+ (1,0) [0|255] "raw"  MDS
 SG_ ConsecutiveData3 m2 : 31|8@0+ (1,0) [0|255] "raw"  MDS
 SG_ SingleData3 m0 : 31|8@0+ (1,0) [0|255] "raw"  MDS
 SG_ FirstData1 m1 : 23|8@0+ (1,0) [0|255] "raw"  MDS
 SG_ UnknownData2 m4 : 23|8@0+ (1,0) [0|255] "raw"  MDS
 SG_ ConsecutiveData2 m2 : 23|8@0+ (1,0) [0|255] "raw"  MDS
 SG_ SingleData2 m0 : 23|8@0+ (1,0) [0|255] "raw"  MDS
 SG_ SeparationTimeRaw m3 : 23|8@0+ (1,0) [0|255] "raw"  MDS
 SG_ UnknownData1 m4 : 15|8@0+ (1,0) [0|255] "raw"  MDS
 SG_ ConsecutiveData1 m2 : 15|8@0+ (1,0) [0|255] "raw"  MDS
 SG_ SingleData1 m0 : 15|8@0+ (1,0) [0|255] "raw"  MDS
 SG_ BlockSize m3 : 15|8@0+ (1,0) [0|255] "raw"  MDS
 SG_ UnknownPciLow m4 : 3|4@0+ (1,0) [0|15] "raw"  MDS
 SG_ FlowStatus m3 : 3|4@0+ (1,0) [0|15] "raw"  MDS
 SG_ ConsecutiveSequence m2 : 3|4@0+ (1,0) [0|15] "raw"  MDS
 SG_ FirstFrameLength m1 : 3|12@0+ (1,0) [0|4095] "raw"  MDS
 SG_ SingleFrameLength m0 : 3|4@0+ (1,0) [0|15] "raw"  MDS
 SG_ IsoTpFrameType M : 7|4@0+ (1,0) [0|15] ""  MDS

BO_ 1659 FMUX_DiagResponse: 8 FMUX
 SG_ FlowPadding5 m3 : 63|8@0+ (1,0) [0|255] "raw"  MDS,BSI
 SG_ FirstData6 m1 : 63|8@0+ (1,0) [0|255] "raw"  MDS,BSI
 SG_ UnknownData7 m4 : 63|8@0+ (1,0) [0|255] "raw"  MDS,BSI
 SG_ ConsecutiveData7 m2 : 63|8@0+ (1,0) [0|255] "raw"  MDS,BSI
 SG_ SingleData7 m0 : 63|8@0+ (1,0) [0|255] "raw"  MDS,BSI
 SG_ FlowPadding4 m3 : 55|8@0+ (1,0) [0|255] "raw"  MDS,BSI
 SG_ FirstData5 m1 : 55|8@0+ (1,0) [0|255] "raw"  MDS,BSI
 SG_ UnknownData6 m4 : 55|8@0+ (1,0) [0|255] "raw"  MDS,BSI
 SG_ ConsecutiveData6 m2 : 55|8@0+ (1,0) [0|255] "raw"  MDS,BSI
 SG_ SingleData6 m0 : 55|8@0+ (1,0) [0|255] "raw"  MDS,BSI
 SG_ FlowPadding3 m3 : 47|8@0+ (1,0) [0|255] "raw"  MDS,BSI
 SG_ FirstData4 m1 : 47|8@0+ (1,0) [0|255] "raw"  MDS,BSI
 SG_ UnknownData5 m4 : 47|8@0+ (1,0) [0|255] "raw"  MDS,BSI
 SG_ ConsecutiveData5 m2 : 47|8@0+ (1,0) [0|255] "raw"  MDS,BSI
 SG_ SingleData5 m0 : 47|8@0+ (1,0) [0|255] "raw"  MDS,BSI
 SG_ FlowPadding2 m3 : 39|8@0+ (1,0) [0|255] "raw"  MDS,BSI
 SG_ FirstData3 m1 : 39|8@0+ (1,0) [0|255] "raw"  MDS,BSI
 SG_ UnknownData4 m4 : 39|8@0+ (1,0) [0|255] "raw"  MDS,BSI
 SG_ ConsecutiveData4 m2 : 39|8@0+ (1,0) [0|255] "raw"  MDS,BSI
 SG_ SingleData4 m0 : 39|8@0+ (1,0) [0|255] "raw"  MDS,BSI
 SG_ FlowPadding1 m3 : 31|8@0+ (1,0) [0|255] "raw"  MDS,BSI
 SG_ FirstData2 m1 : 31|8@0+ (1,0) [0|255] "raw"  MDS,BSI
 SG_ UnknownData3 m4 : 31|8@0+ (1,0) [0|255] "raw"  MDS,BSI
 SG_ ConsecutiveData3 m2 : 31|8@0+ (1,0) [0|255] "raw"  MDS,BSI
 SG_ SingleData3 m0 : 31|8@0+ (1,0) [0|255] "raw"  MDS,BSI
 SG_ FirstData1 m1 : 23|8@0+ (1,0) [0|255] "raw"  MDS,BSI
 SG_ UnknownData2 m4 : 23|8@0+ (1,0) [0|255] "raw"  MDS,BSI
 SG_ ConsecutiveData2 m2 : 23|8@0+ (1,0) [0|255] "raw"  MDS,BSI
 SG_ SingleData2 m0 : 23|8@0+ (1,0) [0|255] "raw"  MDS,BSI
 SG_ SeparationTimeRaw m3 : 23|8@0+ (1,0) [0|255] "raw"  MDS,BSI
 SG_ UnknownData1 m4 : 15|8@0+ (1,0) [0|255] "raw"  MDS,BSI
 SG_ ConsecutiveData1 m2 : 15|8@0+ (1,0) [0|255] "raw"  MDS,BSI
 SG_ SingleData1 m0 : 15|8@0+ (1,0) [0|255] "raw"  MDS,BSI
 SG_ BlockSize m3 : 15|8@0+ (1,0) [0|255] "raw"  MDS,BSI
 SG_ UnknownPciLow m4 : 3|4@0+ (1,0) [0|15] "raw"  MDS,BSI
 SG_ FlowStatus m3 : 3|4@0+ (1,0) [0|15] "raw"  MDS,BSI
 SG_ ConsecutiveSequence m2 : 3|4@0+ (1,0) [0|15] "raw"  MDS,BSI
 SG_ FirstFrameLength m1 : 3|12@0+ (1,0) [0|4095] "raw"  MDS,BSI
 SG_ SingleFrameLength m0 : 3|4@0+ (1,0) [0|15] "raw"  MDS,BSI
 SG_ IsoTpFrameType M : 7|4@0+ (1,0) [0|15] ""  MDS,BSI

BO_ 1660 MDS_DiagResponse: 8 MDS
 SG_ FlowPadding5 m3 : 63|8@0+ (1,0) [0|255] "raw"  BSI
 SG_ FirstData6 m1 : 63|8@0+ (1,0) [0|255] "raw"  BSI
 SG_ UnknownData7 m4 : 63|8@0+ (1,0) [0|255] "raw"  BSI
 SG_ ConsecutiveData7 m2 : 63|8@0+ (1,0) [0|255] "raw"  BSI
 SG_ SingleData7 m0 : 63|8@0+ (1,0) [0|255] "raw"  BSI
 SG_ FlowPadding4 m3 : 55|8@0+ (1,0) [0|255] "raw"  BSI
 SG_ FirstData5 m1 : 55|8@0+ (1,0) [0|255] "raw"  BSI
 SG_ UnknownData6 m4 : 55|8@0+ (1,0) [0|255] "raw"  BSI
 SG_ ConsecutiveData6 m2 : 55|8@0+ (1,0) [0|255] "raw"  BSI
 SG_ SingleData6 m0 : 55|8@0+ (1,0) [0|255] "raw"  BSI
 SG_ FlowPadding3 m3 : 47|8@0+ (1,0) [0|255] "raw"  BSI
 SG_ FirstData4 m1 : 47|8@0+ (1,0) [0|255] "raw"  BSI
 SG_ UnknownData5 m4 : 47|8@0+ (1,0) [0|255] "raw"  BSI
 SG_ ConsecutiveData5 m2 : 47|8@0+ (1,0) [0|255] "raw"  BSI
 SG_ SingleData5 m0 : 47|8@0+ (1,0) [0|255] "raw"  BSI
 SG_ FlowPadding2 m3 : 39|8@0+ (1,0) [0|255] "raw"  BSI
 SG_ FirstData3 m1 : 39|8@0+ (1,0) [0|255] "raw"  BSI
 SG_ UnknownData4 m4 : 39|8@0+ (1,0) [0|255] "raw"  BSI
 SG_ ConsecutiveData4 m2 : 39|8@0+ (1,0) [0|255] "raw"  BSI
 SG_ SingleData4 m0 : 39|8@0+ (1,0) [0|255] "raw"  BSI
 SG_ FlowPadding1 m3 : 31|8@0+ (1,0) [0|255] "raw"  BSI
 SG_ FirstData2 m1 : 31|8@0+ (1,0) [0|255] "raw"  BSI
 SG_ UnknownData3 m4 : 31|8@0+ (1,0) [0|255] "raw"  BSI
 SG_ ConsecutiveData3 m2 : 31|8@0+ (1,0) [0|255] "raw"  BSI
 SG_ SingleData3 m0 : 31|8@0+ (1,0) [0|255] "raw"  BSI
 SG_ FirstData1 m1 : 23|8@0+ (1,0) [0|255] "raw"  BSI
 SG_ UnknownData2 m4 : 23|8@0+ (1,0) [0|255] "raw"  BSI
 SG_ ConsecutiveData2 m2 : 23|8@0+ (1,0) [0|255] "raw"  BSI
 SG_ SingleData2 m0 : 23|8@0+ (1,0) [0|255] "raw"  BSI
 SG_ SeparationTimeRaw m3 : 23|8@0+ (1,0) [0|255] "raw"  BSI
 SG_ UnknownData1 m4 : 15|8@0+ (1,0) [0|255] "raw"  BSI
 SG_ ConsecutiveData1 m2 : 15|8@0+ (1,0) [0|255] "raw"  BSI
 SG_ SingleData1 m0 : 15|8@0+ (1,0) [0|255] "raw"  BSI
 SG_ BlockSize m3 : 15|8@0+ (1,0) [0|255] "raw"  BSI
 SG_ UnknownPciLow m4 : 3|4@0+ (1,0) [0|15] "raw"  BSI
 SG_ FlowStatus m3 : 3|4@0+ (1,0) [0|15] "raw"  BSI
 SG_ ConsecutiveSequence m2 : 3|4@0+ (1,0) [0|15] "raw"  BSI
 SG_ FirstFrameLength m1 : 3|12@0+ (1,0) [0|4095] "raw"  BSI
 SG_ SingleFrameLength m0 : 3|4@0+ (1,0) [0|15] "raw"  BSI
 SG_ IsoTpFrameType M : 7|4@0+ (1,0) [0|15] ""  BSI

BO_ 1661 AMPLI_DiagResponse: 8 AMPLI
 SG_ FlowPadding5 m3 : 63|8@0+ (1,0) [0|255] "raw"  BSI,MDS
 SG_ FirstData6 m1 : 63|8@0+ (1,0) [0|255] "raw"  BSI,MDS
 SG_ UnknownData7 m4 : 63|8@0+ (1,0) [0|255] "raw"  BSI,MDS
 SG_ ConsecutiveData7 m2 : 63|8@0+ (1,0) [0|255] "raw"  BSI,MDS
 SG_ SingleData7 m0 : 63|8@0+ (1,0) [0|255] "raw"  BSI,MDS
 SG_ FlowPadding4 m3 : 55|8@0+ (1,0) [0|255] "raw"  BSI,MDS
 SG_ FirstData5 m1 : 55|8@0+ (1,0) [0|255] "raw"  BSI,MDS
 SG_ UnknownData6 m4 : 55|8@0+ (1,0) [0|255] "raw"  BSI,MDS
 SG_ ConsecutiveData6 m2 : 55|8@0+ (1,0) [0|255] "raw"  BSI,MDS
 SG_ SingleData6 m0 : 55|8@0+ (1,0) [0|255] "raw"  BSI,MDS
 SG_ FlowPadding3 m3 : 47|8@0+ (1,0) [0|255] "raw"  BSI,MDS
 SG_ FirstData4 m1 : 47|8@0+ (1,0) [0|255] "raw"  BSI,MDS
 SG_ UnknownData5 m4 : 47|8@0+ (1,0) [0|255] "raw"  BSI,MDS
 SG_ ConsecutiveData5 m2 : 47|8@0+ (1,0) [0|255] "raw"  BSI,MDS
 SG_ SingleData5 m0 : 47|8@0+ (1,0) [0|255] "raw"  BSI,MDS
 SG_ FlowPadding2 m3 : 39|8@0+ (1,0) [0|255] "raw"  BSI,MDS
 SG_ FirstData3 m1 : 39|8@0+ (1,0) [0|255] "raw"  BSI,MDS
 SG_ UnknownData4 m4 : 39|8@0+ (1,0) [0|255] "raw"  BSI,MDS
 SG_ ConsecutiveData4 m2 : 39|8@0+ (1,0) [0|255] "raw"  BSI,MDS
 SG_ SingleData4 m0 : 39|8@0+ (1,0) [0|255] "raw"  BSI,MDS
 SG_ FlowPadding1 m3 : 31|8@0+ (1,0) [0|255] "raw"  BSI,MDS
 SG_ FirstData2 m1 : 31|8@0+ (1,0) [0|255] "raw"  BSI,MDS
 SG_ UnknownData3 m4 : 31|8@0+ (1,0) [0|255] "raw"  BSI,MDS
 SG_ ConsecutiveData3 m2 : 31|8@0+ (1,0) [0|255] "raw"  BSI,MDS
 SG_ SingleData3 m0 : 31|8@0+ (1,0) [0|255] "raw"  BSI,MDS
 SG_ FirstData1 m1 : 23|8@0+ (1,0) [0|255] "raw"  BSI,MDS
 SG_ UnknownData2 m4 : 23|8@0+ (1,0) [0|255] "raw"  BSI,MDS
 SG_ ConsecutiveData2 m2 : 23|8@0+ (1,0) [0|255] "raw"  BSI,MDS
 SG_ SingleData2 m0 : 23|8@0+ (1,0) [0|255] "raw"  BSI,MDS
 SG_ SeparationTimeRaw m3 : 23|8@0+ (1,0) [0|255] "raw"  BSI,MDS
 SG_ UnknownData1 m4 : 15|8@0+ (1,0) [0|255] "raw"  BSI,MDS
 SG_ ConsecutiveData1 m2 : 15|8@0+ (1,0) [0|255] "raw"  BSI,MDS
 SG_ SingleData1 m0 : 15|8@0+ (1,0) [0|255] "raw"  BSI,MDS
 SG_ BlockSize m3 : 15|8@0+ (1,0) [0|255] "raw"  BSI,MDS
 SG_ UnknownPciLow m4 : 3|4@0+ (1,0) [0|15] "raw"  BSI,MDS
 SG_ FlowStatus m3 : 3|4@0+ (1,0) [0|15] "raw"  BSI,MDS
 SG_ ConsecutiveSequence m2 : 3|4@0+ (1,0) [0|15] "raw"  BSI,MDS
 SG_ FirstFrameLength m1 : 3|12@0+ (1,0) [0|4095] "raw"  BSI,MDS
 SG_ SingleFrameLength m0 : 3|4@0+ (1,0) [0|15] "raw"  BSI,MDS
 SG_ IsoTpFrameType M : 7|4@0+ (1,0) [0|15] ""  BSI,MDS

BO_ 1736 MDS_DiagRequestToBSI: 8 MDS
 SG_ FlowPadding5 m3 : 63|8@0+ (1,0) [0|255] "raw"  BSI
 SG_ FirstData6 m1 : 63|8@0+ (1,0) [0|255] "raw"  BSI
 SG_ UnknownData7 m4 : 63|8@0+ (1,0) [0|255] "raw"  BSI
 SG_ ConsecutiveData7 m2 : 63|8@0+ (1,0) [0|255] "raw"  BSI
 SG_ SingleData7 m0 : 63|8@0+ (1,0) [0|255] "raw"  BSI
 SG_ FlowPadding4 m3 : 55|8@0+ (1,0) [0|255] "raw"  BSI
 SG_ FirstData5 m1 : 55|8@0+ (1,0) [0|255] "raw"  BSI
 SG_ UnknownData6 m4 : 55|8@0+ (1,0) [0|255] "raw"  BSI
 SG_ ConsecutiveData6 m2 : 55|8@0+ (1,0) [0|255] "raw"  BSI
 SG_ SingleData6 m0 : 55|8@0+ (1,0) [0|255] "raw"  BSI
 SG_ FlowPadding3 m3 : 47|8@0+ (1,0) [0|255] "raw"  BSI
 SG_ FirstData4 m1 : 47|8@0+ (1,0) [0|255] "raw"  BSI
 SG_ UnknownData5 m4 : 47|8@0+ (1,0) [0|255] "raw"  BSI
 SG_ ConsecutiveData5 m2 : 47|8@0+ (1,0) [0|255] "raw"  BSI
 SG_ SingleData5 m0 : 47|8@0+ (1,0) [0|255] "raw"  BSI
 SG_ FlowPadding2 m3 : 39|8@0+ (1,0) [0|255] "raw"  BSI
 SG_ FirstData3 m1 : 39|8@0+ (1,0) [0|255] "raw"  BSI
 SG_ UnknownData4 m4 : 39|8@0+ (1,0) [0|255] "raw"  BSI
 SG_ ConsecutiveData4 m2 : 39|8@0+ (1,0) [0|255] "raw"  BSI
 SG_ SingleData4 m0 : 39|8@0+ (1,0) [0|255] "raw"  BSI
 SG_ FlowPadding1 m3 : 31|8@0+ (1,0) [0|255] "raw"  BSI
 SG_ FirstData2 m1 : 31|8@0+ (1,0) [0|255] "raw"  BSI
 SG_ UnknownData3 m4 : 31|8@0+ (1,0) [0|255] "raw"  BSI
 SG_ ConsecutiveData3 m2 : 31|8@0+ (1,0) [0|255] "raw"  BSI
 SG_ SingleData3 m0 : 31|8@0+ (1,0) [0|255] "raw"  BSI
 SG_ FirstData1 m1 : 23|8@0+ (1,0) [0|255] "raw"  BSI
 SG_ UnknownData2 m4 : 23|8@0+ (1,0) [0|255] "raw"  BSI
 SG_ ConsecutiveData2 m2 : 23|8@0+ (1,0) [0|255] "raw"  BSI
 SG_ SingleData2 m0 : 23|8@0+ (1,0) [0|255] "raw"  BSI
 SG_ SeparationTimeRaw m3 : 23|8@0+ (1,0) [0|255] "raw"  BSI
 SG_ UnknownData1 m4 : 15|8@0+ (1,0) [0|255] "raw"  BSI
 SG_ ConsecutiveData1 m2 : 15|8@0+ (1,0) [0|255] "raw"  BSI
 SG_ SingleData1 m0 : 15|8@0+ (1,0) [0|255] "raw"  BSI
 SG_ BlockSize m3 : 15|8@0+ (1,0) [0|255] "raw"  BSI
 SG_ UnknownPciLow m4 : 3|4@0+ (1,0) [0|15] "raw"  BSI
 SG_ FlowStatus m3 : 3|4@0+ (1,0) [0|15] "raw"  BSI
 SG_ ConsecutiveSequence m2 : 3|4@0+ (1,0) [0|15] "raw"  BSI
 SG_ FirstFrameLength m1 : 3|12@0+ (1,0) [0|4095] "raw"  BSI
 SG_ SingleFrameLength m0 : 3|4@0+ (1,0) [0|15] "raw"  BSI
 SG_ IsoTpFrameType M : 7|4@0+ (1,0) [0|15] ""  BSI

BO_ 1814 FMUX_DiagResponse_2: 8 FMUX
 SG_ FlowPadding5 m3 : 63|8@0+ (1,0) [0|255] "raw"  MDS,BSI
 SG_ FirstData6 m1 : 63|8@0+ (1,0) [0|255] "raw"  MDS,BSI
 SG_ UnknownData7 m4 : 63|8@0+ (1,0) [0|255] "raw"  MDS,BSI
 SG_ ConsecutiveData7 m2 : 63|8@0+ (1,0) [0|255] "raw"  MDS,BSI
 SG_ SingleData7 m0 : 63|8@0+ (1,0) [0|255] "raw"  MDS,BSI
 SG_ FlowPadding4 m3 : 55|8@0+ (1,0) [0|255] "raw"  MDS,BSI
 SG_ FirstData5 m1 : 55|8@0+ (1,0) [0|255] "raw"  MDS,BSI
 SG_ UnknownData6 m4 : 55|8@0+ (1,0) [0|255] "raw"  MDS,BSI
 SG_ ConsecutiveData6 m2 : 55|8@0+ (1,0) [0|255] "raw"  MDS,BSI
 SG_ SingleData6 m0 : 55|8@0+ (1,0) [0|255] "raw"  MDS,BSI
 SG_ FlowPadding3 m3 : 47|8@0+ (1,0) [0|255] "raw"  MDS,BSI
 SG_ FirstData4 m1 : 47|8@0+ (1,0) [0|255] "raw"  MDS,BSI
 SG_ UnknownData5 m4 : 47|8@0+ (1,0) [0|255] "raw"  MDS,BSI
 SG_ ConsecutiveData5 m2 : 47|8@0+ (1,0) [0|255] "raw"  MDS,BSI
 SG_ SingleData5 m0 : 47|8@0+ (1,0) [0|255] "raw"  MDS,BSI
 SG_ FlowPadding2 m3 : 39|8@0+ (1,0) [0|255] "raw"  MDS,BSI
 SG_ FirstData3 m1 : 39|8@0+ (1,0) [0|255] "raw"  MDS,BSI
 SG_ UnknownData4 m4 : 39|8@0+ (1,0) [0|255] "raw"  MDS,BSI
 SG_ ConsecutiveData4 m2 : 39|8@0+ (1,0) [0|255] "raw"  MDS,BSI
 SG_ SingleData4 m0 : 39|8@0+ (1,0) [0|255] "raw"  MDS,BSI
 SG_ FlowPadding1 m3 : 31|8@0+ (1,0) [0|255] "raw"  MDS,BSI
 SG_ FirstData2 m1 : 31|8@0+ (1,0) [0|255] "raw"  MDS,BSI
 SG_ UnknownData3 m4 : 31|8@0+ (1,0) [0|255] "raw"  MDS,BSI
 SG_ ConsecutiveData3 m2 : 31|8@0+ (1,0) [0|255] "raw"  MDS,BSI
 SG_ SingleData3 m0 : 31|8@0+ (1,0) [0|255] "raw"  MDS,BSI
 SG_ FirstData1 m1 : 23|8@0+ (1,0) [0|255] "raw"  MDS,BSI
 SG_ UnknownData2 m4 : 23|8@0+ (1,0) [0|255] "raw"  MDS,BSI
 SG_ ConsecutiveData2 m2 : 23|8@0+ (1,0) [0|255] "raw"  MDS,BSI
 SG_ SingleData2 m0 : 23|8@0+ (1,0) [0|255] "raw"  MDS,BSI
 SG_ SeparationTimeRaw m3 : 23|8@0+ (1,0) [0|255] "raw"  MDS,BSI
 SG_ UnknownData1 m4 : 15|8@0+ (1,0) [0|255] "raw"  MDS,BSI
 SG_ ConsecutiveData1 m2 : 15|8@0+ (1,0) [0|255] "raw"  MDS,BSI
 SG_ SingleData1 m0 : 15|8@0+ (1,0) [0|255] "raw"  MDS,BSI
 SG_ BlockSize m3 : 15|8@0+ (1,0) [0|255] "raw"  MDS,BSI
 SG_ UnknownPciLow m4 : 3|4@0+ (1,0) [0|15] "raw"  MDS,BSI
 SG_ FlowStatus m3 : 3|4@0+ (1,0) [0|15] "raw"  MDS,BSI
 SG_ ConsecutiveSequence m2 : 3|4@0+ (1,0) [0|15] "raw"  MDS,BSI
 SG_ FirstFrameLength m1 : 3|12@0+ (1,0) [0|4095] "raw"  MDS,BSI
 SG_ SingleFrameLength m0 : 3|4@0+ (1,0) [0|15] "raw"  MDS,BSI
 SG_ IsoTpFrameType M : 7|4@0+ (1,0) [0|15] ""  MDS,BSI

BO_ 1816 CMB_DiagResponse_2: 8 CMB
 SG_ FlowPadding5 m3 : 63|8@0+ (1,0) [0|255] "raw"  MDS,BSI
 SG_ FirstData6 m1 : 63|8@0+ (1,0) [0|255] "raw"  MDS,BSI
 SG_ UnknownData7 m4 : 63|8@0+ (1,0) [0|255] "raw"  MDS,BSI
 SG_ ConsecutiveData7 m2 : 63|8@0+ (1,0) [0|255] "raw"  MDS,BSI
 SG_ SingleData7 m0 : 63|8@0+ (1,0) [0|255] "raw"  MDS,BSI
 SG_ FlowPadding4 m3 : 55|8@0+ (1,0) [0|255] "raw"  MDS,BSI
 SG_ FirstData5 m1 : 55|8@0+ (1,0) [0|255] "raw"  MDS,BSI
 SG_ UnknownData6 m4 : 55|8@0+ (1,0) [0|255] "raw"  MDS,BSI
 SG_ ConsecutiveData6 m2 : 55|8@0+ (1,0) [0|255] "raw"  MDS,BSI
 SG_ SingleData6 m0 : 55|8@0+ (1,0) [0|255] "raw"  MDS,BSI
 SG_ FlowPadding3 m3 : 47|8@0+ (1,0) [0|255] "raw"  MDS,BSI
 SG_ FirstData4 m1 : 47|8@0+ (1,0) [0|255] "raw"  MDS,BSI
 SG_ UnknownData5 m4 : 47|8@0+ (1,0) [0|255] "raw"  MDS,BSI
 SG_ ConsecutiveData5 m2 : 47|8@0+ (1,0) [0|255] "raw"  MDS,BSI
 SG_ SingleData5 m0 : 47|8@0+ (1,0) [0|255] "raw"  MDS,BSI
 SG_ FlowPadding2 m3 : 39|8@0+ (1,0) [0|255] "raw"  MDS,BSI
 SG_ FirstData3 m1 : 39|8@0+ (1,0) [0|255] "raw"  MDS,BSI
 SG_ UnknownData4 m4 : 39|8@0+ (1,0) [0|255] "raw"  MDS,BSI
 SG_ ConsecutiveData4 m2 : 39|8@0+ (1,0) [0|255] "raw"  MDS,BSI
 SG_ SingleData4 m0 : 39|8@0+ (1,0) [0|255] "raw"  MDS,BSI
 SG_ FlowPadding1 m3 : 31|8@0+ (1,0) [0|255] "raw"  MDS,BSI
 SG_ FirstData2 m1 : 31|8@0+ (1,0) [0|255] "raw"  MDS,BSI
 SG_ UnknownData3 m4 : 31|8@0+ (1,0) [0|255] "raw"  MDS,BSI
 SG_ ConsecutiveData3 m2 : 31|8@0+ (1,0) [0|255] "raw"  MDS,BSI
 SG_ SingleData3 m0 : 31|8@0+ (1,0) [0|255] "raw"  MDS,BSI
 SG_ FirstData1 m1 : 23|8@0+ (1,0) [0|255] "raw"  MDS,BSI
 SG_ UnknownData2 m4 : 23|8@0+ (1,0) [0|255] "raw"  MDS,BSI
 SG_ ConsecutiveData2 m2 : 23|8@0+ (1,0) [0|255] "raw"  MDS,BSI
 SG_ SingleData2 m0 : 23|8@0+ (1,0) [0|255] "raw"  MDS,BSI
 SG_ SeparationTimeRaw m3 : 23|8@0+ (1,0) [0|255] "raw"  MDS,BSI
 SG_ UnknownData1 m4 : 15|8@0+ (1,0) [0|255] "raw"  MDS,BSI
 SG_ ConsecutiveData1 m2 : 15|8@0+ (1,0) [0|255] "raw"  MDS,BSI
 SG_ SingleData1 m0 : 15|8@0+ (1,0) [0|255] "raw"  MDS,BSI
 SG_ BlockSize m3 : 15|8@0+ (1,0) [0|255] "raw"  MDS,BSI
 SG_ UnknownPciLow m4 : 3|4@0+ (1,0) [0|15] "raw"  MDS,BSI
 SG_ FlowStatus m3 : 3|4@0+ (1,0) [0|15] "raw"  MDS,BSI
 SG_ ConsecutiveSequence m2 : 3|4@0+ (1,0) [0|15] "raw"  MDS,BSI
 SG_ FirstFrameLength m1 : 3|12@0+ (1,0) [0|4095] "raw"  MDS,BSI
 SG_ SingleFrameLength m0 : 3|4@0+ (1,0) [0|15] "raw"  MDS,BSI
 SG_ IsoTpFrameType M : 7|4@0+ (1,0) [0|15] ""  MDS,BSI

BO_ 1846 BSI_DiagRequestToFMUX: 8 BSI
 SG_ FlowPadding5 m3 : 63|8@0+ (1,0) [0|255] "raw"  FMUX
 SG_ FirstData6 m1 : 63|8@0+ (1,0) [0|255] "raw"  FMUX
 SG_ UnknownData7 m4 : 63|8@0+ (1,0) [0|255] "raw"  FMUX
 SG_ ConsecutiveData7 m2 : 63|8@0+ (1,0) [0|255] "raw"  FMUX
 SG_ SingleData7 m0 : 63|8@0+ (1,0) [0|255] "raw"  FMUX
 SG_ FlowPadding4 m3 : 55|8@0+ (1,0) [0|255] "raw"  FMUX
 SG_ FirstData5 m1 : 55|8@0+ (1,0) [0|255] "raw"  FMUX
 SG_ UnknownData6 m4 : 55|8@0+ (1,0) [0|255] "raw"  FMUX
 SG_ ConsecutiveData6 m2 : 55|8@0+ (1,0) [0|255] "raw"  FMUX
 SG_ SingleData6 m0 : 55|8@0+ (1,0) [0|255] "raw"  FMUX
 SG_ FlowPadding3 m3 : 47|8@0+ (1,0) [0|255] "raw"  FMUX
 SG_ FirstData4 m1 : 47|8@0+ (1,0) [0|255] "raw"  FMUX
 SG_ UnknownData5 m4 : 47|8@0+ (1,0) [0|255] "raw"  FMUX
 SG_ ConsecutiveData5 m2 : 47|8@0+ (1,0) [0|255] "raw"  FMUX
 SG_ SingleData5 m0 : 47|8@0+ (1,0) [0|255] "raw"  FMUX
 SG_ FlowPadding2 m3 : 39|8@0+ (1,0) [0|255] "raw"  FMUX
 SG_ FirstData3 m1 : 39|8@0+ (1,0) [0|255] "raw"  FMUX
 SG_ UnknownData4 m4 : 39|8@0+ (1,0) [0|255] "raw"  FMUX
 SG_ ConsecutiveData4 m2 : 39|8@0+ (1,0) [0|255] "raw"  FMUX
 SG_ SingleData4 m0 : 39|8@0+ (1,0) [0|255] "raw"  FMUX
 SG_ FlowPadding1 m3 : 31|8@0+ (1,0) [0|255] "raw"  FMUX
 SG_ FirstData2 m1 : 31|8@0+ (1,0) [0|255] "raw"  FMUX
 SG_ UnknownData3 m4 : 31|8@0+ (1,0) [0|255] "raw"  FMUX
 SG_ ConsecutiveData3 m2 : 31|8@0+ (1,0) [0|255] "raw"  FMUX
 SG_ SingleData3 m0 : 31|8@0+ (1,0) [0|255] "raw"  FMUX
 SG_ FirstData1 m1 : 23|8@0+ (1,0) [0|255] "raw"  FMUX
 SG_ UnknownData2 m4 : 23|8@0+ (1,0) [0|255] "raw"  FMUX
 SG_ ConsecutiveData2 m2 : 23|8@0+ (1,0) [0|255] "raw"  FMUX
 SG_ SingleData2 m0 : 23|8@0+ (1,0) [0|255] "raw"  FMUX
 SG_ SeparationTimeRaw m3 : 23|8@0+ (1,0) [0|255] "raw"  FMUX
 SG_ UnknownData1 m4 : 15|8@0+ (1,0) [0|255] "raw"  FMUX
 SG_ ConsecutiveData1 m2 : 15|8@0+ (1,0) [0|255] "raw"  FMUX
 SG_ SingleData1 m0 : 15|8@0+ (1,0) [0|255] "raw"  FMUX
 SG_ BlockSize m3 : 15|8@0+ (1,0) [0|255] "raw"  FMUX
 SG_ UnknownPciLow m4 : 3|4@0+ (1,0) [0|15] "raw"  FMUX
 SG_ FlowStatus m3 : 3|4@0+ (1,0) [0|15] "raw"  FMUX
 SG_ ConsecutiveSequence m2 : 3|4@0+ (1,0) [0|15] "raw"  FMUX
 SG_ FirstFrameLength m1 : 3|12@0+ (1,0) [0|4095] "raw"  FMUX
 SG_ SingleFrameLength m0 : 3|4@0+ (1,0) [0|15] "raw"  FMUX
 SG_ IsoTpFrameType M : 7|4@0+ (1,0) [0|15] ""  FMUX

BO_ 1848 BSI_DiagRequestToCMB: 8 BSI
 SG_ FlowPadding5 m3 : 63|8@0+ (1,0) [0|255] "raw"  CMB
 SG_ FirstData6 m1 : 63|8@0+ (1,0) [0|255] "raw"  CMB
 SG_ UnknownData7 m4 : 63|8@0+ (1,0) [0|255] "raw"  CMB
 SG_ ConsecutiveData7 m2 : 63|8@0+ (1,0) [0|255] "raw"  CMB
 SG_ SingleData7 m0 : 63|8@0+ (1,0) [0|255] "raw"  CMB
 SG_ FlowPadding4 m3 : 55|8@0+ (1,0) [0|255] "raw"  CMB
 SG_ FirstData5 m1 : 55|8@0+ (1,0) [0|255] "raw"  CMB
 SG_ UnknownData6 m4 : 55|8@0+ (1,0) [0|255] "raw"  CMB
 SG_ ConsecutiveData6 m2 : 55|8@0+ (1,0) [0|255] "raw"  CMB
 SG_ SingleData6 m0 : 55|8@0+ (1,0) [0|255] "raw"  CMB
 SG_ FlowPadding3 m3 : 47|8@0+ (1,0) [0|255] "raw"  CMB
 SG_ FirstData4 m1 : 47|8@0+ (1,0) [0|255] "raw"  CMB
 SG_ UnknownData5 m4 : 47|8@0+ (1,0) [0|255] "raw"  CMB
 SG_ ConsecutiveData5 m2 : 47|8@0+ (1,0) [0|255] "raw"  CMB
 SG_ SingleData5 m0 : 47|8@0+ (1,0) [0|255] "raw"  CMB
 SG_ FlowPadding2 m3 : 39|8@0+ (1,0) [0|255] "raw"  CMB
 SG_ FirstData3 m1 : 39|8@0+ (1,0) [0|255] "raw"  CMB
 SG_ UnknownData4 m4 : 39|8@0+ (1,0) [0|255] "raw"  CMB
 SG_ ConsecutiveData4 m2 : 39|8@0+ (1,0) [0|255] "raw"  CMB
 SG_ SingleData4 m0 : 39|8@0+ (1,0) [0|255] "raw"  CMB
 SG_ FlowPadding1 m3 : 31|8@0+ (1,0) [0|255] "raw"  CMB
 SG_ FirstData2 m1 : 31|8@0+ (1,0) [0|255] "raw"  CMB
 SG_ UnknownData3 m4 : 31|8@0+ (1,0) [0|255] "raw"  CMB
 SG_ ConsecutiveData3 m2 : 31|8@0+ (1,0) [0|255] "raw"  CMB
 SG_ SingleData3 m0 : 31|8@0+ (1,0) [0|255] "raw"  CMB
 SG_ FirstData1 m1 : 23|8@0+ (1,0) [0|255] "raw"  CMB
 SG_ UnknownData2 m4 : 23|8@0+ (1,0) [0|255] "raw"  CMB
 SG_ ConsecutiveData2 m2 : 23|8@0+ (1,0) [0|255] "raw"  CMB
 SG_ SingleData2 m0 : 23|8@0+ (1,0) [0|255] "raw"  CMB
 SG_ SeparationTimeRaw m3 : 23|8@0+ (1,0) [0|255] "raw"  CMB
 SG_ UnknownData1 m4 : 15|8@0+ (1,0) [0|255] "raw"  CMB
 SG_ ConsecutiveData1 m2 : 15|8@0+ (1,0) [0|255] "raw"  CMB
 SG_ SingleData1 m0 : 15|8@0+ (1,0) [0|255] "raw"  CMB
 SG_ BlockSize m3 : 15|8@0+ (1,0) [0|255] "raw"  CMB
 SG_ UnknownPciLow m4 : 3|4@0+ (1,0) [0|15] "raw"  CMB
 SG_ FlowStatus m3 : 3|4@0+ (1,0) [0|15] "raw"  CMB
 SG_ ConsecutiveSequence m2 : 3|4@0+ (1,0) [0|15] "raw"  CMB
 SG_ FirstFrameLength m1 : 3|12@0+ (1,0) [0|4095] "raw"  CMB
 SG_ SingleFrameLength m0 : 3|4@0+ (1,0) [0|15] "raw"  CMB
 SG_ IsoTpFrameType M : 7|4@0+ (1,0) [0|15] ""  CMB

BO_ 1857 MDS_DiagRequestToBSI_2: 8 MDS
 SG_ FlowPadding5 m3 : 63|8@0+ (1,0) [0|255] "raw"  BSI
 SG_ FirstData6 m1 : 63|8@0+ (1,0) [0|255] "raw"  BSI
 SG_ UnknownData7 m4 : 63|8@0+ (1,0) [0|255] "raw"  BSI
 SG_ ConsecutiveData7 m2 : 63|8@0+ (1,0) [0|255] "raw"  BSI
 SG_ SingleData7 m0 : 63|8@0+ (1,0) [0|255] "raw"  BSI
 SG_ FlowPadding4 m3 : 55|8@0+ (1,0) [0|255] "raw"  BSI
 SG_ FirstData5 m1 : 55|8@0+ (1,0) [0|255] "raw"  BSI
 SG_ UnknownData6 m4 : 55|8@0+ (1,0) [0|255] "raw"  BSI
 SG_ ConsecutiveData6 m2 : 55|8@0+ (1,0) [0|255] "raw"  BSI
 SG_ SingleData6 m0 : 55|8@0+ (1,0) [0|255] "raw"  BSI
 SG_ FlowPadding3 m3 : 47|8@0+ (1,0) [0|255] "raw"  BSI
 SG_ FirstData4 m1 : 47|8@0+ (1,0) [0|255] "raw"  BSI
 SG_ UnknownData5 m4 : 47|8@0+ (1,0) [0|255] "raw"  BSI
 SG_ ConsecutiveData5 m2 : 47|8@0+ (1,0) [0|255] "raw"  BSI
 SG_ SingleData5 m0 : 47|8@0+ (1,0) [0|255] "raw"  BSI
 SG_ FlowPadding2 m3 : 39|8@0+ (1,0) [0|255] "raw"  BSI
 SG_ FirstData3 m1 : 39|8@0+ (1,0) [0|255] "raw"  BSI
 SG_ UnknownData4 m4 : 39|8@0+ (1,0) [0|255] "raw"  BSI
 SG_ ConsecutiveData4 m2 : 39|8@0+ (1,0) [0|255] "raw"  BSI
 SG_ SingleData4 m0 : 39|8@0+ (1,0) [0|255] "raw"  BSI
 SG_ FlowPadding1 m3 : 31|8@0+ (1,0) [0|255] "raw"  BSI
 SG_ FirstData2 m1 : 31|8@0+ (1,0) [0|255] "raw"  BSI
 SG_ UnknownData3 m4 : 31|8@0+ (1,0) [0|255] "raw"  BSI
 SG_ ConsecutiveData3 m2 : 31|8@0+ (1,0) [0|255] "raw"  BSI
 SG_ SingleData3 m0 : 31|8@0+ (1,0) [0|255] "raw"  BSI
 SG_ FirstData1 m1 : 23|8@0+ (1,0) [0|255] "raw"  BSI
 SG_ UnknownData2 m4 : 23|8@0+ (1,0) [0|255] "raw"  BSI
 SG_ ConsecutiveData2 m2 : 23|8@0+ (1,0) [0|255] "raw"  BSI
 SG_ SingleData2 m0 : 23|8@0+ (1,0) [0|255] "raw"  BSI
 SG_ SeparationTimeRaw m3 : 23|8@0+ (1,0) [0|255] "raw"  BSI
 SG_ UnknownData1 m4 : 15|8@0+ (1,0) [0|255] "raw"  BSI
 SG_ ConsecutiveData1 m2 : 15|8@0+ (1,0) [0|255] "raw"  BSI
 SG_ SingleData1 m0 : 15|8@0+ (1,0) [0|255] "raw"  BSI
 SG_ BlockSize m3 : 15|8@0+ (1,0) [0|255] "raw"  BSI
 SG_ UnknownPciLow m4 : 3|4@0+ (1,0) [0|15] "raw"  BSI
 SG_ FlowStatus m3 : 3|4@0+ (1,0) [0|15] "raw"  BSI
 SG_ ConsecutiveSequence m2 : 3|4@0+ (1,0) [0|15] "raw"  BSI
 SG_ FirstFrameLength m1 : 3|12@0+ (1,0) [0|4095] "raw"  BSI
 SG_ SingleFrameLength m0 : 3|4@0+ (1,0) [0|15] "raw"  BSI
 SG_ IsoTpFrameType M : 7|4@0+ (1,0) [0|15] ""  BSI

BO_ 1858 MDS_DiagRequestToBSI_3: 8 MDS
 SG_ FlowPadding5 m3 : 63|8@0+ (1,0) [0|255] "raw"  BSI
 SG_ FirstData6 m1 : 63|8@0+ (1,0) [0|255] "raw"  BSI
 SG_ UnknownData7 m4 : 63|8@0+ (1,0) [0|255] "raw"  BSI
 SG_ ConsecutiveData7 m2 : 63|8@0+ (1,0) [0|255] "raw"  BSI
 SG_ SingleData7 m0 : 63|8@0+ (1,0) [0|255] "raw"  BSI
 SG_ FlowPadding4 m3 : 55|8@0+ (1,0) [0|255] "raw"  BSI
 SG_ FirstData5 m1 : 55|8@0+ (1,0) [0|255] "raw"  BSI
 SG_ UnknownData6 m4 : 55|8@0+ (1,0) [0|255] "raw"  BSI
 SG_ ConsecutiveData6 m2 : 55|8@0+ (1,0) [0|255] "raw"  BSI
 SG_ SingleData6 m0 : 55|8@0+ (1,0) [0|255] "raw"  BSI
 SG_ FlowPadding3 m3 : 47|8@0+ (1,0) [0|255] "raw"  BSI
 SG_ FirstData4 m1 : 47|8@0+ (1,0) [0|255] "raw"  BSI
 SG_ UnknownData5 m4 : 47|8@0+ (1,0) [0|255] "raw"  BSI
 SG_ ConsecutiveData5 m2 : 47|8@0+ (1,0) [0|255] "raw"  BSI
 SG_ SingleData5 m0 : 47|8@0+ (1,0) [0|255] "raw"  BSI
 SG_ FlowPadding2 m3 : 39|8@0+ (1,0) [0|255] "raw"  BSI
 SG_ FirstData3 m1 : 39|8@0+ (1,0) [0|255] "raw"  BSI
 SG_ UnknownData4 m4 : 39|8@0+ (1,0) [0|255] "raw"  BSI
 SG_ ConsecutiveData4 m2 : 39|8@0+ (1,0) [0|255] "raw"  BSI
 SG_ SingleData4 m0 : 39|8@0+ (1,0) [0|255] "raw"  BSI
 SG_ FlowPadding1 m3 : 31|8@0+ (1,0) [0|255] "raw"  BSI
 SG_ FirstData2 m1 : 31|8@0+ (1,0) [0|255] "raw"  BSI
 SG_ UnknownData3 m4 : 31|8@0+ (1,0) [0|255] "raw"  BSI
 SG_ ConsecutiveData3 m2 : 31|8@0+ (1,0) [0|255] "raw"  BSI
 SG_ SingleData3 m0 : 31|8@0+ (1,0) [0|255] "raw"  BSI
 SG_ FirstData1 m1 : 23|8@0+ (1,0) [0|255] "raw"  BSI
 SG_ UnknownData2 m4 : 23|8@0+ (1,0) [0|255] "raw"  BSI
 SG_ ConsecutiveData2 m2 : 23|8@0+ (1,0) [0|255] "raw"  BSI
 SG_ SingleData2 m0 : 23|8@0+ (1,0) [0|255] "raw"  BSI
 SG_ SeparationTimeRaw m3 : 23|8@0+ (1,0) [0|255] "raw"  BSI
 SG_ UnknownData1 m4 : 15|8@0+ (1,0) [0|255] "raw"  BSI
 SG_ ConsecutiveData1 m2 : 15|8@0+ (1,0) [0|255] "raw"  BSI
 SG_ SingleData1 m0 : 15|8@0+ (1,0) [0|255] "raw"  BSI
 SG_ BlockSize m3 : 15|8@0+ (1,0) [0|255] "raw"  BSI
 SG_ UnknownPciLow m4 : 3|4@0+ (1,0) [0|15] "raw"  BSI
 SG_ FlowStatus m3 : 3|4@0+ (1,0) [0|15] "raw"  BSI
 SG_ ConsecutiveSequence m2 : 3|4@0+ (1,0) [0|15] "raw"  BSI
 SG_ FirstFrameLength m1 : 3|12@0+ (1,0) [0|4095] "raw"  BSI
 SG_ SingleFrameLength m0 : 3|4@0+ (1,0) [0|15] "raw"  BSI
 SG_ IsoTpFrameType M : 7|4@0+ (1,0) [0|15] ""  BSI

BO_ 1860 MDS_DiagRequestToBSI_4: 8 MDS
 SG_ FlowPadding5 m3 : 63|8@0+ (1,0) [0|255] "raw"  BSI
 SG_ FirstData6 m1 : 63|8@0+ (1,0) [0|255] "raw"  BSI
 SG_ UnknownData7 m4 : 63|8@0+ (1,0) [0|255] "raw"  BSI
 SG_ ConsecutiveData7 m2 : 63|8@0+ (1,0) [0|255] "raw"  BSI
 SG_ SingleData7 m0 : 63|8@0+ (1,0) [0|255] "raw"  BSI
 SG_ FlowPadding4 m3 : 55|8@0+ (1,0) [0|255] "raw"  BSI
 SG_ FirstData5 m1 : 55|8@0+ (1,0) [0|255] "raw"  BSI
 SG_ UnknownData6 m4 : 55|8@0+ (1,0) [0|255] "raw"  BSI
 SG_ ConsecutiveData6 m2 : 55|8@0+ (1,0) [0|255] "raw"  BSI
 SG_ SingleData6 m0 : 55|8@0+ (1,0) [0|255] "raw"  BSI
 SG_ FlowPadding3 m3 : 47|8@0+ (1,0) [0|255] "raw"  BSI
 SG_ FirstData4 m1 : 47|8@0+ (1,0) [0|255] "raw"  BSI
 SG_ UnknownData5 m4 : 47|8@0+ (1,0) [0|255] "raw"  BSI
 SG_ ConsecutiveData5 m2 : 47|8@0+ (1,0) [0|255] "raw"  BSI
 SG_ SingleData5 m0 : 47|8@0+ (1,0) [0|255] "raw"  BSI
 SG_ FlowPadding2 m3 : 39|8@0+ (1,0) [0|255] "raw"  BSI
 SG_ FirstData3 m1 : 39|8@0+ (1,0) [0|255] "raw"  BSI
 SG_ UnknownData4 m4 : 39|8@0+ (1,0) [0|255] "raw"  BSI
 SG_ ConsecutiveData4 m2 : 39|8@0+ (1,0) [0|255] "raw"  BSI
 SG_ SingleData4 m0 : 39|8@0+ (1,0) [0|255] "raw"  BSI
 SG_ FlowPadding1 m3 : 31|8@0+ (1,0) [0|255] "raw"  BSI
 SG_ FirstData2 m1 : 31|8@0+ (1,0) [0|255] "raw"  BSI
 SG_ UnknownData3 m4 : 31|8@0+ (1,0) [0|255] "raw"  BSI
 SG_ ConsecutiveData3 m2 : 31|8@0+ (1,0) [0|255] "raw"  BSI
 SG_ SingleData3 m0 : 31|8@0+ (1,0) [0|255] "raw"  BSI
 SG_ FirstData1 m1 : 23|8@0+ (1,0) [0|255] "raw"  BSI
 SG_ UnknownData2 m4 : 23|8@0+ (1,0) [0|255] "raw"  BSI
 SG_ ConsecutiveData2 m2 : 23|8@0+ (1,0) [0|255] "raw"  BSI
 SG_ SingleData2 m0 : 23|8@0+ (1,0) [0|255] "raw"  BSI
 SG_ SeparationTimeRaw m3 : 23|8@0+ (1,0) [0|255] "raw"  BSI
 SG_ UnknownData1 m4 : 15|8@0+ (1,0) [0|255] "raw"  BSI
 SG_ ConsecutiveData1 m2 : 15|8@0+ (1,0) [0|255] "raw"  BSI
 SG_ SingleData1 m0 : 15|8@0+ (1,0) [0|255] "raw"  BSI
 SG_ BlockSize m3 : 15|8@0+ (1,0) [0|255] "raw"  BSI
 SG_ UnknownPciLow m4 : 3|4@0+ (1,0) [0|15] "raw"  BSI
 SG_ FlowStatus m3 : 3|4@0+ (1,0) [0|15] "raw"  BSI
 SG_ ConsecutiveSequence m2 : 3|4@0+ (1,0) [0|15] "raw"  BSI
 SG_ FirstFrameLength m1 : 3|12@0+ (1,0) [0|4095] "raw"  BSI
 SG_ SingleFrameLength m0 : 3|4@0+ (1,0) [0|15] "raw"  BSI
 SG_ IsoTpFrameType M : 7|4@0+ (1,0) [0|15] ""  BSI

BO_ 1861 MDS_DiagRequestToBSI_5: 8 MDS
 SG_ FlowPadding5 m3 : 63|8@0+ (1,0) [0|255] "raw"  BSI
 SG_ FirstData6 m1 : 63|8@0+ (1,0) [0|255] "raw"  BSI
 SG_ UnknownData7 m4 : 63|8@0+ (1,0) [0|255] "raw"  BSI
 SG_ ConsecutiveData7 m2 : 63|8@0+ (1,0) [0|255] "raw"  BSI
 SG_ SingleData7 m0 : 63|8@0+ (1,0) [0|255] "raw"  BSI
 SG_ FlowPadding4 m3 : 55|8@0+ (1,0) [0|255] "raw"  BSI
 SG_ FirstData5 m1 : 55|8@0+ (1,0) [0|255] "raw"  BSI
 SG_ UnknownData6 m4 : 55|8@0+ (1,0) [0|255] "raw"  BSI
 SG_ ConsecutiveData6 m2 : 55|8@0+ (1,0) [0|255] "raw"  BSI
 SG_ SingleData6 m0 : 55|8@0+ (1,0) [0|255] "raw"  BSI
 SG_ FlowPadding3 m3 : 47|8@0+ (1,0) [0|255] "raw"  BSI
 SG_ FirstData4 m1 : 47|8@0+ (1,0) [0|255] "raw"  BSI
 SG_ UnknownData5 m4 : 47|8@0+ (1,0) [0|255] "raw"  BSI
 SG_ ConsecutiveData5 m2 : 47|8@0+ (1,0) [0|255] "raw"  BSI
 SG_ SingleData5 m0 : 47|8@0+ (1,0) [0|255] "raw"  BSI
 SG_ FlowPadding2 m3 : 39|8@0+ (1,0) [0|255] "raw"  BSI
 SG_ FirstData3 m1 : 39|8@0+ (1,0) [0|255] "raw"  BSI
 SG_ UnknownData4 m4 : 39|8@0+ (1,0) [0|255] "raw"  BSI
 SG_ ConsecutiveData4 m2 : 39|8@0+ (1,0) [0|255] "raw"  BSI
 SG_ SingleData4 m0 : 39|8@0+ (1,0) [0|255] "raw"  BSI
 SG_ FlowPadding1 m3 : 31|8@0+ (1,0) [0|255] "raw"  BSI
 SG_ FirstData2 m1 : 31|8@0+ (1,0) [0|255] "raw"  BSI
 SG_ UnknownData3 m4 : 31|8@0+ (1,0) [0|255] "raw"  BSI
 SG_ ConsecutiveData3 m2 : 31|8@0+ (1,0) [0|255] "raw"  BSI
 SG_ SingleData3 m0 : 31|8@0+ (1,0) [0|255] "raw"  BSI
 SG_ FirstData1 m1 : 23|8@0+ (1,0) [0|255] "raw"  BSI
 SG_ UnknownData2 m4 : 23|8@0+ (1,0) [0|255] "raw"  BSI
 SG_ ConsecutiveData2 m2 : 23|8@0+ (1,0) [0|255] "raw"  BSI
 SG_ SingleData2 m0 : 23|8@0+ (1,0) [0|255] "raw"  BSI
 SG_ SeparationTimeRaw m3 : 23|8@0+ (1,0) [0|255] "raw"  BSI
 SG_ UnknownData1 m4 : 15|8@0+ (1,0) [0|255] "raw"  BSI
 SG_ ConsecutiveData1 m2 : 15|8@0+ (1,0) [0|255] "raw"  BSI
 SG_ SingleData1 m0 : 15|8@0+ (1,0) [0|255] "raw"  BSI
 SG_ BlockSize m3 : 15|8@0+ (1,0) [0|255] "raw"  BSI
 SG_ UnknownPciLow m4 : 3|4@0+ (1,0) [0|15] "raw"  BSI
 SG_ FlowStatus m3 : 3|4@0+ (1,0) [0|15] "raw"  BSI
 SG_ ConsecutiveSequence m2 : 3|4@0+ (1,0) [0|15] "raw"  BSI
 SG_ FirstFrameLength m1 : 3|12@0+ (1,0) [0|4095] "raw"  BSI
 SG_ SingleFrameLength m0 : 3|4@0+ (1,0) [0|15] "raw"  BSI
 SG_ IsoTpFrameType M : 7|4@0+ (1,0) [0|15] ""  BSI

BO_TX_BU_ 1846 : BSI,MDS;
BO_TX_BU_ 1848 : BSI,MDS;
CM_ BO_ 1646 "DATABASE_CANDIDATE: physical interpretation unverified; capture/layout evidence reported separately. INFO-DIV CAN, 125000 bit/s; CAN ID 0x66E. PSA-RE title: BDMC_DIAG_RESPONSE. Diagnostic response sent by the BDMC ECU. Source: https://github.com/prototux/PSA-RE/blob/67f7581e7622410efdbb29c7eda3b86982b9b450/buses/AEE2010.full/LS.INFO-DIV/66E.yml. Source sender alternatives: BSI; physical TX/gateway forwarding not verified. WIRE ISO-TP ONLY: normal addressing candidate, maximum Classical CAN DLC 8; actual DLC may be shorter. Data includes padding. No reassembly, text, DID or application-layer decoding. Original application layouts are preserved in source JSON; do not decode them at wire offsets. ";
CM_ SG_ 1646 FlowPadding5 "TRANSPORT_CANDIDATE: normal-addressing ISO-TP. PSA-RE bits 8.7-8.0. ";
CM_ SG_ 1646 FirstData6 "TRANSPORT_CANDIDATE: normal-addressing ISO-TP. PSA-RE bits 8.7-8.0. ";
CM_ SG_ 1646 UnknownData7 "TRANSPORT_CANDIDATE: normal-addressing ISO-TP. PSA-RE bits 8.7-8.0. ";
CM_ SG_ 1646 ConsecutiveData7 "TRANSPORT_CANDIDATE: normal-addressing ISO-TP. PSA-RE bits 8.7-8.0. ";
CM_ SG_ 1646 SingleData7 "TRANSPORT_CANDIDATE: normal-addressing ISO-TP. PSA-RE bits 8.7-8.0. ";
CM_ SG_ 1646 FlowPadding4 "TRANSPORT_CANDIDATE: normal-addressing ISO-TP. PSA-RE bits 7.7-7.0. ";
CM_ SG_ 1646 FirstData5 "TRANSPORT_CANDIDATE: normal-addressing ISO-TP. PSA-RE bits 7.7-7.0. ";
CM_ SG_ 1646 UnknownData6 "TRANSPORT_CANDIDATE: normal-addressing ISO-TP. PSA-RE bits 7.7-7.0. ";
CM_ SG_ 1646 ConsecutiveData6 "TRANSPORT_CANDIDATE: normal-addressing ISO-TP. PSA-RE bits 7.7-7.0. ";
CM_ SG_ 1646 SingleData6 "TRANSPORT_CANDIDATE: normal-addressing ISO-TP. PSA-RE bits 7.7-7.0. ";
CM_ SG_ 1646 FlowPadding3 "TRANSPORT_CANDIDATE: normal-addressing ISO-TP. PSA-RE bits 6.7-6.0. ";
CM_ SG_ 1646 FirstData4 "TRANSPORT_CANDIDATE: normal-addressing ISO-TP. PSA-RE bits 6.7-6.0. ";
CM_ SG_ 1646 UnknownData5 "TRANSPORT_CANDIDATE: normal-addressing ISO-TP. PSA-RE bits 6.7-6.0. ";
CM_ SG_ 1646 ConsecutiveData5 "TRANSPORT_CANDIDATE: normal-addressing ISO-TP. PSA-RE bits 6.7-6.0. ";
CM_ SG_ 1646 SingleData5 "TRANSPORT_CANDIDATE: normal-addressing ISO-TP. PSA-RE bits 6.7-6.0. ";
CM_ SG_ 1646 FlowPadding2 "TRANSPORT_CANDIDATE: normal-addressing ISO-TP. PSA-RE bits 5.7-5.0. ";
CM_ SG_ 1646 FirstData3 "TRANSPORT_CANDIDATE: normal-addressing ISO-TP. PSA-RE bits 5.7-5.0. ";
CM_ SG_ 1646 UnknownData4 "TRANSPORT_CANDIDATE: normal-addressing ISO-TP. PSA-RE bits 5.7-5.0. ";
CM_ SG_ 1646 ConsecutiveData4 "TRANSPORT_CANDIDATE: normal-addressing ISO-TP. PSA-RE bits 5.7-5.0. ";
CM_ SG_ 1646 SingleData4 "TRANSPORT_CANDIDATE: normal-addressing ISO-TP. PSA-RE bits 5.7-5.0. ";
CM_ SG_ 1646 FlowPadding1 "TRANSPORT_CANDIDATE: normal-addressing ISO-TP. PSA-RE bits 4.7-4.0. ";
CM_ SG_ 1646 FirstData2 "TRANSPORT_CANDIDATE: normal-addressing ISO-TP. PSA-RE bits 4.7-4.0. ";
CM_ SG_ 1646 UnknownData3 "TRANSPORT_CANDIDATE: normal-addressing ISO-TP. PSA-RE bits 4.7-4.0. ";
CM_ SG_ 1646 ConsecutiveData3 "TRANSPORT_CANDIDATE: normal-addressing ISO-TP. PSA-RE bits 4.7-4.0. ";
CM_ SG_ 1646 SingleData3 "TRANSPORT_CANDIDATE: normal-addressing ISO-TP. PSA-RE bits 4.7-4.0. ";
CM_ SG_ 1646 FirstData1 "TRANSPORT_CANDIDATE: normal-addressing ISO-TP. PSA-RE bits 3.7-3.0. ";
CM_ SG_ 1646 UnknownData2 "TRANSPORT_CANDIDATE: normal-addressing ISO-TP. PSA-RE bits 3.7-3.0. ";
CM_ SG_ 1646 ConsecutiveData2 "TRANSPORT_CANDIDATE: normal-addressing ISO-TP. PSA-RE bits 3.7-3.0. ";
CM_ SG_ 1646 SingleData2 "TRANSPORT_CANDIDATE: normal-addressing ISO-TP. PSA-RE bits 3.7-3.0. ";
CM_ SG_ 1646 SeparationTimeRaw "TRANSPORT_CANDIDATE: normal-addressing ISO-TP. PSA-RE bits 3.7-3.0. Raw STmin code; 0xF1..0xF9 are not milliseconds.";
CM_ SG_ 1646 UnknownData1 "TRANSPORT_CANDIDATE: normal-addressing ISO-TP. PSA-RE bits 2.7-2.0. ";
CM_ SG_ 1646 ConsecutiveData1 "TRANSPORT_CANDIDATE: normal-addressing ISO-TP. PSA-RE bits 2.7-2.0. ";
CM_ SG_ 1646 SingleData1 "TRANSPORT_CANDIDATE: normal-addressing ISO-TP. PSA-RE bits 2.7-2.0. ";
CM_ SG_ 1646 BlockSize "TRANSPORT_CANDIDATE: normal-addressing ISO-TP. PSA-RE bits 2.7-2.0. ";
CM_ SG_ 1646 UnknownPciLow "TRANSPORT_CANDIDATE: normal-addressing ISO-TP. PSA-RE bits 1.3-1.0. ";
CM_ SG_ 1646 FlowStatus "TRANSPORT_CANDIDATE: normal-addressing ISO-TP. PSA-RE bits 1.3-1.0. ";
CM_ SG_ 1646 ConsecutiveSequence "TRANSPORT_CANDIDATE: normal-addressing ISO-TP. PSA-RE bits 1.3-1.0. ";
CM_ SG_ 1646 FirstFrameLength "TRANSPORT_CANDIDATE: normal-addressing ISO-TP. PSA-RE bits 1.3-2.0. 12-bit declared PDU length; not a reassembled value.";
CM_ SG_ 1646 SingleFrameLength "TRANSPORT_CANDIDATE: normal-addressing ISO-TP. PSA-RE bits 1.3-1.0. Declared data length; not a validity check.";
CM_ SG_ 1646 IsoTpFrameType "TRANSPORT_CANDIDATE: normal-addressing ISO-TP. PSA-RE bits 1.7-1.4. PCI high nibble; normal addressing candidate.";
CM_ BO_ 1647 "DATABASE_CANDIDATE: physical interpretation unverified; capture/layout evidence reported separately. INFO-DIV CAN, 125000 bit/s; CAN ID 0x66F. PSA-RE title: BDMP_DIAG_RESPONSE. Diagnostic response sent by the BDMP ECU. Source: https://github.com/prototux/PSA-RE/blob/67f7581e7622410efdbb29c7eda3b86982b9b450/buses/AEE2010.full/LS.INFO-DIV/66F.yml. Source sender alternatives: BSI; physical TX/gateway forwarding not verified. WIRE ISO-TP ONLY: normal addressing candidate, maximum Classical CAN DLC 8; actual DLC may be shorter. Data includes padding. No reassembly, text, DID or application-layer decoding. Original application layouts are preserved in source JSON; do not decode them at wire offsets. ";
CM_ SG_ 1647 FlowPadding5 "TRANSPORT_CANDIDATE: normal-addressing ISO-TP. PSA-RE bits 8.7-8.0. ";
CM_ SG_ 1647 FirstData6 "TRANSPORT_CANDIDATE: normal-addressing ISO-TP. PSA-RE bits 8.7-8.0. ";
CM_ SG_ 1647 UnknownData7 "TRANSPORT_CANDIDATE: normal-addressing ISO-TP. PSA-RE bits 8.7-8.0. ";
CM_ SG_ 1647 ConsecutiveData7 "TRANSPORT_CANDIDATE: normal-addressing ISO-TP. PSA-RE bits 8.7-8.0. ";
CM_ SG_ 1647 SingleData7 "TRANSPORT_CANDIDATE: normal-addressing ISO-TP. PSA-RE bits 8.7-8.0. ";
CM_ SG_ 1647 FlowPadding4 "TRANSPORT_CANDIDATE: normal-addressing ISO-TP. PSA-RE bits 7.7-7.0. ";
CM_ SG_ 1647 FirstData5 "TRANSPORT_CANDIDATE: normal-addressing ISO-TP. PSA-RE bits 7.7-7.0. ";
CM_ SG_ 1647 UnknownData6 "TRANSPORT_CANDIDATE: normal-addressing ISO-TP. PSA-RE bits 7.7-7.0. ";
CM_ SG_ 1647 ConsecutiveData6 "TRANSPORT_CANDIDATE: normal-addressing ISO-TP. PSA-RE bits 7.7-7.0. ";
CM_ SG_ 1647 SingleData6 "TRANSPORT_CANDIDATE: normal-addressing ISO-TP. PSA-RE bits 7.7-7.0. ";
CM_ SG_ 1647 FlowPadding3 "TRANSPORT_CANDIDATE: normal-addressing ISO-TP. PSA-RE bits 6.7-6.0. ";
CM_ SG_ 1647 FirstData4 "TRANSPORT_CANDIDATE: normal-addressing ISO-TP. PSA-RE bits 6.7-6.0. ";
CM_ SG_ 1647 UnknownData5 "TRANSPORT_CANDIDATE: normal-addressing ISO-TP. PSA-RE bits 6.7-6.0. ";
CM_ SG_ 1647 ConsecutiveData5 "TRANSPORT_CANDIDATE: normal-addressing ISO-TP. PSA-RE bits 6.7-6.0. ";
CM_ SG_ 1647 SingleData5 "TRANSPORT_CANDIDATE: normal-addressing ISO-TP. PSA-RE bits 6.7-6.0. ";
CM_ SG_ 1647 FlowPadding2 "TRANSPORT_CANDIDATE: normal-addressing ISO-TP. PSA-RE bits 5.7-5.0. ";
CM_ SG_ 1647 FirstData3 "TRANSPORT_CANDIDATE: normal-addressing ISO-TP. PSA-RE bits 5.7-5.0. ";
CM_ SG_ 1647 UnknownData4 "TRANSPORT_CANDIDATE: normal-addressing ISO-TP. PSA-RE bits 5.7-5.0. ";
CM_ SG_ 1647 ConsecutiveData4 "TRANSPORT_CANDIDATE: normal-addressing ISO-TP. PSA-RE bits 5.7-5.0. ";
CM_ SG_ 1647 SingleData4 "TRANSPORT_CANDIDATE: normal-addressing ISO-TP. PSA-RE bits 5.7-5.0. ";
CM_ SG_ 1647 FlowPadding1 "TRANSPORT_CANDIDATE: normal-addressing ISO-TP. PSA-RE bits 4.7-4.0. ";
CM_ SG_ 1647 FirstData2 "TRANSPORT_CANDIDATE: normal-addressing ISO-TP. PSA-RE bits 4.7-4.0. ";
CM_ SG_ 1647 UnknownData3 "TRANSPORT_CANDIDATE: normal-addressing ISO-TP. PSA-RE bits 4.7-4.0. ";
CM_ SG_ 1647 ConsecutiveData3 "TRANSPORT_CANDIDATE: normal-addressing ISO-TP. PSA-RE bits 4.7-4.0. ";
CM_ SG_ 1647 SingleData3 "TRANSPORT_CANDIDATE: normal-addressing ISO-TP. PSA-RE bits 4.7-4.0. ";
CM_ SG_ 1647 FirstData1 "TRANSPORT_CANDIDATE: normal-addressing ISO-TP. PSA-RE bits 3.7-3.0. ";
CM_ SG_ 1647 UnknownData2 "TRANSPORT_CANDIDATE: normal-addressing ISO-TP. PSA-RE bits 3.7-3.0. ";
CM_ SG_ 1647 ConsecutiveData2 "TRANSPORT_CANDIDATE: normal-addressing ISO-TP. PSA-RE bits 3.7-3.0. ";
CM_ SG_ 1647 SingleData2 "TRANSPORT_CANDIDATE: normal-addressing ISO-TP. PSA-RE bits 3.7-3.0. ";
CM_ SG_ 1647 SeparationTimeRaw "TRANSPORT_CANDIDATE: normal-addressing ISO-TP. PSA-RE bits 3.7-3.0. Raw STmin code; 0xF1..0xF9 are not milliseconds.";
CM_ SG_ 1647 UnknownData1 "TRANSPORT_CANDIDATE: normal-addressing ISO-TP. PSA-RE bits 2.7-2.0. ";
CM_ SG_ 1647 ConsecutiveData1 "TRANSPORT_CANDIDATE: normal-addressing ISO-TP. PSA-RE bits 2.7-2.0. ";
CM_ SG_ 1647 SingleData1 "TRANSPORT_CANDIDATE: normal-addressing ISO-TP. PSA-RE bits 2.7-2.0. ";
CM_ SG_ 1647 BlockSize "TRANSPORT_CANDIDATE: normal-addressing ISO-TP. PSA-RE bits 2.7-2.0. ";
CM_ SG_ 1647 UnknownPciLow "TRANSPORT_CANDIDATE: normal-addressing ISO-TP. PSA-RE bits 1.3-1.0. ";
CM_ SG_ 1647 FlowStatus "TRANSPORT_CANDIDATE: normal-addressing ISO-TP. PSA-RE bits 1.3-1.0. ";
CM_ SG_ 1647 ConsecutiveSequence "TRANSPORT_CANDIDATE: normal-addressing ISO-TP. PSA-RE bits 1.3-1.0. ";
CM_ SG_ 1647 FirstFrameLength "TRANSPORT_CANDIDATE: normal-addressing ISO-TP. PSA-RE bits 1.3-2.0. 12-bit declared PDU length; not a reassembled value.";
CM_ SG_ 1647 SingleFrameLength "TRANSPORT_CANDIDATE: normal-addressing ISO-TP. PSA-RE bits 1.3-1.0. Declared data length; not a validity check.";
CM_ SG_ 1647 IsoTpFrameType "TRANSPORT_CANDIDATE: normal-addressing ISO-TP. PSA-RE bits 1.7-1.4. PCI high nibble; normal addressing candidate.";
CM_ BO_ 1648 "DATABASE_CANDIDATE: physical interpretation unverified; capture/layout evidence reported separately. INFO-DIV CAN, 125000 bit/s; CAN ID 0x670. PSA-RE title: VTH_DIAG_RESPONSE. Diagnostic response sent by the HUD ECU. Source: https://github.com/prototux/PSA-RE/blob/67f7581e7622410efdbb29c7eda3b86982b9b450/buses/AEE2010.full/LS.INFO-DIV/670.yml. Source sender alternatives: VTH; physical TX/gateway forwarding not verified. WIRE ISO-TP ONLY: normal addressing candidate, maximum Classical CAN DLC 8; actual DLC may be shorter. Data includes padding. No reassembly, text, DID or application-layer decoding. Original application layouts are preserved in source JSON; do not decode them at wire offsets. ";
CM_ SG_ 1648 FlowPadding5 "TRANSPORT_CANDIDATE: normal-addressing ISO-TP. PSA-RE bits 8.7-8.0. ";
CM_ SG_ 1648 FirstData6 "TRANSPORT_CANDIDATE: normal-addressing ISO-TP. PSA-RE bits 8.7-8.0. ";
CM_ SG_ 1648 UnknownData7 "TRANSPORT_CANDIDATE: normal-addressing ISO-TP. PSA-RE bits 8.7-8.0. ";
CM_ SG_ 1648 ConsecutiveData7 "TRANSPORT_CANDIDATE: normal-addressing ISO-TP. PSA-RE bits 8.7-8.0. ";
CM_ SG_ 1648 SingleData7 "TRANSPORT_CANDIDATE: normal-addressing ISO-TP. PSA-RE bits 8.7-8.0. ";
CM_ SG_ 1648 FlowPadding4 "TRANSPORT_CANDIDATE: normal-addressing ISO-TP. PSA-RE bits 7.7-7.0. ";
CM_ SG_ 1648 FirstData5 "TRANSPORT_CANDIDATE: normal-addressing ISO-TP. PSA-RE bits 7.7-7.0. ";
CM_ SG_ 1648 UnknownData6 "TRANSPORT_CANDIDATE: normal-addressing ISO-TP. PSA-RE bits 7.7-7.0. ";
CM_ SG_ 1648 ConsecutiveData6 "TRANSPORT_CANDIDATE: normal-addressing ISO-TP. PSA-RE bits 7.7-7.0. ";
CM_ SG_ 1648 SingleData6 "TRANSPORT_CANDIDATE: normal-addressing ISO-TP. PSA-RE bits 7.7-7.0. ";
CM_ SG_ 1648 FlowPadding3 "TRANSPORT_CANDIDATE: normal-addressing ISO-TP. PSA-RE bits 6.7-6.0. ";
CM_ SG_ 1648 FirstData4 "TRANSPORT_CANDIDATE: normal-addressing ISO-TP. PSA-RE bits 6.7-6.0. ";
CM_ SG_ 1648 UnknownData5 "TRANSPORT_CANDIDATE: normal-addressing ISO-TP. PSA-RE bits 6.7-6.0. ";
CM_ SG_ 1648 ConsecutiveData5 "TRANSPORT_CANDIDATE: normal-addressing ISO-TP. PSA-RE bits 6.7-6.0. ";
CM_ SG_ 1648 SingleData5 "TRANSPORT_CANDIDATE: normal-addressing ISO-TP. PSA-RE bits 6.7-6.0. ";
CM_ SG_ 1648 FlowPadding2 "TRANSPORT_CANDIDATE: normal-addressing ISO-TP. PSA-RE bits 5.7-5.0. ";
CM_ SG_ 1648 FirstData3 "TRANSPORT_CANDIDATE: normal-addressing ISO-TP. PSA-RE bits 5.7-5.0. ";
CM_ SG_ 1648 UnknownData4 "TRANSPORT_CANDIDATE: normal-addressing ISO-TP. PSA-RE bits 5.7-5.0. ";
CM_ SG_ 1648 ConsecutiveData4 "TRANSPORT_CANDIDATE: normal-addressing ISO-TP. PSA-RE bits 5.7-5.0. ";
CM_ SG_ 1648 SingleData4 "TRANSPORT_CANDIDATE: normal-addressing ISO-TP. PSA-RE bits 5.7-5.0. ";
CM_ SG_ 1648 FlowPadding1 "TRANSPORT_CANDIDATE: normal-addressing ISO-TP. PSA-RE bits 4.7-4.0. ";
CM_ SG_ 1648 FirstData2 "TRANSPORT_CANDIDATE: normal-addressing ISO-TP. PSA-RE bits 4.7-4.0. ";
CM_ SG_ 1648 UnknownData3 "TRANSPORT_CANDIDATE: normal-addressing ISO-TP. PSA-RE bits 4.7-4.0. ";
CM_ SG_ 1648 ConsecutiveData3 "TRANSPORT_CANDIDATE: normal-addressing ISO-TP. PSA-RE bits 4.7-4.0. ";
CM_ SG_ 1648 SingleData3 "TRANSPORT_CANDIDATE: normal-addressing ISO-TP. PSA-RE bits 4.7-4.0. ";
CM_ SG_ 1648 FirstData1 "TRANSPORT_CANDIDATE: normal-addressing ISO-TP. PSA-RE bits 3.7-3.0. ";
CM_ SG_ 1648 UnknownData2 "TRANSPORT_CANDIDATE: normal-addressing ISO-TP. PSA-RE bits 3.7-3.0. ";
CM_ SG_ 1648 ConsecutiveData2 "TRANSPORT_CANDIDATE: normal-addressing ISO-TP. PSA-RE bits 3.7-3.0. ";
CM_ SG_ 1648 SingleData2 "TRANSPORT_CANDIDATE: normal-addressing ISO-TP. PSA-RE bits 3.7-3.0. ";
CM_ SG_ 1648 SeparationTimeRaw "TRANSPORT_CANDIDATE: normal-addressing ISO-TP. PSA-RE bits 3.7-3.0. Raw STmin code; 0xF1..0xF9 are not milliseconds.";
CM_ SG_ 1648 UnknownData1 "TRANSPORT_CANDIDATE: normal-addressing ISO-TP. PSA-RE bits 2.7-2.0. ";
CM_ SG_ 1648 ConsecutiveData1 "TRANSPORT_CANDIDATE: normal-addressing ISO-TP. PSA-RE bits 2.7-2.0. ";
CM_ SG_ 1648 SingleData1 "TRANSPORT_CANDIDATE: normal-addressing ISO-TP. PSA-RE bits 2.7-2.0. ";
CM_ SG_ 1648 BlockSize "TRANSPORT_CANDIDATE: normal-addressing ISO-TP. PSA-RE bits 2.7-2.0. ";
CM_ SG_ 1648 UnknownPciLow "TRANSPORT_CANDIDATE: normal-addressing ISO-TP. PSA-RE bits 1.3-1.0. ";
CM_ SG_ 1648 FlowStatus "TRANSPORT_CANDIDATE: normal-addressing ISO-TP. PSA-RE bits 1.3-1.0. ";
CM_ SG_ 1648 ConsecutiveSequence "TRANSPORT_CANDIDATE: normal-addressing ISO-TP. PSA-RE bits 1.3-1.0. ";
CM_ SG_ 1648 FirstFrameLength "TRANSPORT_CANDIDATE: normal-addressing ISO-TP. PSA-RE bits 1.3-2.0. 12-bit declared PDU length; not a reassembled value.";
CM_ SG_ 1648 SingleFrameLength "TRANSPORT_CANDIDATE: normal-addressing ISO-TP. PSA-RE bits 1.3-1.0. Declared data length; not a validity check.";
CM_ SG_ 1648 IsoTpFrameType "TRANSPORT_CANDIDATE: normal-addressing ISO-TP. PSA-RE bits 1.7-1.4. PCI high nibble; normal addressing candidate.";
CM_ BO_ 1649 "DATABASE_CANDIDATE: physical interpretation unverified; capture/layout evidence reported separately. INFO-DIV CAN, 125000 bit/s; CAN ID 0x671. PSA-RE title: DIAG_RESPONSE. Diagnostic response frame sent on the bus. Source: https://github.com/prototux/PSA-RE/blob/67f7581e7622410efdbb29c7eda3b86982b9b450/buses/AEE2010.full/LS.INFO-DIV/671.yml. Source sender alternatives: CDC; physical TX/gateway forwarding not verified. WIRE ISO-TP ONLY: normal addressing candidate, maximum Classical CAN DLC 8; actual DLC may be shorter. Data includes padding. No reassembly, text, DID or application-layer decoding. Original application layouts are preserved in source JSON; do not decode them at wire offsets. ";
CM_ SG_ 1649 FlowPadding5 "TRANSPORT_CANDIDATE: normal-addressing ISO-TP. PSA-RE bits 8.7-8.0. ";
CM_ SG_ 1649 FirstData6 "TRANSPORT_CANDIDATE: normal-addressing ISO-TP. PSA-RE bits 8.7-8.0. ";
CM_ SG_ 1649 UnknownData7 "TRANSPORT_CANDIDATE: normal-addressing ISO-TP. PSA-RE bits 8.7-8.0. ";
CM_ SG_ 1649 ConsecutiveData7 "TRANSPORT_CANDIDATE: normal-addressing ISO-TP. PSA-RE bits 8.7-8.0. ";
CM_ SG_ 1649 SingleData7 "TRANSPORT_CANDIDATE: normal-addressing ISO-TP. PSA-RE bits 8.7-8.0. ";
CM_ SG_ 1649 FlowPadding4 "TRANSPORT_CANDIDATE: normal-addressing ISO-TP. PSA-RE bits 7.7-7.0. ";
CM_ SG_ 1649 FirstData5 "TRANSPORT_CANDIDATE: normal-addressing ISO-TP. PSA-RE bits 7.7-7.0. ";
CM_ SG_ 1649 UnknownData6 "TRANSPORT_CANDIDATE: normal-addressing ISO-TP. PSA-RE bits 7.7-7.0. ";
CM_ SG_ 1649 ConsecutiveData6 "TRANSPORT_CANDIDATE: normal-addressing ISO-TP. PSA-RE bits 7.7-7.0. ";
CM_ SG_ 1649 SingleData6 "TRANSPORT_CANDIDATE: normal-addressing ISO-TP. PSA-RE bits 7.7-7.0. ";
CM_ SG_ 1649 FlowPadding3 "TRANSPORT_CANDIDATE: normal-addressing ISO-TP. PSA-RE bits 6.7-6.0. ";
CM_ SG_ 1649 FirstData4 "TRANSPORT_CANDIDATE: normal-addressing ISO-TP. PSA-RE bits 6.7-6.0. ";
CM_ SG_ 1649 UnknownData5 "TRANSPORT_CANDIDATE: normal-addressing ISO-TP. PSA-RE bits 6.7-6.0. ";
CM_ SG_ 1649 ConsecutiveData5 "TRANSPORT_CANDIDATE: normal-addressing ISO-TP. PSA-RE bits 6.7-6.0. ";
CM_ SG_ 1649 SingleData5 "TRANSPORT_CANDIDATE: normal-addressing ISO-TP. PSA-RE bits 6.7-6.0. ";
CM_ SG_ 1649 FlowPadding2 "TRANSPORT_CANDIDATE: normal-addressing ISO-TP. PSA-RE bits 5.7-5.0. ";
CM_ SG_ 1649 FirstData3 "TRANSPORT_CANDIDATE: normal-addressing ISO-TP. PSA-RE bits 5.7-5.0. ";
CM_ SG_ 1649 UnknownData4 "TRANSPORT_CANDIDATE: normal-addressing ISO-TP. PSA-RE bits 5.7-5.0. ";
CM_ SG_ 1649 ConsecutiveData4 "TRANSPORT_CANDIDATE: normal-addressing ISO-TP. PSA-RE bits 5.7-5.0. ";
CM_ SG_ 1649 SingleData4 "TRANSPORT_CANDIDATE: normal-addressing ISO-TP. PSA-RE bits 5.7-5.0. ";
CM_ SG_ 1649 FlowPadding1 "TRANSPORT_CANDIDATE: normal-addressing ISO-TP. PSA-RE bits 4.7-4.0. ";
CM_ SG_ 1649 FirstData2 "TRANSPORT_CANDIDATE: normal-addressing ISO-TP. PSA-RE bits 4.7-4.0. ";
CM_ SG_ 1649 UnknownData3 "TRANSPORT_CANDIDATE: normal-addressing ISO-TP. PSA-RE bits 4.7-4.0. ";
CM_ SG_ 1649 ConsecutiveData3 "TRANSPORT_CANDIDATE: normal-addressing ISO-TP. PSA-RE bits 4.7-4.0. ";
CM_ SG_ 1649 SingleData3 "TRANSPORT_CANDIDATE: normal-addressing ISO-TP. PSA-RE bits 4.7-4.0. ";
CM_ SG_ 1649 FirstData1 "TRANSPORT_CANDIDATE: normal-addressing ISO-TP. PSA-RE bits 3.7-3.0. ";
CM_ SG_ 1649 UnknownData2 "TRANSPORT_CANDIDATE: normal-addressing ISO-TP. PSA-RE bits 3.7-3.0. ";
CM_ SG_ 1649 ConsecutiveData2 "TRANSPORT_CANDIDATE: normal-addressing ISO-TP. PSA-RE bits 3.7-3.0. ";
CM_ SG_ 1649 SingleData2 "TRANSPORT_CANDIDATE: normal-addressing ISO-TP. PSA-RE bits 3.7-3.0. ";
CM_ SG_ 1649 SeparationTimeRaw "TRANSPORT_CANDIDATE: normal-addressing ISO-TP. PSA-RE bits 3.7-3.0. Raw STmin code; 0xF1..0xF9 are not milliseconds.";
CM_ SG_ 1649 UnknownData1 "TRANSPORT_CANDIDATE: normal-addressing ISO-TP. PSA-RE bits 2.7-2.0. ";
CM_ SG_ 1649 ConsecutiveData1 "TRANSPORT_CANDIDATE: normal-addressing ISO-TP. PSA-RE bits 2.7-2.0. ";
CM_ SG_ 1649 SingleData1 "TRANSPORT_CANDIDATE: normal-addressing ISO-TP. PSA-RE bits 2.7-2.0. ";
CM_ SG_ 1649 BlockSize "TRANSPORT_CANDIDATE: normal-addressing ISO-TP. PSA-RE bits 2.7-2.0. ";
CM_ SG_ 1649 UnknownPciLow "TRANSPORT_CANDIDATE: normal-addressing ISO-TP. PSA-RE bits 1.3-1.0. ";
CM_ SG_ 1649 FlowStatus "TRANSPORT_CANDIDATE: normal-addressing ISO-TP. PSA-RE bits 1.3-1.0. ";
CM_ SG_ 1649 ConsecutiveSequence "TRANSPORT_CANDIDATE: normal-addressing ISO-TP. PSA-RE bits 1.3-1.0. ";
CM_ SG_ 1649 FirstFrameLength "TRANSPORT_CANDIDATE: normal-addressing ISO-TP. PSA-RE bits 1.3-2.0. 12-bit declared PDU length; not a reassembled value.";
CM_ SG_ 1649 SingleFrameLength "TRANSPORT_CANDIDATE: normal-addressing ISO-TP. PSA-RE bits 1.3-1.0. Declared data length; not a validity check.";
CM_ SG_ 1649 IsoTpFrameType "TRANSPORT_CANDIDATE: normal-addressing ISO-TP. PSA-RE bits 1.7-1.4. PCI high nibble; normal addressing candidate.";
CM_ BO_ 1650 "DATABASE_CANDIDATE: physical interpretation unverified; capture/layout evidence reported separately. INFO-DIV CAN, 125000 bit/s; CAN ID 0x672. PSA-RE title: MATT_DIAG_RESPONSE. Diagnostic response sent by the MATT ECU. Source: https://github.com/prototux/PSA-RE/blob/67f7581e7622410efdbb29c7eda3b86982b9b450/buses/AEE2010.full/LS.INFO-DIV/672.yml. Source sender alternatives: MATT; physical TX/gateway forwarding not verified. WIRE ISO-TP ONLY: normal addressing candidate, maximum Classical CAN DLC 8; actual DLC may be shorter. Data includes padding. No reassembly, text, DID or application-layer decoding. Original application layouts are preserved in source JSON; do not decode them at wire offsets. ";
CM_ SG_ 1650 FlowPadding5 "TRANSPORT_CANDIDATE: normal-addressing ISO-TP. PSA-RE bits 8.7-8.0. ";
CM_ SG_ 1650 FirstData6 "TRANSPORT_CANDIDATE: normal-addressing ISO-TP. PSA-RE bits 8.7-8.0. ";
CM_ SG_ 1650 UnknownData7 "TRANSPORT_CANDIDATE: normal-addressing ISO-TP. PSA-RE bits 8.7-8.0. ";
CM_ SG_ 1650 ConsecutiveData7 "TRANSPORT_CANDIDATE: normal-addressing ISO-TP. PSA-RE bits 8.7-8.0. ";
CM_ SG_ 1650 SingleData7 "TRANSPORT_CANDIDATE: normal-addressing ISO-TP. PSA-RE bits 8.7-8.0. ";
CM_ SG_ 1650 FlowPadding4 "TRANSPORT_CANDIDATE: normal-addressing ISO-TP. PSA-RE bits 7.7-7.0. ";
CM_ SG_ 1650 FirstData5 "TRANSPORT_CANDIDATE: normal-addressing ISO-TP. PSA-RE bits 7.7-7.0. ";
CM_ SG_ 1650 UnknownData6 "TRANSPORT_CANDIDATE: normal-addressing ISO-TP. PSA-RE bits 7.7-7.0. ";
CM_ SG_ 1650 ConsecutiveData6 "TRANSPORT_CANDIDATE: normal-addressing ISO-TP. PSA-RE bits 7.7-7.0. ";
CM_ SG_ 1650 SingleData6 "TRANSPORT_CANDIDATE: normal-addressing ISO-TP. PSA-RE bits 7.7-7.0. ";
CM_ SG_ 1650 FlowPadding3 "TRANSPORT_CANDIDATE: normal-addressing ISO-TP. PSA-RE bits 6.7-6.0. ";
CM_ SG_ 1650 FirstData4 "TRANSPORT_CANDIDATE: normal-addressing ISO-TP. PSA-RE bits 6.7-6.0. ";
CM_ SG_ 1650 UnknownData5 "TRANSPORT_CANDIDATE: normal-addressing ISO-TP. PSA-RE bits 6.7-6.0. ";
CM_ SG_ 1650 ConsecutiveData5 "TRANSPORT_CANDIDATE: normal-addressing ISO-TP. PSA-RE bits 6.7-6.0. ";
CM_ SG_ 1650 SingleData5 "TRANSPORT_CANDIDATE: normal-addressing ISO-TP. PSA-RE bits 6.7-6.0. ";
CM_ SG_ 1650 FlowPadding2 "TRANSPORT_CANDIDATE: normal-addressing ISO-TP. PSA-RE bits 5.7-5.0. ";
CM_ SG_ 1650 FirstData3 "TRANSPORT_CANDIDATE: normal-addressing ISO-TP. PSA-RE bits 5.7-5.0. ";
CM_ SG_ 1650 UnknownData4 "TRANSPORT_CANDIDATE: normal-addressing ISO-TP. PSA-RE bits 5.7-5.0. ";
CM_ SG_ 1650 ConsecutiveData4 "TRANSPORT_CANDIDATE: normal-addressing ISO-TP. PSA-RE bits 5.7-5.0. ";
CM_ SG_ 1650 SingleData4 "TRANSPORT_CANDIDATE: normal-addressing ISO-TP. PSA-RE bits 5.7-5.0. ";
CM_ SG_ 1650 FlowPadding1 "TRANSPORT_CANDIDATE: normal-addressing ISO-TP. PSA-RE bits 4.7-4.0. ";
CM_ SG_ 1650 FirstData2 "TRANSPORT_CANDIDATE: normal-addressing ISO-TP. PSA-RE bits 4.7-4.0. ";
CM_ SG_ 1650 UnknownData3 "TRANSPORT_CANDIDATE: normal-addressing ISO-TP. PSA-RE bits 4.7-4.0. ";
CM_ SG_ 1650 ConsecutiveData3 "TRANSPORT_CANDIDATE: normal-addressing ISO-TP. PSA-RE bits 4.7-4.0. ";
CM_ SG_ 1650 SingleData3 "TRANSPORT_CANDIDATE: normal-addressing ISO-TP. PSA-RE bits 4.7-4.0. ";
CM_ SG_ 1650 FirstData1 "TRANSPORT_CANDIDATE: normal-addressing ISO-TP. PSA-RE bits 3.7-3.0. ";
CM_ SG_ 1650 UnknownData2 "TRANSPORT_CANDIDATE: normal-addressing ISO-TP. PSA-RE bits 3.7-3.0. ";
CM_ SG_ 1650 ConsecutiveData2 "TRANSPORT_CANDIDATE: normal-addressing ISO-TP. PSA-RE bits 3.7-3.0. ";
CM_ SG_ 1650 SingleData2 "TRANSPORT_CANDIDATE: normal-addressing ISO-TP. PSA-RE bits 3.7-3.0. ";
CM_ SG_ 1650 SeparationTimeRaw "TRANSPORT_CANDIDATE: normal-addressing ISO-TP. PSA-RE bits 3.7-3.0. Raw STmin code; 0xF1..0xF9 are not milliseconds.";
CM_ SG_ 1650 UnknownData1 "TRANSPORT_CANDIDATE: normal-addressing ISO-TP. PSA-RE bits 2.7-2.0. ";
CM_ SG_ 1650 ConsecutiveData1 "TRANSPORT_CANDIDATE: normal-addressing ISO-TP. PSA-RE bits 2.7-2.0. ";
CM_ SG_ 1650 SingleData1 "TRANSPORT_CANDIDATE: normal-addressing ISO-TP. PSA-RE bits 2.7-2.0. ";
CM_ SG_ 1650 BlockSize "TRANSPORT_CANDIDATE: normal-addressing ISO-TP. PSA-RE bits 2.7-2.0. ";
CM_ SG_ 1650 UnknownPciLow "TRANSPORT_CANDIDATE: normal-addressing ISO-TP. PSA-RE bits 1.3-1.0. ";
CM_ SG_ 1650 FlowStatus "TRANSPORT_CANDIDATE: normal-addressing ISO-TP. PSA-RE bits 1.3-1.0. ";
CM_ SG_ 1650 ConsecutiveSequence "TRANSPORT_CANDIDATE: normal-addressing ISO-TP. PSA-RE bits 1.3-1.0. ";
CM_ SG_ 1650 FirstFrameLength "TRANSPORT_CANDIDATE: normal-addressing ISO-TP. PSA-RE bits 1.3-2.0. 12-bit declared PDU length; not a reassembled value.";
CM_ SG_ 1650 SingleFrameLength "TRANSPORT_CANDIDATE: normal-addressing ISO-TP. PSA-RE bits 1.3-1.0. Declared data length; not a validity check.";
CM_ SG_ 1650 IsoTpFrameType "TRANSPORT_CANDIDATE: normal-addressing ISO-TP. PSA-RE bits 1.7-1.4. PCI high nibble; normal addressing candidate.";
CM_ BO_ 1651 "DATABASE_CANDIDATE: physical interpretation unverified; capture/layout evidence reported separately. INFO-DIV CAN, 125000 bit/s; CAN ID 0x673. PSA-RE title: AVP_DIAG_RESPONSE. Diagnostic response sent by the AVP ECU. Source: https://github.com/prototux/PSA-RE/blob/67f7581e7622410efdbb29c7eda3b86982b9b450/buses/AEE2010.full/LS.INFO-DIV/673.yml. Source sender alternatives: AVP; physical TX/gateway forwarding not verified. WIRE ISO-TP ONLY: normal addressing candidate, maximum Classical CAN DLC 8; actual DLC may be shorter. Data includes padding. No reassembly, text, DID or application-layer decoding. Original application layouts are preserved in source JSON; do not decode them at wire offsets. ";
CM_ SG_ 1651 FlowPadding5 "TRANSPORT_CANDIDATE: normal-addressing ISO-TP. PSA-RE bits 8.7-8.0. ";
CM_ SG_ 1651 FirstData6 "TRANSPORT_CANDIDATE: normal-addressing ISO-TP. PSA-RE bits 8.7-8.0. ";
CM_ SG_ 1651 UnknownData7 "TRANSPORT_CANDIDATE: normal-addressing ISO-TP. PSA-RE bits 8.7-8.0. ";
CM_ SG_ 1651 ConsecutiveData7 "TRANSPORT_CANDIDATE: normal-addressing ISO-TP. PSA-RE bits 8.7-8.0. ";
CM_ SG_ 1651 SingleData7 "TRANSPORT_CANDIDATE: normal-addressing ISO-TP. PSA-RE bits 8.7-8.0. ";
CM_ SG_ 1651 FlowPadding4 "TRANSPORT_CANDIDATE: normal-addressing ISO-TP. PSA-RE bits 7.7-7.0. ";
CM_ SG_ 1651 FirstData5 "TRANSPORT_CANDIDATE: normal-addressing ISO-TP. PSA-RE bits 7.7-7.0. ";
CM_ SG_ 1651 UnknownData6 "TRANSPORT_CANDIDATE: normal-addressing ISO-TP. PSA-RE bits 7.7-7.0. ";
CM_ SG_ 1651 ConsecutiveData6 "TRANSPORT_CANDIDATE: normal-addressing ISO-TP. PSA-RE bits 7.7-7.0. ";
CM_ SG_ 1651 SingleData6 "TRANSPORT_CANDIDATE: normal-addressing ISO-TP. PSA-RE bits 7.7-7.0. ";
CM_ SG_ 1651 FlowPadding3 "TRANSPORT_CANDIDATE: normal-addressing ISO-TP. PSA-RE bits 6.7-6.0. ";
CM_ SG_ 1651 FirstData4 "TRANSPORT_CANDIDATE: normal-addressing ISO-TP. PSA-RE bits 6.7-6.0. ";
CM_ SG_ 1651 UnknownData5 "TRANSPORT_CANDIDATE: normal-addressing ISO-TP. PSA-RE bits 6.7-6.0. ";
CM_ SG_ 1651 ConsecutiveData5 "TRANSPORT_CANDIDATE: normal-addressing ISO-TP. PSA-RE bits 6.7-6.0. ";
CM_ SG_ 1651 SingleData5 "TRANSPORT_CANDIDATE: normal-addressing ISO-TP. PSA-RE bits 6.7-6.0. ";
CM_ SG_ 1651 FlowPadding2 "TRANSPORT_CANDIDATE: normal-addressing ISO-TP. PSA-RE bits 5.7-5.0. ";
CM_ SG_ 1651 FirstData3 "TRANSPORT_CANDIDATE: normal-addressing ISO-TP. PSA-RE bits 5.7-5.0. ";
CM_ SG_ 1651 UnknownData4 "TRANSPORT_CANDIDATE: normal-addressing ISO-TP. PSA-RE bits 5.7-5.0. ";
CM_ SG_ 1651 ConsecutiveData4 "TRANSPORT_CANDIDATE: normal-addressing ISO-TP. PSA-RE bits 5.7-5.0. ";
CM_ SG_ 1651 SingleData4 "TRANSPORT_CANDIDATE: normal-addressing ISO-TP. PSA-RE bits 5.7-5.0. ";
CM_ SG_ 1651 FlowPadding1 "TRANSPORT_CANDIDATE: normal-addressing ISO-TP. PSA-RE bits 4.7-4.0. ";
CM_ SG_ 1651 FirstData2 "TRANSPORT_CANDIDATE: normal-addressing ISO-TP. PSA-RE bits 4.7-4.0. ";
CM_ SG_ 1651 UnknownData3 "TRANSPORT_CANDIDATE: normal-addressing ISO-TP. PSA-RE bits 4.7-4.0. ";
CM_ SG_ 1651 ConsecutiveData3 "TRANSPORT_CANDIDATE: normal-addressing ISO-TP. PSA-RE bits 4.7-4.0. ";
CM_ SG_ 1651 SingleData3 "TRANSPORT_CANDIDATE: normal-addressing ISO-TP. PSA-RE bits 4.7-4.0. ";
CM_ SG_ 1651 FirstData1 "TRANSPORT_CANDIDATE: normal-addressing ISO-TP. PSA-RE bits 3.7-3.0. ";
CM_ SG_ 1651 UnknownData2 "TRANSPORT_CANDIDATE: normal-addressing ISO-TP. PSA-RE bits 3.7-3.0. ";
CM_ SG_ 1651 ConsecutiveData2 "TRANSPORT_CANDIDATE: normal-addressing ISO-TP. PSA-RE bits 3.7-3.0. ";
CM_ SG_ 1651 SingleData2 "TRANSPORT_CANDIDATE: normal-addressing ISO-TP. PSA-RE bits 3.7-3.0. ";
CM_ SG_ 1651 SeparationTimeRaw "TRANSPORT_CANDIDATE: normal-addressing ISO-TP. PSA-RE bits 3.7-3.0. Raw STmin code; 0xF1..0xF9 are not milliseconds.";
CM_ SG_ 1651 UnknownData1 "TRANSPORT_CANDIDATE: normal-addressing ISO-TP. PSA-RE bits 2.7-2.0. ";
CM_ SG_ 1651 ConsecutiveData1 "TRANSPORT_CANDIDATE: normal-addressing ISO-TP. PSA-RE bits 2.7-2.0. ";
CM_ SG_ 1651 SingleData1 "TRANSPORT_CANDIDATE: normal-addressing ISO-TP. PSA-RE bits 2.7-2.0. ";
CM_ SG_ 1651 BlockSize "TRANSPORT_CANDIDATE: normal-addressing ISO-TP. PSA-RE bits 2.7-2.0. ";
CM_ SG_ 1651 UnknownPciLow "TRANSPORT_CANDIDATE: normal-addressing ISO-TP. PSA-RE bits 1.3-1.0. ";
CM_ SG_ 1651 FlowStatus "TRANSPORT_CANDIDATE: normal-addressing ISO-TP. PSA-RE bits 1.3-1.0. ";
CM_ SG_ 1651 ConsecutiveSequence "TRANSPORT_CANDIDATE: normal-addressing ISO-TP. PSA-RE bits 1.3-1.0. ";
CM_ SG_ 1651 FirstFrameLength "TRANSPORT_CANDIDATE: normal-addressing ISO-TP. PSA-RE bits 1.3-2.0. 12-bit declared PDU length; not a reassembled value.";
CM_ SG_ 1651 SingleFrameLength "TRANSPORT_CANDIDATE: normal-addressing ISO-TP. PSA-RE bits 1.3-1.0. Declared data length; not a validity check.";
CM_ SG_ 1651 IsoTpFrameType "TRANSPORT_CANDIDATE: normal-addressing ISO-TP. PSA-RE bits 1.7-1.4. PCI high nibble; normal addressing candidate.";
CM_ BO_ 1652 "DATABASE_CANDIDATE: physical interpretation unverified; capture/layout evidence reported separately. INFO-DIV CAN, 125000 bit/s; CAN ID 0x674. PSA-RE title: DIAG_RESPONSE_2. Diagnostic response frame sent on the bus. Source: https://github.com/prototux/PSA-RE/blob/67f7581e7622410efdbb29c7eda3b86982b9b450/buses/AEE2010.full/LS.INFO-DIV/674.yml. Source sender alternatives: BSI; physical TX/gateway forwarding not verified. WIRE ISO-TP ONLY: normal addressing candidate, maximum Classical CAN DLC 8; actual DLC may be shorter. Data includes padding. No reassembly, text, DID or application-layer decoding. Original application layouts are preserved in source JSON; do not decode them at wire offsets. ";
CM_ SG_ 1652 FlowPadding5 "TRANSPORT_CANDIDATE: normal-addressing ISO-TP. PSA-RE bits 8.7-8.0. ";
CM_ SG_ 1652 FirstData6 "TRANSPORT_CANDIDATE: normal-addressing ISO-TP. PSA-RE bits 8.7-8.0. ";
CM_ SG_ 1652 UnknownData7 "TRANSPORT_CANDIDATE: normal-addressing ISO-TP. PSA-RE bits 8.7-8.0. ";
CM_ SG_ 1652 ConsecutiveData7 "TRANSPORT_CANDIDATE: normal-addressing ISO-TP. PSA-RE bits 8.7-8.0. ";
CM_ SG_ 1652 SingleData7 "TRANSPORT_CANDIDATE: normal-addressing ISO-TP. PSA-RE bits 8.7-8.0. ";
CM_ SG_ 1652 FlowPadding4 "TRANSPORT_CANDIDATE: normal-addressing ISO-TP. PSA-RE bits 7.7-7.0. ";
CM_ SG_ 1652 FirstData5 "TRANSPORT_CANDIDATE: normal-addressing ISO-TP. PSA-RE bits 7.7-7.0. ";
CM_ SG_ 1652 UnknownData6 "TRANSPORT_CANDIDATE: normal-addressing ISO-TP. PSA-RE bits 7.7-7.0. ";
CM_ SG_ 1652 ConsecutiveData6 "TRANSPORT_CANDIDATE: normal-addressing ISO-TP. PSA-RE bits 7.7-7.0. ";
CM_ SG_ 1652 SingleData6 "TRANSPORT_CANDIDATE: normal-addressing ISO-TP. PSA-RE bits 7.7-7.0. ";
CM_ SG_ 1652 FlowPadding3 "TRANSPORT_CANDIDATE: normal-addressing ISO-TP. PSA-RE bits 6.7-6.0. ";
CM_ SG_ 1652 FirstData4 "TRANSPORT_CANDIDATE: normal-addressing ISO-TP. PSA-RE bits 6.7-6.0. ";
CM_ SG_ 1652 UnknownData5 "TRANSPORT_CANDIDATE: normal-addressing ISO-TP. PSA-RE bits 6.7-6.0. ";
CM_ SG_ 1652 ConsecutiveData5 "TRANSPORT_CANDIDATE: normal-addressing ISO-TP. PSA-RE bits 6.7-6.0. ";
CM_ SG_ 1652 SingleData5 "TRANSPORT_CANDIDATE: normal-addressing ISO-TP. PSA-RE bits 6.7-6.0. ";
CM_ SG_ 1652 FlowPadding2 "TRANSPORT_CANDIDATE: normal-addressing ISO-TP. PSA-RE bits 5.7-5.0. ";
CM_ SG_ 1652 FirstData3 "TRANSPORT_CANDIDATE: normal-addressing ISO-TP. PSA-RE bits 5.7-5.0. ";
CM_ SG_ 1652 UnknownData4 "TRANSPORT_CANDIDATE: normal-addressing ISO-TP. PSA-RE bits 5.7-5.0. ";
CM_ SG_ 1652 ConsecutiveData4 "TRANSPORT_CANDIDATE: normal-addressing ISO-TP. PSA-RE bits 5.7-5.0. ";
CM_ SG_ 1652 SingleData4 "TRANSPORT_CANDIDATE: normal-addressing ISO-TP. PSA-RE bits 5.7-5.0. ";
CM_ SG_ 1652 FlowPadding1 "TRANSPORT_CANDIDATE: normal-addressing ISO-TP. PSA-RE bits 4.7-4.0. ";
CM_ SG_ 1652 FirstData2 "TRANSPORT_CANDIDATE: normal-addressing ISO-TP. PSA-RE bits 4.7-4.0. ";
CM_ SG_ 1652 UnknownData3 "TRANSPORT_CANDIDATE: normal-addressing ISO-TP. PSA-RE bits 4.7-4.0. ";
CM_ SG_ 1652 ConsecutiveData3 "TRANSPORT_CANDIDATE: normal-addressing ISO-TP. PSA-RE bits 4.7-4.0. ";
CM_ SG_ 1652 SingleData3 "TRANSPORT_CANDIDATE: normal-addressing ISO-TP. PSA-RE bits 4.7-4.0. ";
CM_ SG_ 1652 FirstData1 "TRANSPORT_CANDIDATE: normal-addressing ISO-TP. PSA-RE bits 3.7-3.0. ";
CM_ SG_ 1652 UnknownData2 "TRANSPORT_CANDIDATE: normal-addressing ISO-TP. PSA-RE bits 3.7-3.0. ";
CM_ SG_ 1652 ConsecutiveData2 "TRANSPORT_CANDIDATE: normal-addressing ISO-TP. PSA-RE bits 3.7-3.0. ";
CM_ SG_ 1652 SingleData2 "TRANSPORT_CANDIDATE: normal-addressing ISO-TP. PSA-RE bits 3.7-3.0. ";
CM_ SG_ 1652 SeparationTimeRaw "TRANSPORT_CANDIDATE: normal-addressing ISO-TP. PSA-RE bits 3.7-3.0. Raw STmin code; 0xF1..0xF9 are not milliseconds.";
CM_ SG_ 1652 UnknownData1 "TRANSPORT_CANDIDATE: normal-addressing ISO-TP. PSA-RE bits 2.7-2.0. ";
CM_ SG_ 1652 ConsecutiveData1 "TRANSPORT_CANDIDATE: normal-addressing ISO-TP. PSA-RE bits 2.7-2.0. ";
CM_ SG_ 1652 SingleData1 "TRANSPORT_CANDIDATE: normal-addressing ISO-TP. PSA-RE bits 2.7-2.0. ";
CM_ SG_ 1652 BlockSize "TRANSPORT_CANDIDATE: normal-addressing ISO-TP. PSA-RE bits 2.7-2.0. ";
CM_ SG_ 1652 UnknownPciLow "TRANSPORT_CANDIDATE: normal-addressing ISO-TP. PSA-RE bits 1.3-1.0. ";
CM_ SG_ 1652 FlowStatus "TRANSPORT_CANDIDATE: normal-addressing ISO-TP. PSA-RE bits 1.3-1.0. ";
CM_ SG_ 1652 ConsecutiveSequence "TRANSPORT_CANDIDATE: normal-addressing ISO-TP. PSA-RE bits 1.3-1.0. ";
CM_ SG_ 1652 FirstFrameLength "TRANSPORT_CANDIDATE: normal-addressing ISO-TP. PSA-RE bits 1.3-2.0. 12-bit declared PDU length; not a reassembled value.";
CM_ SG_ 1652 SingleFrameLength "TRANSPORT_CANDIDATE: normal-addressing ISO-TP. PSA-RE bits 1.3-1.0. Declared data length; not a validity check.";
CM_ SG_ 1652 IsoTpFrameType "TRANSPORT_CANDIDATE: normal-addressing ISO-TP. PSA-RE bits 1.7-1.4. PCI high nibble; normal addressing candidate.";
CM_ BO_ 1654 "DATABASE_CANDIDATE: physical interpretation unverified; capture/layout evidence reported separately. INFO-DIV CAN, 125000 bit/s; CAN ID 0x676. PSA-RE title: DIAG_RESPONSE_BTT. Diagnostic response data sent by the BTT module. Source: https://github.com/prototux/PSA-RE/blob/67f7581e7622410efdbb29c7eda3b86982b9b450/buses/AEE2010.full/LS.INFO-DIV/676.yml. Source sender alternatives: BTT; physical TX/gateway forwarding not verified. ";
CM_ SG_ 1654 DiagnosticData "DATABASE_CANDIDATE: physical interpretation unverified; capture/layout evidence reported separately. PSA-RE bits 1.7-8.0. Diagnostic data";
CM_ BO_ 1656 "DATABASE_CANDIDATE: physical interpretation unverified; capture/layout evidence reported separately. INFO-DIV CAN, 125000 bit/s; CAN ID 0x678. PSA-RE title: CLR_DIAG_RESPONSE. Diagnostic response sent by the CLR ECU. Source: https://github.com/prototux/PSA-RE/blob/67f7581e7622410efdbb29c7eda3b86982b9b450/buses/AEE2010.full/LS.INFO-DIV/678.yml. Source sender alternatives: BSI; physical TX/gateway forwarding not verified. WIRE ISO-TP ONLY: normal addressing candidate, maximum Classical CAN DLC 8; actual DLC may be shorter. Data includes padding. No reassembly, text, DID or application-layer decoding. Original application layouts are preserved in source JSON; do not decode them at wire offsets. ";
CM_ SG_ 1656 FlowPadding5 "TRANSPORT_CANDIDATE: normal-addressing ISO-TP. PSA-RE bits 8.7-8.0. ";
CM_ SG_ 1656 FirstData6 "TRANSPORT_CANDIDATE: normal-addressing ISO-TP. PSA-RE bits 8.7-8.0. ";
CM_ SG_ 1656 UnknownData7 "TRANSPORT_CANDIDATE: normal-addressing ISO-TP. PSA-RE bits 8.7-8.0. ";
CM_ SG_ 1656 ConsecutiveData7 "TRANSPORT_CANDIDATE: normal-addressing ISO-TP. PSA-RE bits 8.7-8.0. ";
CM_ SG_ 1656 SingleData7 "TRANSPORT_CANDIDATE: normal-addressing ISO-TP. PSA-RE bits 8.7-8.0. ";
CM_ SG_ 1656 FlowPadding4 "TRANSPORT_CANDIDATE: normal-addressing ISO-TP. PSA-RE bits 7.7-7.0. ";
CM_ SG_ 1656 FirstData5 "TRANSPORT_CANDIDATE: normal-addressing ISO-TP. PSA-RE bits 7.7-7.0. ";
CM_ SG_ 1656 UnknownData6 "TRANSPORT_CANDIDATE: normal-addressing ISO-TP. PSA-RE bits 7.7-7.0. ";
CM_ SG_ 1656 ConsecutiveData6 "TRANSPORT_CANDIDATE: normal-addressing ISO-TP. PSA-RE bits 7.7-7.0. ";
CM_ SG_ 1656 SingleData6 "TRANSPORT_CANDIDATE: normal-addressing ISO-TP. PSA-RE bits 7.7-7.0. ";
CM_ SG_ 1656 FlowPadding3 "TRANSPORT_CANDIDATE: normal-addressing ISO-TP. PSA-RE bits 6.7-6.0. ";
CM_ SG_ 1656 FirstData4 "TRANSPORT_CANDIDATE: normal-addressing ISO-TP. PSA-RE bits 6.7-6.0. ";
CM_ SG_ 1656 UnknownData5 "TRANSPORT_CANDIDATE: normal-addressing ISO-TP. PSA-RE bits 6.7-6.0. ";
CM_ SG_ 1656 ConsecutiveData5 "TRANSPORT_CANDIDATE: normal-addressing ISO-TP. PSA-RE bits 6.7-6.0. ";
CM_ SG_ 1656 SingleData5 "TRANSPORT_CANDIDATE: normal-addressing ISO-TP. PSA-RE bits 6.7-6.0. ";
CM_ SG_ 1656 FlowPadding2 "TRANSPORT_CANDIDATE: normal-addressing ISO-TP. PSA-RE bits 5.7-5.0. ";
CM_ SG_ 1656 FirstData3 "TRANSPORT_CANDIDATE: normal-addressing ISO-TP. PSA-RE bits 5.7-5.0. ";
CM_ SG_ 1656 UnknownData4 "TRANSPORT_CANDIDATE: normal-addressing ISO-TP. PSA-RE bits 5.7-5.0. ";
CM_ SG_ 1656 ConsecutiveData4 "TRANSPORT_CANDIDATE: normal-addressing ISO-TP. PSA-RE bits 5.7-5.0. ";
CM_ SG_ 1656 SingleData4 "TRANSPORT_CANDIDATE: normal-addressing ISO-TP. PSA-RE bits 5.7-5.0. ";
CM_ SG_ 1656 FlowPadding1 "TRANSPORT_CANDIDATE: normal-addressing ISO-TP. PSA-RE bits 4.7-4.0. ";
CM_ SG_ 1656 FirstData2 "TRANSPORT_CANDIDATE: normal-addressing ISO-TP. PSA-RE bits 4.7-4.0. ";
CM_ SG_ 1656 UnknownData3 "TRANSPORT_CANDIDATE: normal-addressing ISO-TP. PSA-RE bits 4.7-4.0. ";
CM_ SG_ 1656 ConsecutiveData3 "TRANSPORT_CANDIDATE: normal-addressing ISO-TP. PSA-RE bits 4.7-4.0. ";
CM_ SG_ 1656 SingleData3 "TRANSPORT_CANDIDATE: normal-addressing ISO-TP. PSA-RE bits 4.7-4.0. ";
CM_ SG_ 1656 FirstData1 "TRANSPORT_CANDIDATE: normal-addressing ISO-TP. PSA-RE bits 3.7-3.0. ";
CM_ SG_ 1656 UnknownData2 "TRANSPORT_CANDIDATE: normal-addressing ISO-TP. PSA-RE bits 3.7-3.0. ";
CM_ SG_ 1656 ConsecutiveData2 "TRANSPORT_CANDIDATE: normal-addressing ISO-TP. PSA-RE bits 3.7-3.0. ";
CM_ SG_ 1656 SingleData2 "TRANSPORT_CANDIDATE: normal-addressing ISO-TP. PSA-RE bits 3.7-3.0. ";
CM_ SG_ 1656 SeparationTimeRaw "TRANSPORT_CANDIDATE: normal-addressing ISO-TP. PSA-RE bits 3.7-3.0. Raw STmin code; 0xF1..0xF9 are not milliseconds.";
CM_ SG_ 1656 UnknownData1 "TRANSPORT_CANDIDATE: normal-addressing ISO-TP. PSA-RE bits 2.7-2.0. ";
CM_ SG_ 1656 ConsecutiveData1 "TRANSPORT_CANDIDATE: normal-addressing ISO-TP. PSA-RE bits 2.7-2.0. ";
CM_ SG_ 1656 SingleData1 "TRANSPORT_CANDIDATE: normal-addressing ISO-TP. PSA-RE bits 2.7-2.0. ";
CM_ SG_ 1656 BlockSize "TRANSPORT_CANDIDATE: normal-addressing ISO-TP. PSA-RE bits 2.7-2.0. ";
CM_ SG_ 1656 UnknownPciLow "TRANSPORT_CANDIDATE: normal-addressing ISO-TP. PSA-RE bits 1.3-1.0. ";
CM_ SG_ 1656 FlowStatus "TRANSPORT_CANDIDATE: normal-addressing ISO-TP. PSA-RE bits 1.3-1.0. ";
CM_ SG_ 1656 ConsecutiveSequence "TRANSPORT_CANDIDATE: normal-addressing ISO-TP. PSA-RE bits 1.3-1.0. ";
CM_ SG_ 1656 FirstFrameLength "TRANSPORT_CANDIDATE: normal-addressing ISO-TP. PSA-RE bits 1.3-2.0. 12-bit declared PDU length; not a reassembled value.";
CM_ SG_ 1656 SingleFrameLength "TRANSPORT_CANDIDATE: normal-addressing ISO-TP. PSA-RE bits 1.3-1.0. Declared data length; not a validity check.";
CM_ SG_ 1656 IsoTpFrameType "TRANSPORT_CANDIDATE: normal-addressing ISO-TP. PSA-RE bits 1.7-1.4. PCI high nibble; normal addressing candidate.";
CM_ BO_ 1659 "DATABASE_CANDIDATE: physical interpretation unverified; capture/layout evidence reported separately. INFO-DIV CAN, 125000 bit/s; CAN ID 0x67B. PSA-RE title: FMUX_DIAG_RESPONSE. Diagnostic response sent by the FMUX ECU. Source: https://github.com/prototux/PSA-RE/blob/67f7581e7622410efdbb29c7eda3b86982b9b450/buses/AEE2010.full/LS.INFO-DIV/67B.yml. Source sender alternatives: FMUX; physical TX/gateway forwarding not verified. WIRE ISO-TP ONLY: normal addressing candidate, maximum Classical CAN DLC 8; actual DLC may be shorter. Data includes padding. No reassembly, text, DID or application-layer decoding. Original application layouts are preserved in source JSON; do not decode them at wire offsets. ";
CM_ SG_ 1659 FlowPadding5 "TRANSPORT_CANDIDATE: normal-addressing ISO-TP. PSA-RE bits 8.7-8.0. ";
CM_ SG_ 1659 FirstData6 "TRANSPORT_CANDIDATE: normal-addressing ISO-TP. PSA-RE bits 8.7-8.0. ";
CM_ SG_ 1659 UnknownData7 "TRANSPORT_CANDIDATE: normal-addressing ISO-TP. PSA-RE bits 8.7-8.0. ";
CM_ SG_ 1659 ConsecutiveData7 "TRANSPORT_CANDIDATE: normal-addressing ISO-TP. PSA-RE bits 8.7-8.0. ";
CM_ SG_ 1659 SingleData7 "TRANSPORT_CANDIDATE: normal-addressing ISO-TP. PSA-RE bits 8.7-8.0. ";
CM_ SG_ 1659 FlowPadding4 "TRANSPORT_CANDIDATE: normal-addressing ISO-TP. PSA-RE bits 7.7-7.0. ";
CM_ SG_ 1659 FirstData5 "TRANSPORT_CANDIDATE: normal-addressing ISO-TP. PSA-RE bits 7.7-7.0. ";
CM_ SG_ 1659 UnknownData6 "TRANSPORT_CANDIDATE: normal-addressing ISO-TP. PSA-RE bits 7.7-7.0. ";
CM_ SG_ 1659 ConsecutiveData6 "TRANSPORT_CANDIDATE: normal-addressing ISO-TP. PSA-RE bits 7.7-7.0. ";
CM_ SG_ 1659 SingleData6 "TRANSPORT_CANDIDATE: normal-addressing ISO-TP. PSA-RE bits 7.7-7.0. ";
CM_ SG_ 1659 FlowPadding3 "TRANSPORT_CANDIDATE: normal-addressing ISO-TP. PSA-RE bits 6.7-6.0. ";
CM_ SG_ 1659 FirstData4 "TRANSPORT_CANDIDATE: normal-addressing ISO-TP. PSA-RE bits 6.7-6.0. ";
CM_ SG_ 1659 UnknownData5 "TRANSPORT_CANDIDATE: normal-addressing ISO-TP. PSA-RE bits 6.7-6.0. ";
CM_ SG_ 1659 ConsecutiveData5 "TRANSPORT_CANDIDATE: normal-addressing ISO-TP. PSA-RE bits 6.7-6.0. ";
CM_ SG_ 1659 SingleData5 "TRANSPORT_CANDIDATE: normal-addressing ISO-TP. PSA-RE bits 6.7-6.0. ";
CM_ SG_ 1659 FlowPadding2 "TRANSPORT_CANDIDATE: normal-addressing ISO-TP. PSA-RE bits 5.7-5.0. ";
CM_ SG_ 1659 FirstData3 "TRANSPORT_CANDIDATE: normal-addressing ISO-TP. PSA-RE bits 5.7-5.0. ";
CM_ SG_ 1659 UnknownData4 "TRANSPORT_CANDIDATE: normal-addressing ISO-TP. PSA-RE bits 5.7-5.0. ";
CM_ SG_ 1659 ConsecutiveData4 "TRANSPORT_CANDIDATE: normal-addressing ISO-TP. PSA-RE bits 5.7-5.0. ";
CM_ SG_ 1659 SingleData4 "TRANSPORT_CANDIDATE: normal-addressing ISO-TP. PSA-RE bits 5.7-5.0. ";
CM_ SG_ 1659 FlowPadding1 "TRANSPORT_CANDIDATE: normal-addressing ISO-TP. PSA-RE bits 4.7-4.0. ";
CM_ SG_ 1659 FirstData2 "TRANSPORT_CANDIDATE: normal-addressing ISO-TP. PSA-RE bits 4.7-4.0. ";
CM_ SG_ 1659 UnknownData3 "TRANSPORT_CANDIDATE: normal-addressing ISO-TP. PSA-RE bits 4.7-4.0. ";
CM_ SG_ 1659 ConsecutiveData3 "TRANSPORT_CANDIDATE: normal-addressing ISO-TP. PSA-RE bits 4.7-4.0. ";
CM_ SG_ 1659 SingleData3 "TRANSPORT_CANDIDATE: normal-addressing ISO-TP. PSA-RE bits 4.7-4.0. ";
CM_ SG_ 1659 FirstData1 "TRANSPORT_CANDIDATE: normal-addressing ISO-TP. PSA-RE bits 3.7-3.0. ";
CM_ SG_ 1659 UnknownData2 "TRANSPORT_CANDIDATE: normal-addressing ISO-TP. PSA-RE bits 3.7-3.0. ";
CM_ SG_ 1659 ConsecutiveData2 "TRANSPORT_CANDIDATE: normal-addressing ISO-TP. PSA-RE bits 3.7-3.0. ";
CM_ SG_ 1659 SingleData2 "TRANSPORT_CANDIDATE: normal-addressing ISO-TP. PSA-RE bits 3.7-3.0. ";
CM_ SG_ 1659 SeparationTimeRaw "TRANSPORT_CANDIDATE: normal-addressing ISO-TP. PSA-RE bits 3.7-3.0. Raw STmin code; 0xF1..0xF9 are not milliseconds.";
CM_ SG_ 1659 UnknownData1 "TRANSPORT_CANDIDATE: normal-addressing ISO-TP. PSA-RE bits 2.7-2.0. ";
CM_ SG_ 1659 ConsecutiveData1 "TRANSPORT_CANDIDATE: normal-addressing ISO-TP. PSA-RE bits 2.7-2.0. ";
CM_ SG_ 1659 SingleData1 "TRANSPORT_CANDIDATE: normal-addressing ISO-TP. PSA-RE bits 2.7-2.0. ";
CM_ SG_ 1659 BlockSize "TRANSPORT_CANDIDATE: normal-addressing ISO-TP. PSA-RE bits 2.7-2.0. ";
CM_ SG_ 1659 UnknownPciLow "TRANSPORT_CANDIDATE: normal-addressing ISO-TP. PSA-RE bits 1.3-1.0. ";
CM_ SG_ 1659 FlowStatus "TRANSPORT_CANDIDATE: normal-addressing ISO-TP. PSA-RE bits 1.3-1.0. ";
CM_ SG_ 1659 ConsecutiveSequence "TRANSPORT_CANDIDATE: normal-addressing ISO-TP. PSA-RE bits 1.3-1.0. ";
CM_ SG_ 1659 FirstFrameLength "TRANSPORT_CANDIDATE: normal-addressing ISO-TP. PSA-RE bits 1.3-2.0. 12-bit declared PDU length; not a reassembled value.";
CM_ SG_ 1659 SingleFrameLength "TRANSPORT_CANDIDATE: normal-addressing ISO-TP. PSA-RE bits 1.3-1.0. Declared data length; not a validity check.";
CM_ SG_ 1659 IsoTpFrameType "TRANSPORT_CANDIDATE: normal-addressing ISO-TP. PSA-RE bits 1.7-1.4. PCI high nibble; normal addressing candidate.";
CM_ BO_ 1660 "DATABASE_CANDIDATE: physical interpretation unverified; capture/layout evidence reported separately. INFO-DIV CAN, 125000 bit/s; CAN ID 0x67C. PSA-RE title: MDS_DIAG_RESPONSE. Diagnostic response sent by the MDS ECU. Source: https://github.com/prototux/PSA-RE/blob/67f7581e7622410efdbb29c7eda3b86982b9b450/buses/AEE2010.full/LS.INFO-DIV/67C.yml. Source sender alternatives: MDS; physical TX/gateway forwarding not verified. WIRE ISO-TP ONLY: normal addressing candidate, maximum Classical CAN DLC 8; actual DLC may be shorter. Data includes padding. No reassembly, text, DID or application-layer decoding. Original application layouts are preserved in source JSON; do not decode them at wire offsets. ";
CM_ SG_ 1660 FlowPadding5 "TRANSPORT_CANDIDATE: normal-addressing ISO-TP. PSA-RE bits 8.7-8.0. ";
CM_ SG_ 1660 FirstData6 "TRANSPORT_CANDIDATE: normal-addressing ISO-TP. PSA-RE bits 8.7-8.0. ";
CM_ SG_ 1660 UnknownData7 "TRANSPORT_CANDIDATE: normal-addressing ISO-TP. PSA-RE bits 8.7-8.0. ";
CM_ SG_ 1660 ConsecutiveData7 "TRANSPORT_CANDIDATE: normal-addressing ISO-TP. PSA-RE bits 8.7-8.0. ";
CM_ SG_ 1660 SingleData7 "TRANSPORT_CANDIDATE: normal-addressing ISO-TP. PSA-RE bits 8.7-8.0. ";
CM_ SG_ 1660 FlowPadding4 "TRANSPORT_CANDIDATE: normal-addressing ISO-TP. PSA-RE bits 7.7-7.0. ";
CM_ SG_ 1660 FirstData5 "TRANSPORT_CANDIDATE: normal-addressing ISO-TP. PSA-RE bits 7.7-7.0. ";
CM_ SG_ 1660 UnknownData6 "TRANSPORT_CANDIDATE: normal-addressing ISO-TP. PSA-RE bits 7.7-7.0. ";
CM_ SG_ 1660 ConsecutiveData6 "TRANSPORT_CANDIDATE: normal-addressing ISO-TP. PSA-RE bits 7.7-7.0. ";
CM_ SG_ 1660 SingleData6 "TRANSPORT_CANDIDATE: normal-addressing ISO-TP. PSA-RE bits 7.7-7.0. ";
CM_ SG_ 1660 FlowPadding3 "TRANSPORT_CANDIDATE: normal-addressing ISO-TP. PSA-RE bits 6.7-6.0. ";
CM_ SG_ 1660 FirstData4 "TRANSPORT_CANDIDATE: normal-addressing ISO-TP. PSA-RE bits 6.7-6.0. ";
CM_ SG_ 1660 UnknownData5 "TRANSPORT_CANDIDATE: normal-addressing ISO-TP. PSA-RE bits 6.7-6.0. ";
CM_ SG_ 1660 ConsecutiveData5 "TRANSPORT_CANDIDATE: normal-addressing ISO-TP. PSA-RE bits 6.7-6.0. ";
CM_ SG_ 1660 SingleData5 "TRANSPORT_CANDIDATE: normal-addressing ISO-TP. PSA-RE bits 6.7-6.0. ";
CM_ SG_ 1660 FlowPadding2 "TRANSPORT_CANDIDATE: normal-addressing ISO-TP. PSA-RE bits 5.7-5.0. ";
CM_ SG_ 1660 FirstData3 "TRANSPORT_CANDIDATE: normal-addressing ISO-TP. PSA-RE bits 5.7-5.0. ";
CM_ SG_ 1660 UnknownData4 "TRANSPORT_CANDIDATE: normal-addressing ISO-TP. PSA-RE bits 5.7-5.0. ";
CM_ SG_ 1660 ConsecutiveData4 "TRANSPORT_CANDIDATE: normal-addressing ISO-TP. PSA-RE bits 5.7-5.0. ";
CM_ SG_ 1660 SingleData4 "TRANSPORT_CANDIDATE: normal-addressing ISO-TP. PSA-RE bits 5.7-5.0. ";
CM_ SG_ 1660 FlowPadding1 "TRANSPORT_CANDIDATE: normal-addressing ISO-TP. PSA-RE bits 4.7-4.0. ";
CM_ SG_ 1660 FirstData2 "TRANSPORT_CANDIDATE: normal-addressing ISO-TP. PSA-RE bits 4.7-4.0. ";
CM_ SG_ 1660 UnknownData3 "TRANSPORT_CANDIDATE: normal-addressing ISO-TP. PSA-RE bits 4.7-4.0. ";
CM_ SG_ 1660 ConsecutiveData3 "TRANSPORT_CANDIDATE: normal-addressing ISO-TP. PSA-RE bits 4.7-4.0. ";
CM_ SG_ 1660 SingleData3 "TRANSPORT_CANDIDATE: normal-addressing ISO-TP. PSA-RE bits 4.7-4.0. ";
CM_ SG_ 1660 FirstData1 "TRANSPORT_CANDIDATE: normal-addressing ISO-TP. PSA-RE bits 3.7-3.0. ";
CM_ SG_ 1660 UnknownData2 "TRANSPORT_CANDIDATE: normal-addressing ISO-TP. PSA-RE bits 3.7-3.0. ";
CM_ SG_ 1660 ConsecutiveData2 "TRANSPORT_CANDIDATE: normal-addressing ISO-TP. PSA-RE bits 3.7-3.0. ";
CM_ SG_ 1660 SingleData2 "TRANSPORT_CANDIDATE: normal-addressing ISO-TP. PSA-RE bits 3.7-3.0. ";
CM_ SG_ 1660 SeparationTimeRaw "TRANSPORT_CANDIDATE: normal-addressing ISO-TP. PSA-RE bits 3.7-3.0. Raw STmin code; 0xF1..0xF9 are not milliseconds.";
CM_ SG_ 1660 UnknownData1 "TRANSPORT_CANDIDATE: normal-addressing ISO-TP. PSA-RE bits 2.7-2.0. ";
CM_ SG_ 1660 ConsecutiveData1 "TRANSPORT_CANDIDATE: normal-addressing ISO-TP. PSA-RE bits 2.7-2.0. ";
CM_ SG_ 1660 SingleData1 "TRANSPORT_CANDIDATE: normal-addressing ISO-TP. PSA-RE bits 2.7-2.0. ";
CM_ SG_ 1660 BlockSize "TRANSPORT_CANDIDATE: normal-addressing ISO-TP. PSA-RE bits 2.7-2.0. ";
CM_ SG_ 1660 UnknownPciLow "TRANSPORT_CANDIDATE: normal-addressing ISO-TP. PSA-RE bits 1.3-1.0. ";
CM_ SG_ 1660 FlowStatus "TRANSPORT_CANDIDATE: normal-addressing ISO-TP. PSA-RE bits 1.3-1.0. ";
CM_ SG_ 1660 ConsecutiveSequence "TRANSPORT_CANDIDATE: normal-addressing ISO-TP. PSA-RE bits 1.3-1.0. ";
CM_ SG_ 1660 FirstFrameLength "TRANSPORT_CANDIDATE: normal-addressing ISO-TP. PSA-RE bits 1.3-2.0. 12-bit declared PDU length; not a reassembled value.";
CM_ SG_ 1660 SingleFrameLength "TRANSPORT_CANDIDATE: normal-addressing ISO-TP. PSA-RE bits 1.3-1.0. Declared data length; not a validity check.";
CM_ SG_ 1660 IsoTpFrameType "TRANSPORT_CANDIDATE: normal-addressing ISO-TP. PSA-RE bits 1.7-1.4. PCI high nibble; normal addressing candidate.";
CM_ BO_ 1661 "DATABASE_CANDIDATE: physical interpretation unverified; capture/layout evidence reported separately. INFO-DIV CAN, 125000 bit/s; CAN ID 0x67D. PSA-RE title: AMPLI_DIAG_RESPONSE. Diagnostic response sent by the AMPLI ECU. Source: https://github.com/prototux/PSA-RE/blob/67f7581e7622410efdbb29c7eda3b86982b9b450/buses/AEE2010.full/LS.INFO-DIV/67D.yml. Source sender alternatives: AMPLI; physical TX/gateway forwarding not verified. WIRE ISO-TP ONLY: normal addressing candidate, maximum Classical CAN DLC 8; actual DLC may be shorter. Data includes padding. No reassembly, text, DID or application-layer decoding. Original application layouts are preserved in source JSON; do not decode them at wire offsets. ";
CM_ SG_ 1661 FlowPadding5 "TRANSPORT_CANDIDATE: normal-addressing ISO-TP. PSA-RE bits 8.7-8.0. ";
CM_ SG_ 1661 FirstData6 "TRANSPORT_CANDIDATE: normal-addressing ISO-TP. PSA-RE bits 8.7-8.0. ";
CM_ SG_ 1661 UnknownData7 "TRANSPORT_CANDIDATE: normal-addressing ISO-TP. PSA-RE bits 8.7-8.0. ";
CM_ SG_ 1661 ConsecutiveData7 "TRANSPORT_CANDIDATE: normal-addressing ISO-TP. PSA-RE bits 8.7-8.0. ";
CM_ SG_ 1661 SingleData7 "TRANSPORT_CANDIDATE: normal-addressing ISO-TP. PSA-RE bits 8.7-8.0. ";
CM_ SG_ 1661 FlowPadding4 "TRANSPORT_CANDIDATE: normal-addressing ISO-TP. PSA-RE bits 7.7-7.0. ";
CM_ SG_ 1661 FirstData5 "TRANSPORT_CANDIDATE: normal-addressing ISO-TP. PSA-RE bits 7.7-7.0. ";
CM_ SG_ 1661 UnknownData6 "TRANSPORT_CANDIDATE: normal-addressing ISO-TP. PSA-RE bits 7.7-7.0. ";
CM_ SG_ 1661 ConsecutiveData6 "TRANSPORT_CANDIDATE: normal-addressing ISO-TP. PSA-RE bits 7.7-7.0. ";
CM_ SG_ 1661 SingleData6 "TRANSPORT_CANDIDATE: normal-addressing ISO-TP. PSA-RE bits 7.7-7.0. ";
CM_ SG_ 1661 FlowPadding3 "TRANSPORT_CANDIDATE: normal-addressing ISO-TP. PSA-RE bits 6.7-6.0. ";
CM_ SG_ 1661 FirstData4 "TRANSPORT_CANDIDATE: normal-addressing ISO-TP. PSA-RE bits 6.7-6.0. ";
CM_ SG_ 1661 UnknownData5 "TRANSPORT_CANDIDATE: normal-addressing ISO-TP. PSA-RE bits 6.7-6.0. ";
CM_ SG_ 1661 ConsecutiveData5 "TRANSPORT_CANDIDATE: normal-addressing ISO-TP. PSA-RE bits 6.7-6.0. ";
CM_ SG_ 1661 SingleData5 "TRANSPORT_CANDIDATE: normal-addressing ISO-TP. PSA-RE bits 6.7-6.0. ";
CM_ SG_ 1661 FlowPadding2 "TRANSPORT_CANDIDATE: normal-addressing ISO-TP. PSA-RE bits 5.7-5.0. ";
CM_ SG_ 1661 FirstData3 "TRANSPORT_CANDIDATE: normal-addressing ISO-TP. PSA-RE bits 5.7-5.0. ";
CM_ SG_ 1661 UnknownData4 "TRANSPORT_CANDIDATE: normal-addressing ISO-TP. PSA-RE bits 5.7-5.0. ";
CM_ SG_ 1661 ConsecutiveData4 "TRANSPORT_CANDIDATE: normal-addressing ISO-TP. PSA-RE bits 5.7-5.0. ";
CM_ SG_ 1661 SingleData4 "TRANSPORT_CANDIDATE: normal-addressing ISO-TP. PSA-RE bits 5.7-5.0. ";
CM_ SG_ 1661 FlowPadding1 "TRANSPORT_CANDIDATE: normal-addressing ISO-TP. PSA-RE bits 4.7-4.0. ";
CM_ SG_ 1661 FirstData2 "TRANSPORT_CANDIDATE: normal-addressing ISO-TP. PSA-RE bits 4.7-4.0. ";
CM_ SG_ 1661 UnknownData3 "TRANSPORT_CANDIDATE: normal-addressing ISO-TP. PSA-RE bits 4.7-4.0. ";
CM_ SG_ 1661 ConsecutiveData3 "TRANSPORT_CANDIDATE: normal-addressing ISO-TP. PSA-RE bits 4.7-4.0. ";
CM_ SG_ 1661 SingleData3 "TRANSPORT_CANDIDATE: normal-addressing ISO-TP. PSA-RE bits 4.7-4.0. ";
CM_ SG_ 1661 FirstData1 "TRANSPORT_CANDIDATE: normal-addressing ISO-TP. PSA-RE bits 3.7-3.0. ";
CM_ SG_ 1661 UnknownData2 "TRANSPORT_CANDIDATE: normal-addressing ISO-TP. PSA-RE bits 3.7-3.0. ";
CM_ SG_ 1661 ConsecutiveData2 "TRANSPORT_CANDIDATE: normal-addressing ISO-TP. PSA-RE bits 3.7-3.0. ";
CM_ SG_ 1661 SingleData2 "TRANSPORT_CANDIDATE: normal-addressing ISO-TP. PSA-RE bits 3.7-3.0. ";
CM_ SG_ 1661 SeparationTimeRaw "TRANSPORT_CANDIDATE: normal-addressing ISO-TP. PSA-RE bits 3.7-3.0. Raw STmin code; 0xF1..0xF9 are not milliseconds.";
CM_ SG_ 1661 UnknownData1 "TRANSPORT_CANDIDATE: normal-addressing ISO-TP. PSA-RE bits 2.7-2.0. ";
CM_ SG_ 1661 ConsecutiveData1 "TRANSPORT_CANDIDATE: normal-addressing ISO-TP. PSA-RE bits 2.7-2.0. ";
CM_ SG_ 1661 SingleData1 "TRANSPORT_CANDIDATE: normal-addressing ISO-TP. PSA-RE bits 2.7-2.0. ";
CM_ SG_ 1661 BlockSize "TRANSPORT_CANDIDATE: normal-addressing ISO-TP. PSA-RE bits 2.7-2.0. ";
CM_ SG_ 1661 UnknownPciLow "TRANSPORT_CANDIDATE: normal-addressing ISO-TP. PSA-RE bits 1.3-1.0. ";
CM_ SG_ 1661 FlowStatus "TRANSPORT_CANDIDATE: normal-addressing ISO-TP. PSA-RE bits 1.3-1.0. ";
CM_ SG_ 1661 ConsecutiveSequence "TRANSPORT_CANDIDATE: normal-addressing ISO-TP. PSA-RE bits 1.3-1.0. ";
CM_ SG_ 1661 FirstFrameLength "TRANSPORT_CANDIDATE: normal-addressing ISO-TP. PSA-RE bits 1.3-2.0. 12-bit declared PDU length; not a reassembled value.";
CM_ SG_ 1661 SingleFrameLength "TRANSPORT_CANDIDATE: normal-addressing ISO-TP. PSA-RE bits 1.3-1.0. Declared data length; not a validity check.";
CM_ SG_ 1661 IsoTpFrameType "TRANSPORT_CANDIDATE: normal-addressing ISO-TP. PSA-RE bits 1.7-1.4. PCI high nibble; normal addressing candidate.";
CM_ BO_ 1736 "DATABASE_CANDIDATE: physical interpretation unverified; capture/layout evidence reported separately. INFO-DIV CAN, 125000 bit/s; CAN ID 0x6C8. PSA-RE title: HDC_VCI_DIAG_REQUEST. Diagnostic request addressed to the HDC_VCI ECU. Source: https://github.com/prototux/PSA-RE/blob/67f7581e7622410efdbb29c7eda3b86982b9b450/buses/AEE2010.full/LS.INFO-DIV/6C8.yml. Source sender alternatives: MDS; physical TX/gateway forwarding not verified. WIRE ISO-TP ONLY: normal addressing candidate, maximum Classical CAN DLC 8; actual DLC may be shorter. Data includes padding. No reassembly, text, DID or application-layer decoding. Original application layouts are preserved in source JSON; do not decode them at wire offsets. ";
CM_ SG_ 1736 FlowPadding5 "TRANSPORT_CANDIDATE: normal-addressing ISO-TP. PSA-RE bits 8.7-8.0. ";
CM_ SG_ 1736 FirstData6 "TRANSPORT_CANDIDATE: normal-addressing ISO-TP. PSA-RE bits 8.7-8.0. ";
CM_ SG_ 1736 UnknownData7 "TRANSPORT_CANDIDATE: normal-addressing ISO-TP. PSA-RE bits 8.7-8.0. ";
CM_ SG_ 1736 ConsecutiveData7 "TRANSPORT_CANDIDATE: normal-addressing ISO-TP. PSA-RE bits 8.7-8.0. ";
CM_ SG_ 1736 SingleData7 "TRANSPORT_CANDIDATE: normal-addressing ISO-TP. PSA-RE bits 8.7-8.0. ";
CM_ SG_ 1736 FlowPadding4 "TRANSPORT_CANDIDATE: normal-addressing ISO-TP. PSA-RE bits 7.7-7.0. ";
CM_ SG_ 1736 FirstData5 "TRANSPORT_CANDIDATE: normal-addressing ISO-TP. PSA-RE bits 7.7-7.0. ";
CM_ SG_ 1736 UnknownData6 "TRANSPORT_CANDIDATE: normal-addressing ISO-TP. PSA-RE bits 7.7-7.0. ";
CM_ SG_ 1736 ConsecutiveData6 "TRANSPORT_CANDIDATE: normal-addressing ISO-TP. PSA-RE bits 7.7-7.0. ";
CM_ SG_ 1736 SingleData6 "TRANSPORT_CANDIDATE: normal-addressing ISO-TP. PSA-RE bits 7.7-7.0. ";
CM_ SG_ 1736 FlowPadding3 "TRANSPORT_CANDIDATE: normal-addressing ISO-TP. PSA-RE bits 6.7-6.0. ";
CM_ SG_ 1736 FirstData4 "TRANSPORT_CANDIDATE: normal-addressing ISO-TP. PSA-RE bits 6.7-6.0. ";
CM_ SG_ 1736 UnknownData5 "TRANSPORT_CANDIDATE: normal-addressing ISO-TP. PSA-RE bits 6.7-6.0. ";
CM_ SG_ 1736 ConsecutiveData5 "TRANSPORT_CANDIDATE: normal-addressing ISO-TP. PSA-RE bits 6.7-6.0. ";
CM_ SG_ 1736 SingleData5 "TRANSPORT_CANDIDATE: normal-addressing ISO-TP. PSA-RE bits 6.7-6.0. ";
CM_ SG_ 1736 FlowPadding2 "TRANSPORT_CANDIDATE: normal-addressing ISO-TP. PSA-RE bits 5.7-5.0. ";
CM_ SG_ 1736 FirstData3 "TRANSPORT_CANDIDATE: normal-addressing ISO-TP. PSA-RE bits 5.7-5.0. ";
CM_ SG_ 1736 UnknownData4 "TRANSPORT_CANDIDATE: normal-addressing ISO-TP. PSA-RE bits 5.7-5.0. ";
CM_ SG_ 1736 ConsecutiveData4 "TRANSPORT_CANDIDATE: normal-addressing ISO-TP. PSA-RE bits 5.7-5.0. ";
CM_ SG_ 1736 SingleData4 "TRANSPORT_CANDIDATE: normal-addressing ISO-TP. PSA-RE bits 5.7-5.0. ";
CM_ SG_ 1736 FlowPadding1 "TRANSPORT_CANDIDATE: normal-addressing ISO-TP. PSA-RE bits 4.7-4.0. ";
CM_ SG_ 1736 FirstData2 "TRANSPORT_CANDIDATE: normal-addressing ISO-TP. PSA-RE bits 4.7-4.0. ";
CM_ SG_ 1736 UnknownData3 "TRANSPORT_CANDIDATE: normal-addressing ISO-TP. PSA-RE bits 4.7-4.0. ";
CM_ SG_ 1736 ConsecutiveData3 "TRANSPORT_CANDIDATE: normal-addressing ISO-TP. PSA-RE bits 4.7-4.0. ";
CM_ SG_ 1736 SingleData3 "TRANSPORT_CANDIDATE: normal-addressing ISO-TP. PSA-RE bits 4.7-4.0. ";
CM_ SG_ 1736 FirstData1 "TRANSPORT_CANDIDATE: normal-addressing ISO-TP. PSA-RE bits 3.7-3.0. ";
CM_ SG_ 1736 UnknownData2 "TRANSPORT_CANDIDATE: normal-addressing ISO-TP. PSA-RE bits 3.7-3.0. ";
CM_ SG_ 1736 ConsecutiveData2 "TRANSPORT_CANDIDATE: normal-addressing ISO-TP. PSA-RE bits 3.7-3.0. ";
CM_ SG_ 1736 SingleData2 "TRANSPORT_CANDIDATE: normal-addressing ISO-TP. PSA-RE bits 3.7-3.0. ";
CM_ SG_ 1736 SeparationTimeRaw "TRANSPORT_CANDIDATE: normal-addressing ISO-TP. PSA-RE bits 3.7-3.0. Raw STmin code; 0xF1..0xF9 are not milliseconds.";
CM_ SG_ 1736 UnknownData1 "TRANSPORT_CANDIDATE: normal-addressing ISO-TP. PSA-RE bits 2.7-2.0. ";
CM_ SG_ 1736 ConsecutiveData1 "TRANSPORT_CANDIDATE: normal-addressing ISO-TP. PSA-RE bits 2.7-2.0. ";
CM_ SG_ 1736 SingleData1 "TRANSPORT_CANDIDATE: normal-addressing ISO-TP. PSA-RE bits 2.7-2.0. ";
CM_ SG_ 1736 BlockSize "TRANSPORT_CANDIDATE: normal-addressing ISO-TP. PSA-RE bits 2.7-2.0. ";
CM_ SG_ 1736 UnknownPciLow "TRANSPORT_CANDIDATE: normal-addressing ISO-TP. PSA-RE bits 1.3-1.0. ";
CM_ SG_ 1736 FlowStatus "TRANSPORT_CANDIDATE: normal-addressing ISO-TP. PSA-RE bits 1.3-1.0. ";
CM_ SG_ 1736 ConsecutiveSequence "TRANSPORT_CANDIDATE: normal-addressing ISO-TP. PSA-RE bits 1.3-1.0. ";
CM_ SG_ 1736 FirstFrameLength "TRANSPORT_CANDIDATE: normal-addressing ISO-TP. PSA-RE bits 1.3-2.0. 12-bit declared PDU length; not a reassembled value.";
CM_ SG_ 1736 SingleFrameLength "TRANSPORT_CANDIDATE: normal-addressing ISO-TP. PSA-RE bits 1.3-1.0. Declared data length; not a validity check.";
CM_ SG_ 1736 IsoTpFrameType "TRANSPORT_CANDIDATE: normal-addressing ISO-TP. PSA-RE bits 1.7-1.4. PCI high nibble; normal addressing candidate.";
CM_ BO_ 1814 "DATABASE_CANDIDATE: physical interpretation unverified; capture/layout evidence reported separately. INFO-DIV CAN, 125000 bit/s; CAN ID 0x716. PSA-RE title: OBJECT06_DATA_3. Diagnostic response sent by the LIN_FMUX ECU. Source: https://github.com/prototux/PSA-RE/blob/67f7581e7622410efdbb29c7eda3b86982b9b450/buses/AEE2010.full/LS.INFO-DIV/716.yml. Source sender alternatives: FMUX; physical TX/gateway forwarding not verified. WIRE ISO-TP ONLY: normal addressing candidate, maximum Classical CAN DLC 8; actual DLC may be shorter. Data includes padding. No reassembly, text, DID or application-layer decoding. Original application layouts are preserved in source JSON; do not decode them at wire offsets. ";
CM_ SG_ 1814 FlowPadding5 "TRANSPORT_CANDIDATE: normal-addressing ISO-TP. PSA-RE bits 8.7-8.0. ";
CM_ SG_ 1814 FirstData6 "TRANSPORT_CANDIDATE: normal-addressing ISO-TP. PSA-RE bits 8.7-8.0. ";
CM_ SG_ 1814 UnknownData7 "TRANSPORT_CANDIDATE: normal-addressing ISO-TP. PSA-RE bits 8.7-8.0. ";
CM_ SG_ 1814 ConsecutiveData7 "TRANSPORT_CANDIDATE: normal-addressing ISO-TP. PSA-RE bits 8.7-8.0. ";
CM_ SG_ 1814 SingleData7 "TRANSPORT_CANDIDATE: normal-addressing ISO-TP. PSA-RE bits 8.7-8.0. ";
CM_ SG_ 1814 FlowPadding4 "TRANSPORT_CANDIDATE: normal-addressing ISO-TP. PSA-RE bits 7.7-7.0. ";
CM_ SG_ 1814 FirstData5 "TRANSPORT_CANDIDATE: normal-addressing ISO-TP. PSA-RE bits 7.7-7.0. ";
CM_ SG_ 1814 UnknownData6 "TRANSPORT_CANDIDATE: normal-addressing ISO-TP. PSA-RE bits 7.7-7.0. ";
CM_ SG_ 1814 ConsecutiveData6 "TRANSPORT_CANDIDATE: normal-addressing ISO-TP. PSA-RE bits 7.7-7.0. ";
CM_ SG_ 1814 SingleData6 "TRANSPORT_CANDIDATE: normal-addressing ISO-TP. PSA-RE bits 7.7-7.0. ";
CM_ SG_ 1814 FlowPadding3 "TRANSPORT_CANDIDATE: normal-addressing ISO-TP. PSA-RE bits 6.7-6.0. ";
CM_ SG_ 1814 FirstData4 "TRANSPORT_CANDIDATE: normal-addressing ISO-TP. PSA-RE bits 6.7-6.0. ";
CM_ SG_ 1814 UnknownData5 "TRANSPORT_CANDIDATE: normal-addressing ISO-TP. PSA-RE bits 6.7-6.0. ";
CM_ SG_ 1814 ConsecutiveData5 "TRANSPORT_CANDIDATE: normal-addressing ISO-TP. PSA-RE bits 6.7-6.0. ";
CM_ SG_ 1814 SingleData5 "TRANSPORT_CANDIDATE: normal-addressing ISO-TP. PSA-RE bits 6.7-6.0. ";
CM_ SG_ 1814 FlowPadding2 "TRANSPORT_CANDIDATE: normal-addressing ISO-TP. PSA-RE bits 5.7-5.0. ";
CM_ SG_ 1814 FirstData3 "TRANSPORT_CANDIDATE: normal-addressing ISO-TP. PSA-RE bits 5.7-5.0. ";
CM_ SG_ 1814 UnknownData4 "TRANSPORT_CANDIDATE: normal-addressing ISO-TP. PSA-RE bits 5.7-5.0. ";
CM_ SG_ 1814 ConsecutiveData4 "TRANSPORT_CANDIDATE: normal-addressing ISO-TP. PSA-RE bits 5.7-5.0. ";
CM_ SG_ 1814 SingleData4 "TRANSPORT_CANDIDATE: normal-addressing ISO-TP. PSA-RE bits 5.7-5.0. ";
CM_ SG_ 1814 FlowPadding1 "TRANSPORT_CANDIDATE: normal-addressing ISO-TP. PSA-RE bits 4.7-4.0. ";
CM_ SG_ 1814 FirstData2 "TRANSPORT_CANDIDATE: normal-addressing ISO-TP. PSA-RE bits 4.7-4.0. ";
CM_ SG_ 1814 UnknownData3 "TRANSPORT_CANDIDATE: normal-addressing ISO-TP. PSA-RE bits 4.7-4.0. ";
CM_ SG_ 1814 ConsecutiveData3 "TRANSPORT_CANDIDATE: normal-addressing ISO-TP. PSA-RE bits 4.7-4.0. ";
CM_ SG_ 1814 SingleData3 "TRANSPORT_CANDIDATE: normal-addressing ISO-TP. PSA-RE bits 4.7-4.0. ";
CM_ SG_ 1814 FirstData1 "TRANSPORT_CANDIDATE: normal-addressing ISO-TP. PSA-RE bits 3.7-3.0. ";
CM_ SG_ 1814 UnknownData2 "TRANSPORT_CANDIDATE: normal-addressing ISO-TP. PSA-RE bits 3.7-3.0. ";
CM_ SG_ 1814 ConsecutiveData2 "TRANSPORT_CANDIDATE: normal-addressing ISO-TP. PSA-RE bits 3.7-3.0. ";
CM_ SG_ 1814 SingleData2 "TRANSPORT_CANDIDATE: normal-addressing ISO-TP. PSA-RE bits 3.7-3.0. ";
CM_ SG_ 1814 SeparationTimeRaw "TRANSPORT_CANDIDATE: normal-addressing ISO-TP. PSA-RE bits 3.7-3.0. Raw STmin code; 0xF1..0xF9 are not milliseconds.";
CM_ SG_ 1814 UnknownData1 "TRANSPORT_CANDIDATE: normal-addressing ISO-TP. PSA-RE bits 2.7-2.0. ";
CM_ SG_ 1814 ConsecutiveData1 "TRANSPORT_CANDIDATE: normal-addressing ISO-TP. PSA-RE bits 2.7-2.0. ";
CM_ SG_ 1814 SingleData1 "TRANSPORT_CANDIDATE: normal-addressing ISO-TP. PSA-RE bits 2.7-2.0. ";
CM_ SG_ 1814 BlockSize "TRANSPORT_CANDIDATE: normal-addressing ISO-TP. PSA-RE bits 2.7-2.0. ";
CM_ SG_ 1814 UnknownPciLow "TRANSPORT_CANDIDATE: normal-addressing ISO-TP. PSA-RE bits 1.3-1.0. ";
CM_ SG_ 1814 FlowStatus "TRANSPORT_CANDIDATE: normal-addressing ISO-TP. PSA-RE bits 1.3-1.0. ";
CM_ SG_ 1814 ConsecutiveSequence "TRANSPORT_CANDIDATE: normal-addressing ISO-TP. PSA-RE bits 1.3-1.0. ";
CM_ SG_ 1814 FirstFrameLength "TRANSPORT_CANDIDATE: normal-addressing ISO-TP. PSA-RE bits 1.3-2.0. 12-bit declared PDU length; not a reassembled value.";
CM_ SG_ 1814 SingleFrameLength "TRANSPORT_CANDIDATE: normal-addressing ISO-TP. PSA-RE bits 1.3-1.0. Declared data length; not a validity check.";
CM_ SG_ 1814 IsoTpFrameType "TRANSPORT_CANDIDATE: normal-addressing ISO-TP. PSA-RE bits 1.7-1.4. PCI high nibble; normal addressing candidate.";
CM_ BO_ 1816 "DATABASE_CANDIDATE: physical interpretation unverified; capture/layout evidence reported separately. INFO-DIV CAN, 125000 bit/s; CAN ID 0x718. PSA-RE title: OBJECT07_DATA. Diagnostic response sent by the LIN_CMB ECU. Source: https://github.com/prototux/PSA-RE/blob/67f7581e7622410efdbb29c7eda3b86982b9b450/buses/AEE2010.full/LS.INFO-DIV/718.yml. Source sender alternatives: CMB; physical TX/gateway forwarding not verified. WIRE ISO-TP ONLY: normal addressing candidate, maximum Classical CAN DLC 8; actual DLC may be shorter. Data includes padding. No reassembly, text, DID or application-layer decoding. Original application layouts are preserved in source JSON; do not decode them at wire offsets. Unresolved alternative source layouts preserved in source JSON. ";
CM_ SG_ 1816 FlowPadding5 "TRANSPORT_CANDIDATE: normal-addressing ISO-TP. PSA-RE bits 8.7-8.0. ";
CM_ SG_ 1816 FirstData6 "TRANSPORT_CANDIDATE: normal-addressing ISO-TP. PSA-RE bits 8.7-8.0. ";
CM_ SG_ 1816 UnknownData7 "TRANSPORT_CANDIDATE: normal-addressing ISO-TP. PSA-RE bits 8.7-8.0. ";
CM_ SG_ 1816 ConsecutiveData7 "TRANSPORT_CANDIDATE: normal-addressing ISO-TP. PSA-RE bits 8.7-8.0. ";
CM_ SG_ 1816 SingleData7 "TRANSPORT_CANDIDATE: normal-addressing ISO-TP. PSA-RE bits 8.7-8.0. ";
CM_ SG_ 1816 FlowPadding4 "TRANSPORT_CANDIDATE: normal-addressing ISO-TP. PSA-RE bits 7.7-7.0. ";
CM_ SG_ 1816 FirstData5 "TRANSPORT_CANDIDATE: normal-addressing ISO-TP. PSA-RE bits 7.7-7.0. ";
CM_ SG_ 1816 UnknownData6 "TRANSPORT_CANDIDATE: normal-addressing ISO-TP. PSA-RE bits 7.7-7.0. ";
CM_ SG_ 1816 ConsecutiveData6 "TRANSPORT_CANDIDATE: normal-addressing ISO-TP. PSA-RE bits 7.7-7.0. ";
CM_ SG_ 1816 SingleData6 "TRANSPORT_CANDIDATE: normal-addressing ISO-TP. PSA-RE bits 7.7-7.0. ";
CM_ SG_ 1816 FlowPadding3 "TRANSPORT_CANDIDATE: normal-addressing ISO-TP. PSA-RE bits 6.7-6.0. ";
CM_ SG_ 1816 FirstData4 "TRANSPORT_CANDIDATE: normal-addressing ISO-TP. PSA-RE bits 6.7-6.0. ";
CM_ SG_ 1816 UnknownData5 "TRANSPORT_CANDIDATE: normal-addressing ISO-TP. PSA-RE bits 6.7-6.0. ";
CM_ SG_ 1816 ConsecutiveData5 "TRANSPORT_CANDIDATE: normal-addressing ISO-TP. PSA-RE bits 6.7-6.0. ";
CM_ SG_ 1816 SingleData5 "TRANSPORT_CANDIDATE: normal-addressing ISO-TP. PSA-RE bits 6.7-6.0. ";
CM_ SG_ 1816 FlowPadding2 "TRANSPORT_CANDIDATE: normal-addressing ISO-TP. PSA-RE bits 5.7-5.0. ";
CM_ SG_ 1816 FirstData3 "TRANSPORT_CANDIDATE: normal-addressing ISO-TP. PSA-RE bits 5.7-5.0. ";
CM_ SG_ 1816 UnknownData4 "TRANSPORT_CANDIDATE: normal-addressing ISO-TP. PSA-RE bits 5.7-5.0. ";
CM_ SG_ 1816 ConsecutiveData4 "TRANSPORT_CANDIDATE: normal-addressing ISO-TP. PSA-RE bits 5.7-5.0. ";
CM_ SG_ 1816 SingleData4 "TRANSPORT_CANDIDATE: normal-addressing ISO-TP. PSA-RE bits 5.7-5.0. ";
CM_ SG_ 1816 FlowPadding1 "TRANSPORT_CANDIDATE: normal-addressing ISO-TP. PSA-RE bits 4.7-4.0. ";
CM_ SG_ 1816 FirstData2 "TRANSPORT_CANDIDATE: normal-addressing ISO-TP. PSA-RE bits 4.7-4.0. ";
CM_ SG_ 1816 UnknownData3 "TRANSPORT_CANDIDATE: normal-addressing ISO-TP. PSA-RE bits 4.7-4.0. ";
CM_ SG_ 1816 ConsecutiveData3 "TRANSPORT_CANDIDATE: normal-addressing ISO-TP. PSA-RE bits 4.7-4.0. ";
CM_ SG_ 1816 SingleData3 "TRANSPORT_CANDIDATE: normal-addressing ISO-TP. PSA-RE bits 4.7-4.0. ";
CM_ SG_ 1816 FirstData1 "TRANSPORT_CANDIDATE: normal-addressing ISO-TP. PSA-RE bits 3.7-3.0. ";
CM_ SG_ 1816 UnknownData2 "TRANSPORT_CANDIDATE: normal-addressing ISO-TP. PSA-RE bits 3.7-3.0. ";
CM_ SG_ 1816 ConsecutiveData2 "TRANSPORT_CANDIDATE: normal-addressing ISO-TP. PSA-RE bits 3.7-3.0. ";
CM_ SG_ 1816 SingleData2 "TRANSPORT_CANDIDATE: normal-addressing ISO-TP. PSA-RE bits 3.7-3.0. ";
CM_ SG_ 1816 SeparationTimeRaw "TRANSPORT_CANDIDATE: normal-addressing ISO-TP. PSA-RE bits 3.7-3.0. Raw STmin code; 0xF1..0xF9 are not milliseconds.";
CM_ SG_ 1816 UnknownData1 "TRANSPORT_CANDIDATE: normal-addressing ISO-TP. PSA-RE bits 2.7-2.0. ";
CM_ SG_ 1816 ConsecutiveData1 "TRANSPORT_CANDIDATE: normal-addressing ISO-TP. PSA-RE bits 2.7-2.0. ";
CM_ SG_ 1816 SingleData1 "TRANSPORT_CANDIDATE: normal-addressing ISO-TP. PSA-RE bits 2.7-2.0. ";
CM_ SG_ 1816 BlockSize "TRANSPORT_CANDIDATE: normal-addressing ISO-TP. PSA-RE bits 2.7-2.0. ";
CM_ SG_ 1816 UnknownPciLow "TRANSPORT_CANDIDATE: normal-addressing ISO-TP. PSA-RE bits 1.3-1.0. ";
CM_ SG_ 1816 FlowStatus "TRANSPORT_CANDIDATE: normal-addressing ISO-TP. PSA-RE bits 1.3-1.0. ";
CM_ SG_ 1816 ConsecutiveSequence "TRANSPORT_CANDIDATE: normal-addressing ISO-TP. PSA-RE bits 1.3-1.0. ";
CM_ SG_ 1816 FirstFrameLength "TRANSPORT_CANDIDATE: normal-addressing ISO-TP. PSA-RE bits 1.3-2.0. 12-bit declared PDU length; not a reassembled value.";
CM_ SG_ 1816 SingleFrameLength "TRANSPORT_CANDIDATE: normal-addressing ISO-TP. PSA-RE bits 1.3-1.0. Declared data length; not a validity check.";
CM_ SG_ 1816 IsoTpFrameType "TRANSPORT_CANDIDATE: normal-addressing ISO-TP. PSA-RE bits 1.7-1.4. PCI high nibble; normal addressing candidate.";
CM_ BO_ 1846 "DATABASE_CANDIDATE: physical interpretation unverified; capture/layout evidence reported separately. INFO-DIV CAN, 125000 bit/s; CAN ID 0x736. PSA-RE title: LIN_FMUX_DIAG_REQUEST. Diagnostic request addressed to the LIN_FMUX ECU. Source: https://github.com/prototux/PSA-RE/blob/67f7581e7622410efdbb29c7eda3b86982b9b450/buses/AEE2010.full/LS.INFO-DIV/736.yml. Source sender alternatives: BSI,MDS; physical TX/gateway forwarding not verified. WIRE ISO-TP ONLY: normal addressing candidate, maximum Classical CAN DLC 8; actual DLC may be shorter. Data includes padding. No reassembly, text, DID or application-layer decoding. Original application layouts are preserved in source JSON; do not decode them at wire offsets. ";
CM_ SG_ 1846 FlowPadding5 "TRANSPORT_CANDIDATE: normal-addressing ISO-TP. PSA-RE bits 8.7-8.0. ";
CM_ SG_ 1846 FirstData6 "TRANSPORT_CANDIDATE: normal-addressing ISO-TP. PSA-RE bits 8.7-8.0. ";
CM_ SG_ 1846 UnknownData7 "TRANSPORT_CANDIDATE: normal-addressing ISO-TP. PSA-RE bits 8.7-8.0. ";
CM_ SG_ 1846 ConsecutiveData7 "TRANSPORT_CANDIDATE: normal-addressing ISO-TP. PSA-RE bits 8.7-8.0. ";
CM_ SG_ 1846 SingleData7 "TRANSPORT_CANDIDATE: normal-addressing ISO-TP. PSA-RE bits 8.7-8.0. ";
CM_ SG_ 1846 FlowPadding4 "TRANSPORT_CANDIDATE: normal-addressing ISO-TP. PSA-RE bits 7.7-7.0. ";
CM_ SG_ 1846 FirstData5 "TRANSPORT_CANDIDATE: normal-addressing ISO-TP. PSA-RE bits 7.7-7.0. ";
CM_ SG_ 1846 UnknownData6 "TRANSPORT_CANDIDATE: normal-addressing ISO-TP. PSA-RE bits 7.7-7.0. ";
CM_ SG_ 1846 ConsecutiveData6 "TRANSPORT_CANDIDATE: normal-addressing ISO-TP. PSA-RE bits 7.7-7.0. ";
CM_ SG_ 1846 SingleData6 "TRANSPORT_CANDIDATE: normal-addressing ISO-TP. PSA-RE bits 7.7-7.0. ";
CM_ SG_ 1846 FlowPadding3 "TRANSPORT_CANDIDATE: normal-addressing ISO-TP. PSA-RE bits 6.7-6.0. ";
CM_ SG_ 1846 FirstData4 "TRANSPORT_CANDIDATE: normal-addressing ISO-TP. PSA-RE bits 6.7-6.0. ";
CM_ SG_ 1846 UnknownData5 "TRANSPORT_CANDIDATE: normal-addressing ISO-TP. PSA-RE bits 6.7-6.0. ";
CM_ SG_ 1846 ConsecutiveData5 "TRANSPORT_CANDIDATE: normal-addressing ISO-TP. PSA-RE bits 6.7-6.0. ";
CM_ SG_ 1846 SingleData5 "TRANSPORT_CANDIDATE: normal-addressing ISO-TP. PSA-RE bits 6.7-6.0. ";
CM_ SG_ 1846 FlowPadding2 "TRANSPORT_CANDIDATE: normal-addressing ISO-TP. PSA-RE bits 5.7-5.0. ";
CM_ SG_ 1846 FirstData3 "TRANSPORT_CANDIDATE: normal-addressing ISO-TP. PSA-RE bits 5.7-5.0. ";
CM_ SG_ 1846 UnknownData4 "TRANSPORT_CANDIDATE: normal-addressing ISO-TP. PSA-RE bits 5.7-5.0. ";
CM_ SG_ 1846 ConsecutiveData4 "TRANSPORT_CANDIDATE: normal-addressing ISO-TP. PSA-RE bits 5.7-5.0. ";
CM_ SG_ 1846 SingleData4 "TRANSPORT_CANDIDATE: normal-addressing ISO-TP. PSA-RE bits 5.7-5.0. ";
CM_ SG_ 1846 FlowPadding1 "TRANSPORT_CANDIDATE: normal-addressing ISO-TP. PSA-RE bits 4.7-4.0. ";
CM_ SG_ 1846 FirstData2 "TRANSPORT_CANDIDATE: normal-addressing ISO-TP. PSA-RE bits 4.7-4.0. ";
CM_ SG_ 1846 UnknownData3 "TRANSPORT_CANDIDATE: normal-addressing ISO-TP. PSA-RE bits 4.7-4.0. ";
CM_ SG_ 1846 ConsecutiveData3 "TRANSPORT_CANDIDATE: normal-addressing ISO-TP. PSA-RE bits 4.7-4.0. ";
CM_ SG_ 1846 SingleData3 "TRANSPORT_CANDIDATE: normal-addressing ISO-TP. PSA-RE bits 4.7-4.0. ";
CM_ SG_ 1846 FirstData1 "TRANSPORT_CANDIDATE: normal-addressing ISO-TP. PSA-RE bits 3.7-3.0. ";
CM_ SG_ 1846 UnknownData2 "TRANSPORT_CANDIDATE: normal-addressing ISO-TP. PSA-RE bits 3.7-3.0. ";
CM_ SG_ 1846 ConsecutiveData2 "TRANSPORT_CANDIDATE: normal-addressing ISO-TP. PSA-RE bits 3.7-3.0. ";
CM_ SG_ 1846 SingleData2 "TRANSPORT_CANDIDATE: normal-addressing ISO-TP. PSA-RE bits 3.7-3.0. ";
CM_ SG_ 1846 SeparationTimeRaw "TRANSPORT_CANDIDATE: normal-addressing ISO-TP. PSA-RE bits 3.7-3.0. Raw STmin code; 0xF1..0xF9 are not milliseconds.";
CM_ SG_ 1846 UnknownData1 "TRANSPORT_CANDIDATE: normal-addressing ISO-TP. PSA-RE bits 2.7-2.0. ";
CM_ SG_ 1846 ConsecutiveData1 "TRANSPORT_CANDIDATE: normal-addressing ISO-TP. PSA-RE bits 2.7-2.0. ";
CM_ SG_ 1846 SingleData1 "TRANSPORT_CANDIDATE: normal-addressing ISO-TP. PSA-RE bits 2.7-2.0. ";
CM_ SG_ 1846 BlockSize "TRANSPORT_CANDIDATE: normal-addressing ISO-TP. PSA-RE bits 2.7-2.0. ";
CM_ SG_ 1846 UnknownPciLow "TRANSPORT_CANDIDATE: normal-addressing ISO-TP. PSA-RE bits 1.3-1.0. ";
CM_ SG_ 1846 FlowStatus "TRANSPORT_CANDIDATE: normal-addressing ISO-TP. PSA-RE bits 1.3-1.0. ";
CM_ SG_ 1846 ConsecutiveSequence "TRANSPORT_CANDIDATE: normal-addressing ISO-TP. PSA-RE bits 1.3-1.0. ";
CM_ SG_ 1846 FirstFrameLength "TRANSPORT_CANDIDATE: normal-addressing ISO-TP. PSA-RE bits 1.3-2.0. 12-bit declared PDU length; not a reassembled value.";
CM_ SG_ 1846 SingleFrameLength "TRANSPORT_CANDIDATE: normal-addressing ISO-TP. PSA-RE bits 1.3-1.0. Declared data length; not a validity check.";
CM_ SG_ 1846 IsoTpFrameType "TRANSPORT_CANDIDATE: normal-addressing ISO-TP. PSA-RE bits 1.7-1.4. PCI high nibble; normal addressing candidate.";
CM_ BO_ 1848 "DATABASE_CANDIDATE: physical interpretation unverified; capture/layout evidence reported separately. INFO-DIV CAN, 125000 bit/s; CAN ID 0x738. PSA-RE title: ADAS_OBJECT_15_DATA. Diagnostic request addressed to the LIN_CMB ECU. Source: https://github.com/prototux/PSA-RE/blob/67f7581e7622410efdbb29c7eda3b86982b9b450/buses/AEE2010.full/LS.INFO-DIV/738.yml. Source sender alternatives: BSI,MDS; physical TX/gateway forwarding not verified. WIRE ISO-TP ONLY: normal addressing candidate, maximum Classical CAN DLC 8; actual DLC may be shorter. Data includes padding. No reassembly, text, DID or application-layer decoding. Original application layouts are preserved in source JSON; do not decode them at wire offsets. Unresolved alternative source layouts preserved in source JSON. ";
CM_ SG_ 1848 FlowPadding5 "TRANSPORT_CANDIDATE: normal-addressing ISO-TP. PSA-RE bits 8.7-8.0. ";
CM_ SG_ 1848 FirstData6 "TRANSPORT_CANDIDATE: normal-addressing ISO-TP. PSA-RE bits 8.7-8.0. ";
CM_ SG_ 1848 UnknownData7 "TRANSPORT_CANDIDATE: normal-addressing ISO-TP. PSA-RE bits 8.7-8.0. ";
CM_ SG_ 1848 ConsecutiveData7 "TRANSPORT_CANDIDATE: normal-addressing ISO-TP. PSA-RE bits 8.7-8.0. ";
CM_ SG_ 1848 SingleData7 "TRANSPORT_CANDIDATE: normal-addressing ISO-TP. PSA-RE bits 8.7-8.0. ";
CM_ SG_ 1848 FlowPadding4 "TRANSPORT_CANDIDATE: normal-addressing ISO-TP. PSA-RE bits 7.7-7.0. ";
CM_ SG_ 1848 FirstData5 "TRANSPORT_CANDIDATE: normal-addressing ISO-TP. PSA-RE bits 7.7-7.0. ";
CM_ SG_ 1848 UnknownData6 "TRANSPORT_CANDIDATE: normal-addressing ISO-TP. PSA-RE bits 7.7-7.0. ";
CM_ SG_ 1848 ConsecutiveData6 "TRANSPORT_CANDIDATE: normal-addressing ISO-TP. PSA-RE bits 7.7-7.0. ";
CM_ SG_ 1848 SingleData6 "TRANSPORT_CANDIDATE: normal-addressing ISO-TP. PSA-RE bits 7.7-7.0. ";
CM_ SG_ 1848 FlowPadding3 "TRANSPORT_CANDIDATE: normal-addressing ISO-TP. PSA-RE bits 6.7-6.0. ";
CM_ SG_ 1848 FirstData4 "TRANSPORT_CANDIDATE: normal-addressing ISO-TP. PSA-RE bits 6.7-6.0. ";
CM_ SG_ 1848 UnknownData5 "TRANSPORT_CANDIDATE: normal-addressing ISO-TP. PSA-RE bits 6.7-6.0. ";
CM_ SG_ 1848 ConsecutiveData5 "TRANSPORT_CANDIDATE: normal-addressing ISO-TP. PSA-RE bits 6.7-6.0. ";
CM_ SG_ 1848 SingleData5 "TRANSPORT_CANDIDATE: normal-addressing ISO-TP. PSA-RE bits 6.7-6.0. ";
CM_ SG_ 1848 FlowPadding2 "TRANSPORT_CANDIDATE: normal-addressing ISO-TP. PSA-RE bits 5.7-5.0. ";
CM_ SG_ 1848 FirstData3 "TRANSPORT_CANDIDATE: normal-addressing ISO-TP. PSA-RE bits 5.7-5.0. ";
CM_ SG_ 1848 UnknownData4 "TRANSPORT_CANDIDATE: normal-addressing ISO-TP. PSA-RE bits 5.7-5.0. ";
CM_ SG_ 1848 ConsecutiveData4 "TRANSPORT_CANDIDATE: normal-addressing ISO-TP. PSA-RE bits 5.7-5.0. ";
CM_ SG_ 1848 SingleData4 "TRANSPORT_CANDIDATE: normal-addressing ISO-TP. PSA-RE bits 5.7-5.0. ";
CM_ SG_ 1848 FlowPadding1 "TRANSPORT_CANDIDATE: normal-addressing ISO-TP. PSA-RE bits 4.7-4.0. ";
CM_ SG_ 1848 FirstData2 "TRANSPORT_CANDIDATE: normal-addressing ISO-TP. PSA-RE bits 4.7-4.0. ";
CM_ SG_ 1848 UnknownData3 "TRANSPORT_CANDIDATE: normal-addressing ISO-TP. PSA-RE bits 4.7-4.0. ";
CM_ SG_ 1848 ConsecutiveData3 "TRANSPORT_CANDIDATE: normal-addressing ISO-TP. PSA-RE bits 4.7-4.0. ";
CM_ SG_ 1848 SingleData3 "TRANSPORT_CANDIDATE: normal-addressing ISO-TP. PSA-RE bits 4.7-4.0. ";
CM_ SG_ 1848 FirstData1 "TRANSPORT_CANDIDATE: normal-addressing ISO-TP. PSA-RE bits 3.7-3.0. ";
CM_ SG_ 1848 UnknownData2 "TRANSPORT_CANDIDATE: normal-addressing ISO-TP. PSA-RE bits 3.7-3.0. ";
CM_ SG_ 1848 ConsecutiveData2 "TRANSPORT_CANDIDATE: normal-addressing ISO-TP. PSA-RE bits 3.7-3.0. ";
CM_ SG_ 1848 SingleData2 "TRANSPORT_CANDIDATE: normal-addressing ISO-TP. PSA-RE bits 3.7-3.0. ";
CM_ SG_ 1848 SeparationTimeRaw "TRANSPORT_CANDIDATE: normal-addressing ISO-TP. PSA-RE bits 3.7-3.0. Raw STmin code; 0xF1..0xF9 are not milliseconds.";
CM_ SG_ 1848 UnknownData1 "TRANSPORT_CANDIDATE: normal-addressing ISO-TP. PSA-RE bits 2.7-2.0. ";
CM_ SG_ 1848 ConsecutiveData1 "TRANSPORT_CANDIDATE: normal-addressing ISO-TP. PSA-RE bits 2.7-2.0. ";
CM_ SG_ 1848 SingleData1 "TRANSPORT_CANDIDATE: normal-addressing ISO-TP. PSA-RE bits 2.7-2.0. ";
CM_ SG_ 1848 BlockSize "TRANSPORT_CANDIDATE: normal-addressing ISO-TP. PSA-RE bits 2.7-2.0. ";
CM_ SG_ 1848 UnknownPciLow "TRANSPORT_CANDIDATE: normal-addressing ISO-TP. PSA-RE bits 1.3-1.0. ";
CM_ SG_ 1848 FlowStatus "TRANSPORT_CANDIDATE: normal-addressing ISO-TP. PSA-RE bits 1.3-1.0. ";
CM_ SG_ 1848 ConsecutiveSequence "TRANSPORT_CANDIDATE: normal-addressing ISO-TP. PSA-RE bits 1.3-1.0. ";
CM_ SG_ 1848 FirstFrameLength "TRANSPORT_CANDIDATE: normal-addressing ISO-TP. PSA-RE bits 1.3-2.0. 12-bit declared PDU length; not a reassembled value.";
CM_ SG_ 1848 SingleFrameLength "TRANSPORT_CANDIDATE: normal-addressing ISO-TP. PSA-RE bits 1.3-1.0. Declared data length; not a validity check.";
CM_ SG_ 1848 IsoTpFrameType "TRANSPORT_CANDIDATE: normal-addressing ISO-TP. PSA-RE bits 1.7-1.4. PCI high nibble; normal addressing candidate.";
CM_ BO_ 1857 "DATABASE_CANDIDATE: physical interpretation unverified; capture/layout evidence reported separately. INFO-DIV CAN, 125000 bit/s; CAN ID 0x741. PSA-RE title: BML_DIAG_REQUEST_2. Diagnostic request addressed to the BML ECU. Source: https://github.com/prototux/PSA-RE/blob/67f7581e7622410efdbb29c7eda3b86982b9b450/buses/AEE2010.full/LS.INFO-DIV/741_BML_DIAG_REQUEST_2.yml. Source sender alternatives: MDS; physical TX/gateway forwarding not verified. WIRE ISO-TP ONLY: normal addressing candidate, maximum Classical CAN DLC 8; actual DLC may be shorter. Data includes padding. No reassembly, text, DID or application-layer decoding. Original application layouts are preserved in source JSON; do not decode them at wire offsets. Unresolved alternative source layouts preserved in source JSON. ";
CM_ SG_ 1857 FlowPadding5 "TRANSPORT_CANDIDATE: normal-addressing ISO-TP. PSA-RE bits 8.7-8.0. ";
CM_ SG_ 1857 FirstData6 "TRANSPORT_CANDIDATE: normal-addressing ISO-TP. PSA-RE bits 8.7-8.0. ";
CM_ SG_ 1857 UnknownData7 "TRANSPORT_CANDIDATE: normal-addressing ISO-TP. PSA-RE bits 8.7-8.0. ";
CM_ SG_ 1857 ConsecutiveData7 "TRANSPORT_CANDIDATE: normal-addressing ISO-TP. PSA-RE bits 8.7-8.0. ";
CM_ SG_ 1857 SingleData7 "TRANSPORT_CANDIDATE: normal-addressing ISO-TP. PSA-RE bits 8.7-8.0. ";
CM_ SG_ 1857 FlowPadding4 "TRANSPORT_CANDIDATE: normal-addressing ISO-TP. PSA-RE bits 7.7-7.0. ";
CM_ SG_ 1857 FirstData5 "TRANSPORT_CANDIDATE: normal-addressing ISO-TP. PSA-RE bits 7.7-7.0. ";
CM_ SG_ 1857 UnknownData6 "TRANSPORT_CANDIDATE: normal-addressing ISO-TP. PSA-RE bits 7.7-7.0. ";
CM_ SG_ 1857 ConsecutiveData6 "TRANSPORT_CANDIDATE: normal-addressing ISO-TP. PSA-RE bits 7.7-7.0. ";
CM_ SG_ 1857 SingleData6 "TRANSPORT_CANDIDATE: normal-addressing ISO-TP. PSA-RE bits 7.7-7.0. ";
CM_ SG_ 1857 FlowPadding3 "TRANSPORT_CANDIDATE: normal-addressing ISO-TP. PSA-RE bits 6.7-6.0. ";
CM_ SG_ 1857 FirstData4 "TRANSPORT_CANDIDATE: normal-addressing ISO-TP. PSA-RE bits 6.7-6.0. ";
CM_ SG_ 1857 UnknownData5 "TRANSPORT_CANDIDATE: normal-addressing ISO-TP. PSA-RE bits 6.7-6.0. ";
CM_ SG_ 1857 ConsecutiveData5 "TRANSPORT_CANDIDATE: normal-addressing ISO-TP. PSA-RE bits 6.7-6.0. ";
CM_ SG_ 1857 SingleData5 "TRANSPORT_CANDIDATE: normal-addressing ISO-TP. PSA-RE bits 6.7-6.0. ";
CM_ SG_ 1857 FlowPadding2 "TRANSPORT_CANDIDATE: normal-addressing ISO-TP. PSA-RE bits 5.7-5.0. ";
CM_ SG_ 1857 FirstData3 "TRANSPORT_CANDIDATE: normal-addressing ISO-TP. PSA-RE bits 5.7-5.0. ";
CM_ SG_ 1857 UnknownData4 "TRANSPORT_CANDIDATE: normal-addressing ISO-TP. PSA-RE bits 5.7-5.0. ";
CM_ SG_ 1857 ConsecutiveData4 "TRANSPORT_CANDIDATE: normal-addressing ISO-TP. PSA-RE bits 5.7-5.0. ";
CM_ SG_ 1857 SingleData4 "TRANSPORT_CANDIDATE: normal-addressing ISO-TP. PSA-RE bits 5.7-5.0. ";
CM_ SG_ 1857 FlowPadding1 "TRANSPORT_CANDIDATE: normal-addressing ISO-TP. PSA-RE bits 4.7-4.0. ";
CM_ SG_ 1857 FirstData2 "TRANSPORT_CANDIDATE: normal-addressing ISO-TP. PSA-RE bits 4.7-4.0. ";
CM_ SG_ 1857 UnknownData3 "TRANSPORT_CANDIDATE: normal-addressing ISO-TP. PSA-RE bits 4.7-4.0. ";
CM_ SG_ 1857 ConsecutiveData3 "TRANSPORT_CANDIDATE: normal-addressing ISO-TP. PSA-RE bits 4.7-4.0. ";
CM_ SG_ 1857 SingleData3 "TRANSPORT_CANDIDATE: normal-addressing ISO-TP. PSA-RE bits 4.7-4.0. ";
CM_ SG_ 1857 FirstData1 "TRANSPORT_CANDIDATE: normal-addressing ISO-TP. PSA-RE bits 3.7-3.0. ";
CM_ SG_ 1857 UnknownData2 "TRANSPORT_CANDIDATE: normal-addressing ISO-TP. PSA-RE bits 3.7-3.0. ";
CM_ SG_ 1857 ConsecutiveData2 "TRANSPORT_CANDIDATE: normal-addressing ISO-TP. PSA-RE bits 3.7-3.0. ";
CM_ SG_ 1857 SingleData2 "TRANSPORT_CANDIDATE: normal-addressing ISO-TP. PSA-RE bits 3.7-3.0. ";
CM_ SG_ 1857 SeparationTimeRaw "TRANSPORT_CANDIDATE: normal-addressing ISO-TP. PSA-RE bits 3.7-3.0. Raw STmin code; 0xF1..0xF9 are not milliseconds.";
CM_ SG_ 1857 UnknownData1 "TRANSPORT_CANDIDATE: normal-addressing ISO-TP. PSA-RE bits 2.7-2.0. ";
CM_ SG_ 1857 ConsecutiveData1 "TRANSPORT_CANDIDATE: normal-addressing ISO-TP. PSA-RE bits 2.7-2.0. ";
CM_ SG_ 1857 SingleData1 "TRANSPORT_CANDIDATE: normal-addressing ISO-TP. PSA-RE bits 2.7-2.0. ";
CM_ SG_ 1857 BlockSize "TRANSPORT_CANDIDATE: normal-addressing ISO-TP. PSA-RE bits 2.7-2.0. ";
CM_ SG_ 1857 UnknownPciLow "TRANSPORT_CANDIDATE: normal-addressing ISO-TP. PSA-RE bits 1.3-1.0. ";
CM_ SG_ 1857 FlowStatus "TRANSPORT_CANDIDATE: normal-addressing ISO-TP. PSA-RE bits 1.3-1.0. ";
CM_ SG_ 1857 ConsecutiveSequence "TRANSPORT_CANDIDATE: normal-addressing ISO-TP. PSA-RE bits 1.3-1.0. ";
CM_ SG_ 1857 FirstFrameLength "TRANSPORT_CANDIDATE: normal-addressing ISO-TP. PSA-RE bits 1.3-2.0. 12-bit declared PDU length; not a reassembled value.";
CM_ SG_ 1857 SingleFrameLength "TRANSPORT_CANDIDATE: normal-addressing ISO-TP. PSA-RE bits 1.3-1.0. Declared data length; not a validity check.";
CM_ SG_ 1857 IsoTpFrameType "TRANSPORT_CANDIDATE: normal-addressing ISO-TP. PSA-RE bits 1.7-1.4. PCI high nibble; normal addressing candidate.";
CM_ BO_ 1858 "DATABASE_CANDIDATE: physical interpretation unverified; capture/layout evidence reported separately. INFO-DIV CAN, 125000 bit/s; CAN ID 0x742. PSA-RE title: HDC_DIAG_REQUEST. Diagnostic request addressed to the HDC ECU. Source: https://github.com/prototux/PSA-RE/blob/67f7581e7622410efdbb29c7eda3b86982b9b450/buses/AEE2010.full/LS.INFO-DIV/742.yml. Source sender alternatives: MDS; physical TX/gateway forwarding not verified. WIRE ISO-TP ONLY: normal addressing candidate, maximum Classical CAN DLC 8; actual DLC may be shorter. Data includes padding. No reassembly, text, DID or application-layer decoding. Original application layouts are preserved in source JSON; do not decode them at wire offsets. ";
CM_ SG_ 1858 FlowPadding5 "TRANSPORT_CANDIDATE: normal-addressing ISO-TP. PSA-RE bits 8.7-8.0. ";
CM_ SG_ 1858 FirstData6 "TRANSPORT_CANDIDATE: normal-addressing ISO-TP. PSA-RE bits 8.7-8.0. ";
CM_ SG_ 1858 UnknownData7 "TRANSPORT_CANDIDATE: normal-addressing ISO-TP. PSA-RE bits 8.7-8.0. ";
CM_ SG_ 1858 ConsecutiveData7 "TRANSPORT_CANDIDATE: normal-addressing ISO-TP. PSA-RE bits 8.7-8.0. ";
CM_ SG_ 1858 SingleData7 "TRANSPORT_CANDIDATE: normal-addressing ISO-TP. PSA-RE bits 8.7-8.0. ";
CM_ SG_ 1858 FlowPadding4 "TRANSPORT_CANDIDATE: normal-addressing ISO-TP. PSA-RE bits 7.7-7.0. ";
CM_ SG_ 1858 FirstData5 "TRANSPORT_CANDIDATE: normal-addressing ISO-TP. PSA-RE bits 7.7-7.0. ";
CM_ SG_ 1858 UnknownData6 "TRANSPORT_CANDIDATE: normal-addressing ISO-TP. PSA-RE bits 7.7-7.0. ";
CM_ SG_ 1858 ConsecutiveData6 "TRANSPORT_CANDIDATE: normal-addressing ISO-TP. PSA-RE bits 7.7-7.0. ";
CM_ SG_ 1858 SingleData6 "TRANSPORT_CANDIDATE: normal-addressing ISO-TP. PSA-RE bits 7.7-7.0. ";
CM_ SG_ 1858 FlowPadding3 "TRANSPORT_CANDIDATE: normal-addressing ISO-TP. PSA-RE bits 6.7-6.0. ";
CM_ SG_ 1858 FirstData4 "TRANSPORT_CANDIDATE: normal-addressing ISO-TP. PSA-RE bits 6.7-6.0. ";
CM_ SG_ 1858 UnknownData5 "TRANSPORT_CANDIDATE: normal-addressing ISO-TP. PSA-RE bits 6.7-6.0. ";
CM_ SG_ 1858 ConsecutiveData5 "TRANSPORT_CANDIDATE: normal-addressing ISO-TP. PSA-RE bits 6.7-6.0. ";
CM_ SG_ 1858 SingleData5 "TRANSPORT_CANDIDATE: normal-addressing ISO-TP. PSA-RE bits 6.7-6.0. ";
CM_ SG_ 1858 FlowPadding2 "TRANSPORT_CANDIDATE: normal-addressing ISO-TP. PSA-RE bits 5.7-5.0. ";
CM_ SG_ 1858 FirstData3 "TRANSPORT_CANDIDATE: normal-addressing ISO-TP. PSA-RE bits 5.7-5.0. ";
CM_ SG_ 1858 UnknownData4 "TRANSPORT_CANDIDATE: normal-addressing ISO-TP. PSA-RE bits 5.7-5.0. ";
CM_ SG_ 1858 ConsecutiveData4 "TRANSPORT_CANDIDATE: normal-addressing ISO-TP. PSA-RE bits 5.7-5.0. ";
CM_ SG_ 1858 SingleData4 "TRANSPORT_CANDIDATE: normal-addressing ISO-TP. PSA-RE bits 5.7-5.0. ";
CM_ SG_ 1858 FlowPadding1 "TRANSPORT_CANDIDATE: normal-addressing ISO-TP. PSA-RE bits 4.7-4.0. ";
CM_ SG_ 1858 FirstData2 "TRANSPORT_CANDIDATE: normal-addressing ISO-TP. PSA-RE bits 4.7-4.0. ";
CM_ SG_ 1858 UnknownData3 "TRANSPORT_CANDIDATE: normal-addressing ISO-TP. PSA-RE bits 4.7-4.0. ";
CM_ SG_ 1858 ConsecutiveData3 "TRANSPORT_CANDIDATE: normal-addressing ISO-TP. PSA-RE bits 4.7-4.0. ";
CM_ SG_ 1858 SingleData3 "TRANSPORT_CANDIDATE: normal-addressing ISO-TP. PSA-RE bits 4.7-4.0. ";
CM_ SG_ 1858 FirstData1 "TRANSPORT_CANDIDATE: normal-addressing ISO-TP. PSA-RE bits 3.7-3.0. ";
CM_ SG_ 1858 UnknownData2 "TRANSPORT_CANDIDATE: normal-addressing ISO-TP. PSA-RE bits 3.7-3.0. ";
CM_ SG_ 1858 ConsecutiveData2 "TRANSPORT_CANDIDATE: normal-addressing ISO-TP. PSA-RE bits 3.7-3.0. ";
CM_ SG_ 1858 SingleData2 "TRANSPORT_CANDIDATE: normal-addressing ISO-TP. PSA-RE bits 3.7-3.0. ";
CM_ SG_ 1858 SeparationTimeRaw "TRANSPORT_CANDIDATE: normal-addressing ISO-TP. PSA-RE bits 3.7-3.0. Raw STmin code; 0xF1..0xF9 are not milliseconds.";
CM_ SG_ 1858 UnknownData1 "TRANSPORT_CANDIDATE: normal-addressing ISO-TP. PSA-RE bits 2.7-2.0. ";
CM_ SG_ 1858 ConsecutiveData1 "TRANSPORT_CANDIDATE: normal-addressing ISO-TP. PSA-RE bits 2.7-2.0. ";
CM_ SG_ 1858 SingleData1 "TRANSPORT_CANDIDATE: normal-addressing ISO-TP. PSA-RE bits 2.7-2.0. ";
CM_ SG_ 1858 BlockSize "TRANSPORT_CANDIDATE: normal-addressing ISO-TP. PSA-RE bits 2.7-2.0. ";
CM_ SG_ 1858 UnknownPciLow "TRANSPORT_CANDIDATE: normal-addressing ISO-TP. PSA-RE bits 1.3-1.0. ";
CM_ SG_ 1858 FlowStatus "TRANSPORT_CANDIDATE: normal-addressing ISO-TP. PSA-RE bits 1.3-1.0. ";
CM_ SG_ 1858 ConsecutiveSequence "TRANSPORT_CANDIDATE: normal-addressing ISO-TP. PSA-RE bits 1.3-1.0. ";
CM_ SG_ 1858 FirstFrameLength "TRANSPORT_CANDIDATE: normal-addressing ISO-TP. PSA-RE bits 1.3-2.0. 12-bit declared PDU length; not a reassembled value.";
CM_ SG_ 1858 SingleFrameLength "TRANSPORT_CANDIDATE: normal-addressing ISO-TP. PSA-RE bits 1.3-1.0. Declared data length; not a validity check.";
CM_ SG_ 1858 IsoTpFrameType "TRANSPORT_CANDIDATE: normal-addressing ISO-TP. PSA-RE bits 1.7-1.4. PCI high nibble; normal addressing candidate.";
CM_ BO_ 1860 "DATABASE_CANDIDATE: physical interpretation unverified; capture/layout evidence reported separately. INFO-DIV CAN, 125000 bit/s; CAN ID 0x744. PSA-RE title: ON_CAN_DIAG_REQUEST_30. Diagnostic request addressed to the RBG ECU. Source: https://github.com/prototux/PSA-RE/blob/67f7581e7622410efdbb29c7eda3b86982b9b450/buses/AEE2010.full/LS.INFO-DIV/744.yml. Source sender alternatives: MDS; physical TX/gateway forwarding not verified. WIRE ISO-TP ONLY: normal addressing candidate, maximum Classical CAN DLC 8; actual DLC may be shorter. Data includes padding. No reassembly, text, DID or application-layer decoding. Original application layouts are preserved in source JSON; do not decode them at wire offsets. ";
CM_ SG_ 1860 FlowPadding5 "TRANSPORT_CANDIDATE: normal-addressing ISO-TP. PSA-RE bits 8.7-8.0. ";
CM_ SG_ 1860 FirstData6 "TRANSPORT_CANDIDATE: normal-addressing ISO-TP. PSA-RE bits 8.7-8.0. ";
CM_ SG_ 1860 UnknownData7 "TRANSPORT_CANDIDATE: normal-addressing ISO-TP. PSA-RE bits 8.7-8.0. ";
CM_ SG_ 1860 ConsecutiveData7 "TRANSPORT_CANDIDATE: normal-addressing ISO-TP. PSA-RE bits 8.7-8.0. ";
CM_ SG_ 1860 SingleData7 "TRANSPORT_CANDIDATE: normal-addressing ISO-TP. PSA-RE bits 8.7-8.0. ";
CM_ SG_ 1860 FlowPadding4 "TRANSPORT_CANDIDATE: normal-addressing ISO-TP. PSA-RE bits 7.7-7.0. ";
CM_ SG_ 1860 FirstData5 "TRANSPORT_CANDIDATE: normal-addressing ISO-TP. PSA-RE bits 7.7-7.0. ";
CM_ SG_ 1860 UnknownData6 "TRANSPORT_CANDIDATE: normal-addressing ISO-TP. PSA-RE bits 7.7-7.0. ";
CM_ SG_ 1860 ConsecutiveData6 "TRANSPORT_CANDIDATE: normal-addressing ISO-TP. PSA-RE bits 7.7-7.0. ";
CM_ SG_ 1860 SingleData6 "TRANSPORT_CANDIDATE: normal-addressing ISO-TP. PSA-RE bits 7.7-7.0. ";
CM_ SG_ 1860 FlowPadding3 "TRANSPORT_CANDIDATE: normal-addressing ISO-TP. PSA-RE bits 6.7-6.0. ";
CM_ SG_ 1860 FirstData4 "TRANSPORT_CANDIDATE: normal-addressing ISO-TP. PSA-RE bits 6.7-6.0. ";
CM_ SG_ 1860 UnknownData5 "TRANSPORT_CANDIDATE: normal-addressing ISO-TP. PSA-RE bits 6.7-6.0. ";
CM_ SG_ 1860 ConsecutiveData5 "TRANSPORT_CANDIDATE: normal-addressing ISO-TP. PSA-RE bits 6.7-6.0. ";
CM_ SG_ 1860 SingleData5 "TRANSPORT_CANDIDATE: normal-addressing ISO-TP. PSA-RE bits 6.7-6.0. ";
CM_ SG_ 1860 FlowPadding2 "TRANSPORT_CANDIDATE: normal-addressing ISO-TP. PSA-RE bits 5.7-5.0. ";
CM_ SG_ 1860 FirstData3 "TRANSPORT_CANDIDATE: normal-addressing ISO-TP. PSA-RE bits 5.7-5.0. ";
CM_ SG_ 1860 UnknownData4 "TRANSPORT_CANDIDATE: normal-addressing ISO-TP. PSA-RE bits 5.7-5.0. ";
CM_ SG_ 1860 ConsecutiveData4 "TRANSPORT_CANDIDATE: normal-addressing ISO-TP. PSA-RE bits 5.7-5.0. ";
CM_ SG_ 1860 SingleData4 "TRANSPORT_CANDIDATE: normal-addressing ISO-TP. PSA-RE bits 5.7-5.0. ";
CM_ SG_ 1860 FlowPadding1 "TRANSPORT_CANDIDATE: normal-addressing ISO-TP. PSA-RE bits 4.7-4.0. ";
CM_ SG_ 1860 FirstData2 "TRANSPORT_CANDIDATE: normal-addressing ISO-TP. PSA-RE bits 4.7-4.0. ";
CM_ SG_ 1860 UnknownData3 "TRANSPORT_CANDIDATE: normal-addressing ISO-TP. PSA-RE bits 4.7-4.0. ";
CM_ SG_ 1860 ConsecutiveData3 "TRANSPORT_CANDIDATE: normal-addressing ISO-TP. PSA-RE bits 4.7-4.0. ";
CM_ SG_ 1860 SingleData3 "TRANSPORT_CANDIDATE: normal-addressing ISO-TP. PSA-RE bits 4.7-4.0. ";
CM_ SG_ 1860 FirstData1 "TRANSPORT_CANDIDATE: normal-addressing ISO-TP. PSA-RE bits 3.7-3.0. ";
CM_ SG_ 1860 UnknownData2 "TRANSPORT_CANDIDATE: normal-addressing ISO-TP. PSA-RE bits 3.7-3.0. ";
CM_ SG_ 1860 ConsecutiveData2 "TRANSPORT_CANDIDATE: normal-addressing ISO-TP. PSA-RE bits 3.7-3.0. ";
CM_ SG_ 1860 SingleData2 "TRANSPORT_CANDIDATE: normal-addressing ISO-TP. PSA-RE bits 3.7-3.0. ";
CM_ SG_ 1860 SeparationTimeRaw "TRANSPORT_CANDIDATE: normal-addressing ISO-TP. PSA-RE bits 3.7-3.0. Raw STmin code; 0xF1..0xF9 are not milliseconds.";
CM_ SG_ 1860 UnknownData1 "TRANSPORT_CANDIDATE: normal-addressing ISO-TP. PSA-RE bits 2.7-2.0. ";
CM_ SG_ 1860 ConsecutiveData1 "TRANSPORT_CANDIDATE: normal-addressing ISO-TP. PSA-RE bits 2.7-2.0. ";
CM_ SG_ 1860 SingleData1 "TRANSPORT_CANDIDATE: normal-addressing ISO-TP. PSA-RE bits 2.7-2.0. ";
CM_ SG_ 1860 BlockSize "TRANSPORT_CANDIDATE: normal-addressing ISO-TP. PSA-RE bits 2.7-2.0. ";
CM_ SG_ 1860 UnknownPciLow "TRANSPORT_CANDIDATE: normal-addressing ISO-TP. PSA-RE bits 1.3-1.0. ";
CM_ SG_ 1860 FlowStatus "TRANSPORT_CANDIDATE: normal-addressing ISO-TP. PSA-RE bits 1.3-1.0. ";
CM_ SG_ 1860 ConsecutiveSequence "TRANSPORT_CANDIDATE: normal-addressing ISO-TP. PSA-RE bits 1.3-1.0. ";
CM_ SG_ 1860 FirstFrameLength "TRANSPORT_CANDIDATE: normal-addressing ISO-TP. PSA-RE bits 1.3-2.0. 12-bit declared PDU length; not a reassembled value.";
CM_ SG_ 1860 SingleFrameLength "TRANSPORT_CANDIDATE: normal-addressing ISO-TP. PSA-RE bits 1.3-1.0. Declared data length; not a validity check.";
CM_ SG_ 1860 IsoTpFrameType "TRANSPORT_CANDIDATE: normal-addressing ISO-TP. PSA-RE bits 1.7-1.4. PCI high nibble; normal addressing candidate.";
CM_ BO_ 1861 "DATABASE_CANDIDATE: physical interpretation unverified; capture/layout evidence reported separately. INFO-DIV CAN, 125000 bit/s; CAN ID 0x745. PSA-RE title: LCE_DIAG_REQUEST. Diagnostic request addressed to the LCE ECU. Source: https://github.com/prototux/PSA-RE/blob/67f7581e7622410efdbb29c7eda3b86982b9b450/buses/AEE2010.full/LS.INFO-DIV/745.yml. Source sender alternatives: MDS; physical TX/gateway forwarding not verified. WIRE ISO-TP ONLY: normal addressing candidate, maximum Classical CAN DLC 8; actual DLC may be shorter. Data includes padding. No reassembly, text, DID or application-layer decoding. Original application layouts are preserved in source JSON; do not decode them at wire offsets. ";
CM_ SG_ 1861 FlowPadding5 "TRANSPORT_CANDIDATE: normal-addressing ISO-TP. PSA-RE bits 8.7-8.0. ";
CM_ SG_ 1861 FirstData6 "TRANSPORT_CANDIDATE: normal-addressing ISO-TP. PSA-RE bits 8.7-8.0. ";
CM_ SG_ 1861 UnknownData7 "TRANSPORT_CANDIDATE: normal-addressing ISO-TP. PSA-RE bits 8.7-8.0. ";
CM_ SG_ 1861 ConsecutiveData7 "TRANSPORT_CANDIDATE: normal-addressing ISO-TP. PSA-RE bits 8.7-8.0. ";
CM_ SG_ 1861 SingleData7 "TRANSPORT_CANDIDATE: normal-addressing ISO-TP. PSA-RE bits 8.7-8.0. ";
CM_ SG_ 1861 FlowPadding4 "TRANSPORT_CANDIDATE: normal-addressing ISO-TP. PSA-RE bits 7.7-7.0. ";
CM_ SG_ 1861 FirstData5 "TRANSPORT_CANDIDATE: normal-addressing ISO-TP. PSA-RE bits 7.7-7.0. ";
CM_ SG_ 1861 UnknownData6 "TRANSPORT_CANDIDATE: normal-addressing ISO-TP. PSA-RE bits 7.7-7.0. ";
CM_ SG_ 1861 ConsecutiveData6 "TRANSPORT_CANDIDATE: normal-addressing ISO-TP. PSA-RE bits 7.7-7.0. ";
CM_ SG_ 1861 SingleData6 "TRANSPORT_CANDIDATE: normal-addressing ISO-TP. PSA-RE bits 7.7-7.0. ";
CM_ SG_ 1861 FlowPadding3 "TRANSPORT_CANDIDATE: normal-addressing ISO-TP. PSA-RE bits 6.7-6.0. ";
CM_ SG_ 1861 FirstData4 "TRANSPORT_CANDIDATE: normal-addressing ISO-TP. PSA-RE bits 6.7-6.0. ";
CM_ SG_ 1861 UnknownData5 "TRANSPORT_CANDIDATE: normal-addressing ISO-TP. PSA-RE bits 6.7-6.0. ";
CM_ SG_ 1861 ConsecutiveData5 "TRANSPORT_CANDIDATE: normal-addressing ISO-TP. PSA-RE bits 6.7-6.0. ";
CM_ SG_ 1861 SingleData5 "TRANSPORT_CANDIDATE: normal-addressing ISO-TP. PSA-RE bits 6.7-6.0. ";
CM_ SG_ 1861 FlowPadding2 "TRANSPORT_CANDIDATE: normal-addressing ISO-TP. PSA-RE bits 5.7-5.0. ";
CM_ SG_ 1861 FirstData3 "TRANSPORT_CANDIDATE: normal-addressing ISO-TP. PSA-RE bits 5.7-5.0. ";
CM_ SG_ 1861 UnknownData4 "TRANSPORT_CANDIDATE: normal-addressing ISO-TP. PSA-RE bits 5.7-5.0. ";
CM_ SG_ 1861 ConsecutiveData4 "TRANSPORT_CANDIDATE: normal-addressing ISO-TP. PSA-RE bits 5.7-5.0. ";
CM_ SG_ 1861 SingleData4 "TRANSPORT_CANDIDATE: normal-addressing ISO-TP. PSA-RE bits 5.7-5.0. ";
CM_ SG_ 1861 FlowPadding1 "TRANSPORT_CANDIDATE: normal-addressing ISO-TP. PSA-RE bits 4.7-4.0. ";
CM_ SG_ 1861 FirstData2 "TRANSPORT_CANDIDATE: normal-addressing ISO-TP. PSA-RE bits 4.7-4.0. ";
CM_ SG_ 1861 UnknownData3 "TRANSPORT_CANDIDATE: normal-addressing ISO-TP. PSA-RE bits 4.7-4.0. ";
CM_ SG_ 1861 ConsecutiveData3 "TRANSPORT_CANDIDATE: normal-addressing ISO-TP. PSA-RE bits 4.7-4.0. ";
CM_ SG_ 1861 SingleData3 "TRANSPORT_CANDIDATE: normal-addressing ISO-TP. PSA-RE bits 4.7-4.0. ";
CM_ SG_ 1861 FirstData1 "TRANSPORT_CANDIDATE: normal-addressing ISO-TP. PSA-RE bits 3.7-3.0. ";
CM_ SG_ 1861 UnknownData2 "TRANSPORT_CANDIDATE: normal-addressing ISO-TP. PSA-RE bits 3.7-3.0. ";
CM_ SG_ 1861 ConsecutiveData2 "TRANSPORT_CANDIDATE: normal-addressing ISO-TP. PSA-RE bits 3.7-3.0. ";
CM_ SG_ 1861 SingleData2 "TRANSPORT_CANDIDATE: normal-addressing ISO-TP. PSA-RE bits 3.7-3.0. ";
CM_ SG_ 1861 SeparationTimeRaw "TRANSPORT_CANDIDATE: normal-addressing ISO-TP. PSA-RE bits 3.7-3.0. Raw STmin code; 0xF1..0xF9 are not milliseconds.";
CM_ SG_ 1861 UnknownData1 "TRANSPORT_CANDIDATE: normal-addressing ISO-TP. PSA-RE bits 2.7-2.0. ";
CM_ SG_ 1861 ConsecutiveData1 "TRANSPORT_CANDIDATE: normal-addressing ISO-TP. PSA-RE bits 2.7-2.0. ";
CM_ SG_ 1861 SingleData1 "TRANSPORT_CANDIDATE: normal-addressing ISO-TP. PSA-RE bits 2.7-2.0. ";
CM_ SG_ 1861 BlockSize "TRANSPORT_CANDIDATE: normal-addressing ISO-TP. PSA-RE bits 2.7-2.0. ";
CM_ SG_ 1861 UnknownPciLow "TRANSPORT_CANDIDATE: normal-addressing ISO-TP. PSA-RE bits 1.3-1.0. ";
CM_ SG_ 1861 FlowStatus "TRANSPORT_CANDIDATE: normal-addressing ISO-TP. PSA-RE bits 1.3-1.0. ";
CM_ SG_ 1861 ConsecutiveSequence "TRANSPORT_CANDIDATE: normal-addressing ISO-TP. PSA-RE bits 1.3-1.0. ";
CM_ SG_ 1861 FirstFrameLength "TRANSPORT_CANDIDATE: normal-addressing ISO-TP. PSA-RE bits 1.3-2.0. 12-bit declared PDU length; not a reassembled value.";
CM_ SG_ 1861 SingleFrameLength "TRANSPORT_CANDIDATE: normal-addressing ISO-TP. PSA-RE bits 1.3-1.0. Declared data length; not a validity check.";
CM_ SG_ 1861 IsoTpFrameType "TRANSPORT_CANDIDATE: normal-addressing ISO-TP. PSA-RE bits 1.7-1.4. PCI high nibble; normal addressing candidate.";
VAL_ 1646 FlowStatus 0 "ContinueToSend" 1 "Wait" 2 "Overflow" ;
VAL_ 1646 IsoTpFrameType 0 "SingleFrame" 1 "FirstFrame" 2 "ConsecutiveFrame" 3 "FlowControl" ;
VAL_ 1647 FlowStatus 0 "ContinueToSend" 1 "Wait" 2 "Overflow" ;
VAL_ 1647 IsoTpFrameType 0 "SingleFrame" 1 "FirstFrame" 2 "ConsecutiveFrame" 3 "FlowControl" ;
VAL_ 1648 FlowStatus 0 "ContinueToSend" 1 "Wait" 2 "Overflow" ;
VAL_ 1648 IsoTpFrameType 0 "SingleFrame" 1 "FirstFrame" 2 "ConsecutiveFrame" 3 "FlowControl" ;
VAL_ 1649 FlowStatus 0 "ContinueToSend" 1 "Wait" 2 "Overflow" ;
VAL_ 1649 IsoTpFrameType 0 "SingleFrame" 1 "FirstFrame" 2 "ConsecutiveFrame" 3 "FlowControl" ;
VAL_ 1650 FlowStatus 0 "ContinueToSend" 1 "Wait" 2 "Overflow" ;
VAL_ 1650 IsoTpFrameType 0 "SingleFrame" 1 "FirstFrame" 2 "ConsecutiveFrame" 3 "FlowControl" ;
VAL_ 1651 FlowStatus 0 "ContinueToSend" 1 "Wait" 2 "Overflow" ;
VAL_ 1651 IsoTpFrameType 0 "SingleFrame" 1 "FirstFrame" 2 "ConsecutiveFrame" 3 "FlowControl" ;
VAL_ 1652 FlowStatus 0 "ContinueToSend" 1 "Wait" 2 "Overflow" ;
VAL_ 1652 IsoTpFrameType 0 "SingleFrame" 1 "FirstFrame" 2 "ConsecutiveFrame" 3 "FlowControl" ;
VAL_ 1656 FlowStatus 0 "ContinueToSend" 1 "Wait" 2 "Overflow" ;
VAL_ 1656 IsoTpFrameType 0 "SingleFrame" 1 "FirstFrame" 2 "ConsecutiveFrame" 3 "FlowControl" ;
VAL_ 1659 FlowStatus 0 "ContinueToSend" 1 "Wait" 2 "Overflow" ;
VAL_ 1659 IsoTpFrameType 0 "SingleFrame" 1 "FirstFrame" 2 "ConsecutiveFrame" 3 "FlowControl" ;
VAL_ 1660 FlowStatus 0 "ContinueToSend" 1 "Wait" 2 "Overflow" ;
VAL_ 1660 IsoTpFrameType 0 "SingleFrame" 1 "FirstFrame" 2 "ConsecutiveFrame" 3 "FlowControl" ;
VAL_ 1661 FlowStatus 0 "ContinueToSend" 1 "Wait" 2 "Overflow" ;
VAL_ 1661 IsoTpFrameType 0 "SingleFrame" 1 "FirstFrame" 2 "ConsecutiveFrame" 3 "FlowControl" ;
VAL_ 1736 FlowStatus 0 "ContinueToSend" 1 "Wait" 2 "Overflow" ;
VAL_ 1736 IsoTpFrameType 0 "SingleFrame" 1 "FirstFrame" 2 "ConsecutiveFrame" 3 "FlowControl" ;
VAL_ 1814 FlowStatus 0 "ContinueToSend" 1 "Wait" 2 "Overflow" ;
VAL_ 1814 IsoTpFrameType 0 "SingleFrame" 1 "FirstFrame" 2 "ConsecutiveFrame" 3 "FlowControl" ;
VAL_ 1816 FlowStatus 0 "ContinueToSend" 1 "Wait" 2 "Overflow" ;
VAL_ 1816 IsoTpFrameType 0 "SingleFrame" 1 "FirstFrame" 2 "ConsecutiveFrame" 3 "FlowControl" ;
VAL_ 1846 FlowStatus 0 "ContinueToSend" 1 "Wait" 2 "Overflow" ;
VAL_ 1846 IsoTpFrameType 0 "SingleFrame" 1 "FirstFrame" 2 "ConsecutiveFrame" 3 "FlowControl" ;
VAL_ 1848 FlowStatus 0 "ContinueToSend" 1 "Wait" 2 "Overflow" ;
VAL_ 1848 IsoTpFrameType 0 "SingleFrame" 1 "FirstFrame" 2 "ConsecutiveFrame" 3 "FlowControl" ;
VAL_ 1857 FlowStatus 0 "ContinueToSend" 1 "Wait" 2 "Overflow" ;
VAL_ 1857 IsoTpFrameType 0 "SingleFrame" 1 "FirstFrame" 2 "ConsecutiveFrame" 3 "FlowControl" ;
VAL_ 1858 FlowStatus 0 "ContinueToSend" 1 "Wait" 2 "Overflow" ;
VAL_ 1858 IsoTpFrameType 0 "SingleFrame" 1 "FirstFrame" 2 "ConsecutiveFrame" 3 "FlowControl" ;
VAL_ 1860 FlowStatus 0 "ContinueToSend" 1 "Wait" 2 "Overflow" ;
VAL_ 1860 IsoTpFrameType 0 "SingleFrame" 1 "FirstFrame" 2 "ConsecutiveFrame" 3 "FlowControl" ;
VAL_ 1861 FlowStatus 0 "ContinueToSend" 1 "Wait" 2 "Overflow" ;
VAL_ 1861 IsoTpFrameType 0 "SingleFrame" 1 "FirstFrame" 2 "ConsecutiveFrame" 3 "FlowControl" ;
SG_MUL_VAL_ 1646 SingleFrameLength IsoTpFrameType 0-0;
SG_MUL_VAL_ 1646 FirstFrameLength IsoTpFrameType 1-1;
SG_MUL_VAL_ 1646 ConsecutiveSequence IsoTpFrameType 2-2;
SG_MUL_VAL_ 1646 FlowStatus IsoTpFrameType 3-3;
SG_MUL_VAL_ 1646 UnknownPciLow IsoTpFrameType 4-15;
SG_MUL_VAL_ 1646 BlockSize IsoTpFrameType 3-3;
SG_MUL_VAL_ 1646 SingleData1 IsoTpFrameType 0-0;
SG_MUL_VAL_ 1646 ConsecutiveData1 IsoTpFrameType 2-2;
SG_MUL_VAL_ 1646 UnknownData1 IsoTpFrameType 4-15;
SG_MUL_VAL_ 1646 SeparationTimeRaw IsoTpFrameType 3-3;
SG_MUL_VAL_ 1646 SingleData2 IsoTpFrameType 0-0;
SG_MUL_VAL_ 1646 ConsecutiveData2 IsoTpFrameType 2-2;
SG_MUL_VAL_ 1646 UnknownData2 IsoTpFrameType 4-15;
SG_MUL_VAL_ 1646 FirstData1 IsoTpFrameType 1-1;
SG_MUL_VAL_ 1646 SingleData3 IsoTpFrameType 0-0;
SG_MUL_VAL_ 1646 ConsecutiveData3 IsoTpFrameType 2-2;
SG_MUL_VAL_ 1646 UnknownData3 IsoTpFrameType 4-15;
SG_MUL_VAL_ 1646 FirstData2 IsoTpFrameType 1-1;
SG_MUL_VAL_ 1646 FlowPadding1 IsoTpFrameType 3-3;
SG_MUL_VAL_ 1646 SingleData4 IsoTpFrameType 0-0;
SG_MUL_VAL_ 1646 ConsecutiveData4 IsoTpFrameType 2-2;
SG_MUL_VAL_ 1646 UnknownData4 IsoTpFrameType 4-15;
SG_MUL_VAL_ 1646 FirstData3 IsoTpFrameType 1-1;
SG_MUL_VAL_ 1646 FlowPadding2 IsoTpFrameType 3-3;
SG_MUL_VAL_ 1646 SingleData5 IsoTpFrameType 0-0;
SG_MUL_VAL_ 1646 ConsecutiveData5 IsoTpFrameType 2-2;
SG_MUL_VAL_ 1646 UnknownData5 IsoTpFrameType 4-15;
SG_MUL_VAL_ 1646 FirstData4 IsoTpFrameType 1-1;
SG_MUL_VAL_ 1646 FlowPadding3 IsoTpFrameType 3-3;
SG_MUL_VAL_ 1646 SingleData6 IsoTpFrameType 0-0;
SG_MUL_VAL_ 1646 ConsecutiveData6 IsoTpFrameType 2-2;
SG_MUL_VAL_ 1646 UnknownData6 IsoTpFrameType 4-15;
SG_MUL_VAL_ 1646 FirstData5 IsoTpFrameType 1-1;
SG_MUL_VAL_ 1646 FlowPadding4 IsoTpFrameType 3-3;
SG_MUL_VAL_ 1646 SingleData7 IsoTpFrameType 0-0;
SG_MUL_VAL_ 1646 ConsecutiveData7 IsoTpFrameType 2-2;
SG_MUL_VAL_ 1646 UnknownData7 IsoTpFrameType 4-15;
SG_MUL_VAL_ 1646 FirstData6 IsoTpFrameType 1-1;
SG_MUL_VAL_ 1646 FlowPadding5 IsoTpFrameType 3-3;
SG_MUL_VAL_ 1647 SingleFrameLength IsoTpFrameType 0-0;
SG_MUL_VAL_ 1647 FirstFrameLength IsoTpFrameType 1-1;
SG_MUL_VAL_ 1647 ConsecutiveSequence IsoTpFrameType 2-2;
SG_MUL_VAL_ 1647 FlowStatus IsoTpFrameType 3-3;
SG_MUL_VAL_ 1647 UnknownPciLow IsoTpFrameType 4-15;
SG_MUL_VAL_ 1647 BlockSize IsoTpFrameType 3-3;
SG_MUL_VAL_ 1647 SingleData1 IsoTpFrameType 0-0;
SG_MUL_VAL_ 1647 ConsecutiveData1 IsoTpFrameType 2-2;
SG_MUL_VAL_ 1647 UnknownData1 IsoTpFrameType 4-15;
SG_MUL_VAL_ 1647 SeparationTimeRaw IsoTpFrameType 3-3;
SG_MUL_VAL_ 1647 SingleData2 IsoTpFrameType 0-0;
SG_MUL_VAL_ 1647 ConsecutiveData2 IsoTpFrameType 2-2;
SG_MUL_VAL_ 1647 UnknownData2 IsoTpFrameType 4-15;
SG_MUL_VAL_ 1647 FirstData1 IsoTpFrameType 1-1;
SG_MUL_VAL_ 1647 SingleData3 IsoTpFrameType 0-0;
SG_MUL_VAL_ 1647 ConsecutiveData3 IsoTpFrameType 2-2;
SG_MUL_VAL_ 1647 UnknownData3 IsoTpFrameType 4-15;
SG_MUL_VAL_ 1647 FirstData2 IsoTpFrameType 1-1;
SG_MUL_VAL_ 1647 FlowPadding1 IsoTpFrameType 3-3;
SG_MUL_VAL_ 1647 SingleData4 IsoTpFrameType 0-0;
SG_MUL_VAL_ 1647 ConsecutiveData4 IsoTpFrameType 2-2;
SG_MUL_VAL_ 1647 UnknownData4 IsoTpFrameType 4-15;
SG_MUL_VAL_ 1647 FirstData3 IsoTpFrameType 1-1;
SG_MUL_VAL_ 1647 FlowPadding2 IsoTpFrameType 3-3;
SG_MUL_VAL_ 1647 SingleData5 IsoTpFrameType 0-0;
SG_MUL_VAL_ 1647 ConsecutiveData5 IsoTpFrameType 2-2;
SG_MUL_VAL_ 1647 UnknownData5 IsoTpFrameType 4-15;
SG_MUL_VAL_ 1647 FirstData4 IsoTpFrameType 1-1;
SG_MUL_VAL_ 1647 FlowPadding3 IsoTpFrameType 3-3;
SG_MUL_VAL_ 1647 SingleData6 IsoTpFrameType 0-0;
SG_MUL_VAL_ 1647 ConsecutiveData6 IsoTpFrameType 2-2;
SG_MUL_VAL_ 1647 UnknownData6 IsoTpFrameType 4-15;
SG_MUL_VAL_ 1647 FirstData5 IsoTpFrameType 1-1;
SG_MUL_VAL_ 1647 FlowPadding4 IsoTpFrameType 3-3;
SG_MUL_VAL_ 1647 SingleData7 IsoTpFrameType 0-0;
SG_MUL_VAL_ 1647 ConsecutiveData7 IsoTpFrameType 2-2;
SG_MUL_VAL_ 1647 UnknownData7 IsoTpFrameType 4-15;
SG_MUL_VAL_ 1647 FirstData6 IsoTpFrameType 1-1;
SG_MUL_VAL_ 1647 FlowPadding5 IsoTpFrameType 3-3;
SG_MUL_VAL_ 1648 SingleFrameLength IsoTpFrameType 0-0;
SG_MUL_VAL_ 1648 FirstFrameLength IsoTpFrameType 1-1;
SG_MUL_VAL_ 1648 ConsecutiveSequence IsoTpFrameType 2-2;
SG_MUL_VAL_ 1648 FlowStatus IsoTpFrameType 3-3;
SG_MUL_VAL_ 1648 UnknownPciLow IsoTpFrameType 4-15;
SG_MUL_VAL_ 1648 BlockSize IsoTpFrameType 3-3;
SG_MUL_VAL_ 1648 SingleData1 IsoTpFrameType 0-0;
SG_MUL_VAL_ 1648 ConsecutiveData1 IsoTpFrameType 2-2;
SG_MUL_VAL_ 1648 UnknownData1 IsoTpFrameType 4-15;
SG_MUL_VAL_ 1648 SeparationTimeRaw IsoTpFrameType 3-3;
SG_MUL_VAL_ 1648 SingleData2 IsoTpFrameType 0-0;
SG_MUL_VAL_ 1648 ConsecutiveData2 IsoTpFrameType 2-2;
SG_MUL_VAL_ 1648 UnknownData2 IsoTpFrameType 4-15;
SG_MUL_VAL_ 1648 FirstData1 IsoTpFrameType 1-1;
SG_MUL_VAL_ 1648 SingleData3 IsoTpFrameType 0-0;
SG_MUL_VAL_ 1648 ConsecutiveData3 IsoTpFrameType 2-2;
SG_MUL_VAL_ 1648 UnknownData3 IsoTpFrameType 4-15;
SG_MUL_VAL_ 1648 FirstData2 IsoTpFrameType 1-1;
SG_MUL_VAL_ 1648 FlowPadding1 IsoTpFrameType 3-3;
SG_MUL_VAL_ 1648 SingleData4 IsoTpFrameType 0-0;
SG_MUL_VAL_ 1648 ConsecutiveData4 IsoTpFrameType 2-2;
SG_MUL_VAL_ 1648 UnknownData4 IsoTpFrameType 4-15;
SG_MUL_VAL_ 1648 FirstData3 IsoTpFrameType 1-1;
SG_MUL_VAL_ 1648 FlowPadding2 IsoTpFrameType 3-3;
SG_MUL_VAL_ 1648 SingleData5 IsoTpFrameType 0-0;
SG_MUL_VAL_ 1648 ConsecutiveData5 IsoTpFrameType 2-2;
SG_MUL_VAL_ 1648 UnknownData5 IsoTpFrameType 4-15;
SG_MUL_VAL_ 1648 FirstData4 IsoTpFrameType 1-1;
SG_MUL_VAL_ 1648 FlowPadding3 IsoTpFrameType 3-3;
SG_MUL_VAL_ 1648 SingleData6 IsoTpFrameType 0-0;
SG_MUL_VAL_ 1648 ConsecutiveData6 IsoTpFrameType 2-2;
SG_MUL_VAL_ 1648 UnknownData6 IsoTpFrameType 4-15;
SG_MUL_VAL_ 1648 FirstData5 IsoTpFrameType 1-1;
SG_MUL_VAL_ 1648 FlowPadding4 IsoTpFrameType 3-3;
SG_MUL_VAL_ 1648 SingleData7 IsoTpFrameType 0-0;
SG_MUL_VAL_ 1648 ConsecutiveData7 IsoTpFrameType 2-2;
SG_MUL_VAL_ 1648 UnknownData7 IsoTpFrameType 4-15;
SG_MUL_VAL_ 1648 FirstData6 IsoTpFrameType 1-1;
SG_MUL_VAL_ 1648 FlowPadding5 IsoTpFrameType 3-3;
SG_MUL_VAL_ 1649 SingleFrameLength IsoTpFrameType 0-0;
SG_MUL_VAL_ 1649 FirstFrameLength IsoTpFrameType 1-1;
SG_MUL_VAL_ 1649 ConsecutiveSequence IsoTpFrameType 2-2;
SG_MUL_VAL_ 1649 FlowStatus IsoTpFrameType 3-3;
SG_MUL_VAL_ 1649 UnknownPciLow IsoTpFrameType 4-15;
SG_MUL_VAL_ 1649 BlockSize IsoTpFrameType 3-3;
SG_MUL_VAL_ 1649 SingleData1 IsoTpFrameType 0-0;
SG_MUL_VAL_ 1649 ConsecutiveData1 IsoTpFrameType 2-2;
SG_MUL_VAL_ 1649 UnknownData1 IsoTpFrameType 4-15;
SG_MUL_VAL_ 1649 SeparationTimeRaw IsoTpFrameType 3-3;
SG_MUL_VAL_ 1649 SingleData2 IsoTpFrameType 0-0;
SG_MUL_VAL_ 1649 ConsecutiveData2 IsoTpFrameType 2-2;
SG_MUL_VAL_ 1649 UnknownData2 IsoTpFrameType 4-15;
SG_MUL_VAL_ 1649 FirstData1 IsoTpFrameType 1-1;
SG_MUL_VAL_ 1649 SingleData3 IsoTpFrameType 0-0;
SG_MUL_VAL_ 1649 ConsecutiveData3 IsoTpFrameType 2-2;
SG_MUL_VAL_ 1649 UnknownData3 IsoTpFrameType 4-15;
SG_MUL_VAL_ 1649 FirstData2 IsoTpFrameType 1-1;
SG_MUL_VAL_ 1649 FlowPadding1 IsoTpFrameType 3-3;
SG_MUL_VAL_ 1649 SingleData4 IsoTpFrameType 0-0;
SG_MUL_VAL_ 1649 ConsecutiveData4 IsoTpFrameType 2-2;
SG_MUL_VAL_ 1649 UnknownData4 IsoTpFrameType 4-15;
SG_MUL_VAL_ 1649 FirstData3 IsoTpFrameType 1-1;
SG_MUL_VAL_ 1649 FlowPadding2 IsoTpFrameType 3-3;
SG_MUL_VAL_ 1649 SingleData5 IsoTpFrameType 0-0;
SG_MUL_VAL_ 1649 ConsecutiveData5 IsoTpFrameType 2-2;
SG_MUL_VAL_ 1649 UnknownData5 IsoTpFrameType 4-15;
SG_MUL_VAL_ 1649 FirstData4 IsoTpFrameType 1-1;
SG_MUL_VAL_ 1649 FlowPadding3 IsoTpFrameType 3-3;
SG_MUL_VAL_ 1649 SingleData6 IsoTpFrameType 0-0;
SG_MUL_VAL_ 1649 ConsecutiveData6 IsoTpFrameType 2-2;
SG_MUL_VAL_ 1649 UnknownData6 IsoTpFrameType 4-15;
SG_MUL_VAL_ 1649 FirstData5 IsoTpFrameType 1-1;
SG_MUL_VAL_ 1649 FlowPadding4 IsoTpFrameType 3-3;
SG_MUL_VAL_ 1649 SingleData7 IsoTpFrameType 0-0;
SG_MUL_VAL_ 1649 ConsecutiveData7 IsoTpFrameType 2-2;
SG_MUL_VAL_ 1649 UnknownData7 IsoTpFrameType 4-15;
SG_MUL_VAL_ 1649 FirstData6 IsoTpFrameType 1-1;
SG_MUL_VAL_ 1649 FlowPadding5 IsoTpFrameType 3-3;
SG_MUL_VAL_ 1650 SingleFrameLength IsoTpFrameType 0-0;
SG_MUL_VAL_ 1650 FirstFrameLength IsoTpFrameType 1-1;
SG_MUL_VAL_ 1650 ConsecutiveSequence IsoTpFrameType 2-2;
SG_MUL_VAL_ 1650 FlowStatus IsoTpFrameType 3-3;
SG_MUL_VAL_ 1650 UnknownPciLow IsoTpFrameType 4-15;
SG_MUL_VAL_ 1650 BlockSize IsoTpFrameType 3-3;
SG_MUL_VAL_ 1650 SingleData1 IsoTpFrameType 0-0;
SG_MUL_VAL_ 1650 ConsecutiveData1 IsoTpFrameType 2-2;
SG_MUL_VAL_ 1650 UnknownData1 IsoTpFrameType 4-15;
SG_MUL_VAL_ 1650 SeparationTimeRaw IsoTpFrameType 3-3;
SG_MUL_VAL_ 1650 SingleData2 IsoTpFrameType 0-0;
SG_MUL_VAL_ 1650 ConsecutiveData2 IsoTpFrameType 2-2;
SG_MUL_VAL_ 1650 UnknownData2 IsoTpFrameType 4-15;
SG_MUL_VAL_ 1650 FirstData1 IsoTpFrameType 1-1;
SG_MUL_VAL_ 1650 SingleData3 IsoTpFrameType 0-0;
SG_MUL_VAL_ 1650 ConsecutiveData3 IsoTpFrameType 2-2;
SG_MUL_VAL_ 1650 UnknownData3 IsoTpFrameType 4-15;
SG_MUL_VAL_ 1650 FirstData2 IsoTpFrameType 1-1;
SG_MUL_VAL_ 1650 FlowPadding1 IsoTpFrameType 3-3;
SG_MUL_VAL_ 1650 SingleData4 IsoTpFrameType 0-0;
SG_MUL_VAL_ 1650 ConsecutiveData4 IsoTpFrameType 2-2;
SG_MUL_VAL_ 1650 UnknownData4 IsoTpFrameType 4-15;
SG_MUL_VAL_ 1650 FirstData3 IsoTpFrameType 1-1;
SG_MUL_VAL_ 1650 FlowPadding2 IsoTpFrameType 3-3;
SG_MUL_VAL_ 1650 SingleData5 IsoTpFrameType 0-0;
SG_MUL_VAL_ 1650 ConsecutiveData5 IsoTpFrameType 2-2;
SG_MUL_VAL_ 1650 UnknownData5 IsoTpFrameType 4-15;
SG_MUL_VAL_ 1650 FirstData4 IsoTpFrameType 1-1;
SG_MUL_VAL_ 1650 FlowPadding3 IsoTpFrameType 3-3;
SG_MUL_VAL_ 1650 SingleData6 IsoTpFrameType 0-0;
SG_MUL_VAL_ 1650 ConsecutiveData6 IsoTpFrameType 2-2;
SG_MUL_VAL_ 1650 UnknownData6 IsoTpFrameType 4-15;
SG_MUL_VAL_ 1650 FirstData5 IsoTpFrameType 1-1;
SG_MUL_VAL_ 1650 FlowPadding4 IsoTpFrameType 3-3;
SG_MUL_VAL_ 1650 SingleData7 IsoTpFrameType 0-0;
SG_MUL_VAL_ 1650 ConsecutiveData7 IsoTpFrameType 2-2;
SG_MUL_VAL_ 1650 UnknownData7 IsoTpFrameType 4-15;
SG_MUL_VAL_ 1650 FirstData6 IsoTpFrameType 1-1;
SG_MUL_VAL_ 1650 FlowPadding5 IsoTpFrameType 3-3;
SG_MUL_VAL_ 1651 SingleFrameLength IsoTpFrameType 0-0;
SG_MUL_VAL_ 1651 FirstFrameLength IsoTpFrameType 1-1;
SG_MUL_VAL_ 1651 ConsecutiveSequence IsoTpFrameType 2-2;
SG_MUL_VAL_ 1651 FlowStatus IsoTpFrameType 3-3;
SG_MUL_VAL_ 1651 UnknownPciLow IsoTpFrameType 4-15;
SG_MUL_VAL_ 1651 BlockSize IsoTpFrameType 3-3;
SG_MUL_VAL_ 1651 SingleData1 IsoTpFrameType 0-0;
SG_MUL_VAL_ 1651 ConsecutiveData1 IsoTpFrameType 2-2;
SG_MUL_VAL_ 1651 UnknownData1 IsoTpFrameType 4-15;
SG_MUL_VAL_ 1651 SeparationTimeRaw IsoTpFrameType 3-3;
SG_MUL_VAL_ 1651 SingleData2 IsoTpFrameType 0-0;
SG_MUL_VAL_ 1651 ConsecutiveData2 IsoTpFrameType 2-2;
SG_MUL_VAL_ 1651 UnknownData2 IsoTpFrameType 4-15;
SG_MUL_VAL_ 1651 FirstData1 IsoTpFrameType 1-1;
SG_MUL_VAL_ 1651 SingleData3 IsoTpFrameType 0-0;
SG_MUL_VAL_ 1651 ConsecutiveData3 IsoTpFrameType 2-2;
SG_MUL_VAL_ 1651 UnknownData3 IsoTpFrameType 4-15;
SG_MUL_VAL_ 1651 FirstData2 IsoTpFrameType 1-1;
SG_MUL_VAL_ 1651 FlowPadding1 IsoTpFrameType 3-3;
SG_MUL_VAL_ 1651 SingleData4 IsoTpFrameType 0-0;
SG_MUL_VAL_ 1651 ConsecutiveData4 IsoTpFrameType 2-2;
SG_MUL_VAL_ 1651 UnknownData4 IsoTpFrameType 4-15;
SG_MUL_VAL_ 1651 FirstData3 IsoTpFrameType 1-1;
SG_MUL_VAL_ 1651 FlowPadding2 IsoTpFrameType 3-3;
SG_MUL_VAL_ 1651 SingleData5 IsoTpFrameType 0-0;
SG_MUL_VAL_ 1651 ConsecutiveData5 IsoTpFrameType 2-2;
SG_MUL_VAL_ 1651 UnknownData5 IsoTpFrameType 4-15;
SG_MUL_VAL_ 1651 FirstData4 IsoTpFrameType 1-1;
SG_MUL_VAL_ 1651 FlowPadding3 IsoTpFrameType 3-3;
SG_MUL_VAL_ 1651 SingleData6 IsoTpFrameType 0-0;
SG_MUL_VAL_ 1651 ConsecutiveData6 IsoTpFrameType 2-2;
SG_MUL_VAL_ 1651 UnknownData6 IsoTpFrameType 4-15;
SG_MUL_VAL_ 1651 FirstData5 IsoTpFrameType 1-1;
SG_MUL_VAL_ 1651 FlowPadding4 IsoTpFrameType 3-3;
SG_MUL_VAL_ 1651 SingleData7 IsoTpFrameType 0-0;
SG_MUL_VAL_ 1651 ConsecutiveData7 IsoTpFrameType 2-2;
SG_MUL_VAL_ 1651 UnknownData7 IsoTpFrameType 4-15;
SG_MUL_VAL_ 1651 FirstData6 IsoTpFrameType 1-1;
SG_MUL_VAL_ 1651 FlowPadding5 IsoTpFrameType 3-3;
SG_MUL_VAL_ 1652 SingleFrameLength IsoTpFrameType 0-0;
SG_MUL_VAL_ 1652 FirstFrameLength IsoTpFrameType 1-1;
SG_MUL_VAL_ 1652 ConsecutiveSequence IsoTpFrameType 2-2;
SG_MUL_VAL_ 1652 FlowStatus IsoTpFrameType 3-3;
SG_MUL_VAL_ 1652 UnknownPciLow IsoTpFrameType 4-15;
SG_MUL_VAL_ 1652 BlockSize IsoTpFrameType 3-3;
SG_MUL_VAL_ 1652 SingleData1 IsoTpFrameType 0-0;
SG_MUL_VAL_ 1652 ConsecutiveData1 IsoTpFrameType 2-2;
SG_MUL_VAL_ 1652 UnknownData1 IsoTpFrameType 4-15;
SG_MUL_VAL_ 1652 SeparationTimeRaw IsoTpFrameType 3-3;
SG_MUL_VAL_ 1652 SingleData2 IsoTpFrameType 0-0;
SG_MUL_VAL_ 1652 ConsecutiveData2 IsoTpFrameType 2-2;
SG_MUL_VAL_ 1652 UnknownData2 IsoTpFrameType 4-15;
SG_MUL_VAL_ 1652 FirstData1 IsoTpFrameType 1-1;
SG_MUL_VAL_ 1652 SingleData3 IsoTpFrameType 0-0;
SG_MUL_VAL_ 1652 ConsecutiveData3 IsoTpFrameType 2-2;
SG_MUL_VAL_ 1652 UnknownData3 IsoTpFrameType 4-15;
SG_MUL_VAL_ 1652 FirstData2 IsoTpFrameType 1-1;
SG_MUL_VAL_ 1652 FlowPadding1 IsoTpFrameType 3-3;
SG_MUL_VAL_ 1652 SingleData4 IsoTpFrameType 0-0;
SG_MUL_VAL_ 1652 ConsecutiveData4 IsoTpFrameType 2-2;
SG_MUL_VAL_ 1652 UnknownData4 IsoTpFrameType 4-15;
SG_MUL_VAL_ 1652 FirstData3 IsoTpFrameType 1-1;
SG_MUL_VAL_ 1652 FlowPadding2 IsoTpFrameType 3-3;
SG_MUL_VAL_ 1652 SingleData5 IsoTpFrameType 0-0;
SG_MUL_VAL_ 1652 ConsecutiveData5 IsoTpFrameType 2-2;
SG_MUL_VAL_ 1652 UnknownData5 IsoTpFrameType 4-15;
SG_MUL_VAL_ 1652 FirstData4 IsoTpFrameType 1-1;
SG_MUL_VAL_ 1652 FlowPadding3 IsoTpFrameType 3-3;
SG_MUL_VAL_ 1652 SingleData6 IsoTpFrameType 0-0;
SG_MUL_VAL_ 1652 ConsecutiveData6 IsoTpFrameType 2-2;
SG_MUL_VAL_ 1652 UnknownData6 IsoTpFrameType 4-15;
SG_MUL_VAL_ 1652 FirstData5 IsoTpFrameType 1-1;
SG_MUL_VAL_ 1652 FlowPadding4 IsoTpFrameType 3-3;
SG_MUL_VAL_ 1652 SingleData7 IsoTpFrameType 0-0;
SG_MUL_VAL_ 1652 ConsecutiveData7 IsoTpFrameType 2-2;
SG_MUL_VAL_ 1652 UnknownData7 IsoTpFrameType 4-15;
SG_MUL_VAL_ 1652 FirstData6 IsoTpFrameType 1-1;
SG_MUL_VAL_ 1652 FlowPadding5 IsoTpFrameType 3-3;
SG_MUL_VAL_ 1656 SingleFrameLength IsoTpFrameType 0-0;
SG_MUL_VAL_ 1656 FirstFrameLength IsoTpFrameType 1-1;
SG_MUL_VAL_ 1656 ConsecutiveSequence IsoTpFrameType 2-2;
SG_MUL_VAL_ 1656 FlowStatus IsoTpFrameType 3-3;
SG_MUL_VAL_ 1656 UnknownPciLow IsoTpFrameType 4-15;
SG_MUL_VAL_ 1656 BlockSize IsoTpFrameType 3-3;
SG_MUL_VAL_ 1656 SingleData1 IsoTpFrameType 0-0;
SG_MUL_VAL_ 1656 ConsecutiveData1 IsoTpFrameType 2-2;
SG_MUL_VAL_ 1656 UnknownData1 IsoTpFrameType 4-15;
SG_MUL_VAL_ 1656 SeparationTimeRaw IsoTpFrameType 3-3;
SG_MUL_VAL_ 1656 SingleData2 IsoTpFrameType 0-0;
SG_MUL_VAL_ 1656 ConsecutiveData2 IsoTpFrameType 2-2;
SG_MUL_VAL_ 1656 UnknownData2 IsoTpFrameType 4-15;
SG_MUL_VAL_ 1656 FirstData1 IsoTpFrameType 1-1;
SG_MUL_VAL_ 1656 SingleData3 IsoTpFrameType 0-0;
SG_MUL_VAL_ 1656 ConsecutiveData3 IsoTpFrameType 2-2;
SG_MUL_VAL_ 1656 UnknownData3 IsoTpFrameType 4-15;
SG_MUL_VAL_ 1656 FirstData2 IsoTpFrameType 1-1;
SG_MUL_VAL_ 1656 FlowPadding1 IsoTpFrameType 3-3;
SG_MUL_VAL_ 1656 SingleData4 IsoTpFrameType 0-0;
SG_MUL_VAL_ 1656 ConsecutiveData4 IsoTpFrameType 2-2;
SG_MUL_VAL_ 1656 UnknownData4 IsoTpFrameType 4-15;
SG_MUL_VAL_ 1656 FirstData3 IsoTpFrameType 1-1;
SG_MUL_VAL_ 1656 FlowPadding2 IsoTpFrameType 3-3;
SG_MUL_VAL_ 1656 SingleData5 IsoTpFrameType 0-0;
SG_MUL_VAL_ 1656 ConsecutiveData5 IsoTpFrameType 2-2;
SG_MUL_VAL_ 1656 UnknownData5 IsoTpFrameType 4-15;
SG_MUL_VAL_ 1656 FirstData4 IsoTpFrameType 1-1;
SG_MUL_VAL_ 1656 FlowPadding3 IsoTpFrameType 3-3;
SG_MUL_VAL_ 1656 SingleData6 IsoTpFrameType 0-0;
SG_MUL_VAL_ 1656 ConsecutiveData6 IsoTpFrameType 2-2;
SG_MUL_VAL_ 1656 UnknownData6 IsoTpFrameType 4-15;
SG_MUL_VAL_ 1656 FirstData5 IsoTpFrameType 1-1;
SG_MUL_VAL_ 1656 FlowPadding4 IsoTpFrameType 3-3;
SG_MUL_VAL_ 1656 SingleData7 IsoTpFrameType 0-0;
SG_MUL_VAL_ 1656 ConsecutiveData7 IsoTpFrameType 2-2;
SG_MUL_VAL_ 1656 UnknownData7 IsoTpFrameType 4-15;
SG_MUL_VAL_ 1656 FirstData6 IsoTpFrameType 1-1;
SG_MUL_VAL_ 1656 FlowPadding5 IsoTpFrameType 3-3;
SG_MUL_VAL_ 1659 SingleFrameLength IsoTpFrameType 0-0;
SG_MUL_VAL_ 1659 FirstFrameLength IsoTpFrameType 1-1;
SG_MUL_VAL_ 1659 ConsecutiveSequence IsoTpFrameType 2-2;
SG_MUL_VAL_ 1659 FlowStatus IsoTpFrameType 3-3;
SG_MUL_VAL_ 1659 UnknownPciLow IsoTpFrameType 4-15;
SG_MUL_VAL_ 1659 BlockSize IsoTpFrameType 3-3;
SG_MUL_VAL_ 1659 SingleData1 IsoTpFrameType 0-0;
SG_MUL_VAL_ 1659 ConsecutiveData1 IsoTpFrameType 2-2;
SG_MUL_VAL_ 1659 UnknownData1 IsoTpFrameType 4-15;
SG_MUL_VAL_ 1659 SeparationTimeRaw IsoTpFrameType 3-3;
SG_MUL_VAL_ 1659 SingleData2 IsoTpFrameType 0-0;
SG_MUL_VAL_ 1659 ConsecutiveData2 IsoTpFrameType 2-2;
SG_MUL_VAL_ 1659 UnknownData2 IsoTpFrameType 4-15;
SG_MUL_VAL_ 1659 FirstData1 IsoTpFrameType 1-1;
SG_MUL_VAL_ 1659 SingleData3 IsoTpFrameType 0-0;
SG_MUL_VAL_ 1659 ConsecutiveData3 IsoTpFrameType 2-2;
SG_MUL_VAL_ 1659 UnknownData3 IsoTpFrameType 4-15;
SG_MUL_VAL_ 1659 FirstData2 IsoTpFrameType 1-1;
SG_MUL_VAL_ 1659 FlowPadding1 IsoTpFrameType 3-3;
SG_MUL_VAL_ 1659 SingleData4 IsoTpFrameType 0-0;
SG_MUL_VAL_ 1659 ConsecutiveData4 IsoTpFrameType 2-2;
SG_MUL_VAL_ 1659 UnknownData4 IsoTpFrameType 4-15;
SG_MUL_VAL_ 1659 FirstData3 IsoTpFrameType 1-1;
SG_MUL_VAL_ 1659 FlowPadding2 IsoTpFrameType 3-3;
SG_MUL_VAL_ 1659 SingleData5 IsoTpFrameType 0-0;
SG_MUL_VAL_ 1659 ConsecutiveData5 IsoTpFrameType 2-2;
SG_MUL_VAL_ 1659 UnknownData5 IsoTpFrameType 4-15;
SG_MUL_VAL_ 1659 FirstData4 IsoTpFrameType 1-1;
SG_MUL_VAL_ 1659 FlowPadding3 IsoTpFrameType 3-3;
SG_MUL_VAL_ 1659 SingleData6 IsoTpFrameType 0-0;
SG_MUL_VAL_ 1659 ConsecutiveData6 IsoTpFrameType 2-2;
SG_MUL_VAL_ 1659 UnknownData6 IsoTpFrameType 4-15;
SG_MUL_VAL_ 1659 FirstData5 IsoTpFrameType 1-1;
SG_MUL_VAL_ 1659 FlowPadding4 IsoTpFrameType 3-3;
SG_MUL_VAL_ 1659 SingleData7 IsoTpFrameType 0-0;
SG_MUL_VAL_ 1659 ConsecutiveData7 IsoTpFrameType 2-2;
SG_MUL_VAL_ 1659 UnknownData7 IsoTpFrameType 4-15;
SG_MUL_VAL_ 1659 FirstData6 IsoTpFrameType 1-1;
SG_MUL_VAL_ 1659 FlowPadding5 IsoTpFrameType 3-3;
SG_MUL_VAL_ 1660 SingleFrameLength IsoTpFrameType 0-0;
SG_MUL_VAL_ 1660 FirstFrameLength IsoTpFrameType 1-1;
SG_MUL_VAL_ 1660 ConsecutiveSequence IsoTpFrameType 2-2;
SG_MUL_VAL_ 1660 FlowStatus IsoTpFrameType 3-3;
SG_MUL_VAL_ 1660 UnknownPciLow IsoTpFrameType 4-15;
SG_MUL_VAL_ 1660 BlockSize IsoTpFrameType 3-3;
SG_MUL_VAL_ 1660 SingleData1 IsoTpFrameType 0-0;
SG_MUL_VAL_ 1660 ConsecutiveData1 IsoTpFrameType 2-2;
SG_MUL_VAL_ 1660 UnknownData1 IsoTpFrameType 4-15;
SG_MUL_VAL_ 1660 SeparationTimeRaw IsoTpFrameType 3-3;
SG_MUL_VAL_ 1660 SingleData2 IsoTpFrameType 0-0;
SG_MUL_VAL_ 1660 ConsecutiveData2 IsoTpFrameType 2-2;
SG_MUL_VAL_ 1660 UnknownData2 IsoTpFrameType 4-15;
SG_MUL_VAL_ 1660 FirstData1 IsoTpFrameType 1-1;
SG_MUL_VAL_ 1660 SingleData3 IsoTpFrameType 0-0;
SG_MUL_VAL_ 1660 ConsecutiveData3 IsoTpFrameType 2-2;
SG_MUL_VAL_ 1660 UnknownData3 IsoTpFrameType 4-15;
SG_MUL_VAL_ 1660 FirstData2 IsoTpFrameType 1-1;
SG_MUL_VAL_ 1660 FlowPadding1 IsoTpFrameType 3-3;
SG_MUL_VAL_ 1660 SingleData4 IsoTpFrameType 0-0;
SG_MUL_VAL_ 1660 ConsecutiveData4 IsoTpFrameType 2-2;
SG_MUL_VAL_ 1660 UnknownData4 IsoTpFrameType 4-15;
SG_MUL_VAL_ 1660 FirstData3 IsoTpFrameType 1-1;
SG_MUL_VAL_ 1660 FlowPadding2 IsoTpFrameType 3-3;
SG_MUL_VAL_ 1660 SingleData5 IsoTpFrameType 0-0;
SG_MUL_VAL_ 1660 ConsecutiveData5 IsoTpFrameType 2-2;
SG_MUL_VAL_ 1660 UnknownData5 IsoTpFrameType 4-15;
SG_MUL_VAL_ 1660 FirstData4 IsoTpFrameType 1-1;
SG_MUL_VAL_ 1660 FlowPadding3 IsoTpFrameType 3-3;
SG_MUL_VAL_ 1660 SingleData6 IsoTpFrameType 0-0;
SG_MUL_VAL_ 1660 ConsecutiveData6 IsoTpFrameType 2-2;
SG_MUL_VAL_ 1660 UnknownData6 IsoTpFrameType 4-15;
SG_MUL_VAL_ 1660 FirstData5 IsoTpFrameType 1-1;
SG_MUL_VAL_ 1660 FlowPadding4 IsoTpFrameType 3-3;
SG_MUL_VAL_ 1660 SingleData7 IsoTpFrameType 0-0;
SG_MUL_VAL_ 1660 ConsecutiveData7 IsoTpFrameType 2-2;
SG_MUL_VAL_ 1660 UnknownData7 IsoTpFrameType 4-15;
SG_MUL_VAL_ 1660 FirstData6 IsoTpFrameType 1-1;
SG_MUL_VAL_ 1660 FlowPadding5 IsoTpFrameType 3-3;
SG_MUL_VAL_ 1661 SingleFrameLength IsoTpFrameType 0-0;
SG_MUL_VAL_ 1661 FirstFrameLength IsoTpFrameType 1-1;
SG_MUL_VAL_ 1661 ConsecutiveSequence IsoTpFrameType 2-2;
SG_MUL_VAL_ 1661 FlowStatus IsoTpFrameType 3-3;
SG_MUL_VAL_ 1661 UnknownPciLow IsoTpFrameType 4-15;
SG_MUL_VAL_ 1661 BlockSize IsoTpFrameType 3-3;
SG_MUL_VAL_ 1661 SingleData1 IsoTpFrameType 0-0;
SG_MUL_VAL_ 1661 ConsecutiveData1 IsoTpFrameType 2-2;
SG_MUL_VAL_ 1661 UnknownData1 IsoTpFrameType 4-15;
SG_MUL_VAL_ 1661 SeparationTimeRaw IsoTpFrameType 3-3;
SG_MUL_VAL_ 1661 SingleData2 IsoTpFrameType 0-0;
SG_MUL_VAL_ 1661 ConsecutiveData2 IsoTpFrameType 2-2;
SG_MUL_VAL_ 1661 UnknownData2 IsoTpFrameType 4-15;
SG_MUL_VAL_ 1661 FirstData1 IsoTpFrameType 1-1;
SG_MUL_VAL_ 1661 SingleData3 IsoTpFrameType 0-0;
SG_MUL_VAL_ 1661 ConsecutiveData3 IsoTpFrameType 2-2;
SG_MUL_VAL_ 1661 UnknownData3 IsoTpFrameType 4-15;
SG_MUL_VAL_ 1661 FirstData2 IsoTpFrameType 1-1;
SG_MUL_VAL_ 1661 FlowPadding1 IsoTpFrameType 3-3;
SG_MUL_VAL_ 1661 SingleData4 IsoTpFrameType 0-0;
SG_MUL_VAL_ 1661 ConsecutiveData4 IsoTpFrameType 2-2;
SG_MUL_VAL_ 1661 UnknownData4 IsoTpFrameType 4-15;
SG_MUL_VAL_ 1661 FirstData3 IsoTpFrameType 1-1;
SG_MUL_VAL_ 1661 FlowPadding2 IsoTpFrameType 3-3;
SG_MUL_VAL_ 1661 SingleData5 IsoTpFrameType 0-0;
SG_MUL_VAL_ 1661 ConsecutiveData5 IsoTpFrameType 2-2;
SG_MUL_VAL_ 1661 UnknownData5 IsoTpFrameType 4-15;
SG_MUL_VAL_ 1661 FirstData4 IsoTpFrameType 1-1;
SG_MUL_VAL_ 1661 FlowPadding3 IsoTpFrameType 3-3;
SG_MUL_VAL_ 1661 SingleData6 IsoTpFrameType 0-0;
SG_MUL_VAL_ 1661 ConsecutiveData6 IsoTpFrameType 2-2;
SG_MUL_VAL_ 1661 UnknownData6 IsoTpFrameType 4-15;
SG_MUL_VAL_ 1661 FirstData5 IsoTpFrameType 1-1;
SG_MUL_VAL_ 1661 FlowPadding4 IsoTpFrameType 3-3;
SG_MUL_VAL_ 1661 SingleData7 IsoTpFrameType 0-0;
SG_MUL_VAL_ 1661 ConsecutiveData7 IsoTpFrameType 2-2;
SG_MUL_VAL_ 1661 UnknownData7 IsoTpFrameType 4-15;
SG_MUL_VAL_ 1661 FirstData6 IsoTpFrameType 1-1;
SG_MUL_VAL_ 1661 FlowPadding5 IsoTpFrameType 3-3;
SG_MUL_VAL_ 1736 SingleFrameLength IsoTpFrameType 0-0;
SG_MUL_VAL_ 1736 FirstFrameLength IsoTpFrameType 1-1;
SG_MUL_VAL_ 1736 ConsecutiveSequence IsoTpFrameType 2-2;
SG_MUL_VAL_ 1736 FlowStatus IsoTpFrameType 3-3;
SG_MUL_VAL_ 1736 UnknownPciLow IsoTpFrameType 4-15;
SG_MUL_VAL_ 1736 BlockSize IsoTpFrameType 3-3;
SG_MUL_VAL_ 1736 SingleData1 IsoTpFrameType 0-0;
SG_MUL_VAL_ 1736 ConsecutiveData1 IsoTpFrameType 2-2;
SG_MUL_VAL_ 1736 UnknownData1 IsoTpFrameType 4-15;
SG_MUL_VAL_ 1736 SeparationTimeRaw IsoTpFrameType 3-3;
SG_MUL_VAL_ 1736 SingleData2 IsoTpFrameType 0-0;
SG_MUL_VAL_ 1736 ConsecutiveData2 IsoTpFrameType 2-2;
SG_MUL_VAL_ 1736 UnknownData2 IsoTpFrameType 4-15;
SG_MUL_VAL_ 1736 FirstData1 IsoTpFrameType 1-1;
SG_MUL_VAL_ 1736 SingleData3 IsoTpFrameType 0-0;
SG_MUL_VAL_ 1736 ConsecutiveData3 IsoTpFrameType 2-2;
SG_MUL_VAL_ 1736 UnknownData3 IsoTpFrameType 4-15;
SG_MUL_VAL_ 1736 FirstData2 IsoTpFrameType 1-1;
SG_MUL_VAL_ 1736 FlowPadding1 IsoTpFrameType 3-3;
SG_MUL_VAL_ 1736 SingleData4 IsoTpFrameType 0-0;
SG_MUL_VAL_ 1736 ConsecutiveData4 IsoTpFrameType 2-2;
SG_MUL_VAL_ 1736 UnknownData4 IsoTpFrameType 4-15;
SG_MUL_VAL_ 1736 FirstData3 IsoTpFrameType 1-1;
SG_MUL_VAL_ 1736 FlowPadding2 IsoTpFrameType 3-3;
SG_MUL_VAL_ 1736 SingleData5 IsoTpFrameType 0-0;
SG_MUL_VAL_ 1736 ConsecutiveData5 IsoTpFrameType 2-2;
SG_MUL_VAL_ 1736 UnknownData5 IsoTpFrameType 4-15;
SG_MUL_VAL_ 1736 FirstData4 IsoTpFrameType 1-1;
SG_MUL_VAL_ 1736 FlowPadding3 IsoTpFrameType 3-3;
SG_MUL_VAL_ 1736 SingleData6 IsoTpFrameType 0-0;
SG_MUL_VAL_ 1736 ConsecutiveData6 IsoTpFrameType 2-2;
SG_MUL_VAL_ 1736 UnknownData6 IsoTpFrameType 4-15;
SG_MUL_VAL_ 1736 FirstData5 IsoTpFrameType 1-1;
SG_MUL_VAL_ 1736 FlowPadding4 IsoTpFrameType 3-3;
SG_MUL_VAL_ 1736 SingleData7 IsoTpFrameType 0-0;
SG_MUL_VAL_ 1736 ConsecutiveData7 IsoTpFrameType 2-2;
SG_MUL_VAL_ 1736 UnknownData7 IsoTpFrameType 4-15;
SG_MUL_VAL_ 1736 FirstData6 IsoTpFrameType 1-1;
SG_MUL_VAL_ 1736 FlowPadding5 IsoTpFrameType 3-3;
SG_MUL_VAL_ 1814 SingleFrameLength IsoTpFrameType 0-0;
SG_MUL_VAL_ 1814 FirstFrameLength IsoTpFrameType 1-1;
SG_MUL_VAL_ 1814 ConsecutiveSequence IsoTpFrameType 2-2;
SG_MUL_VAL_ 1814 FlowStatus IsoTpFrameType 3-3;
SG_MUL_VAL_ 1814 UnknownPciLow IsoTpFrameType 4-15;
SG_MUL_VAL_ 1814 BlockSize IsoTpFrameType 3-3;
SG_MUL_VAL_ 1814 SingleData1 IsoTpFrameType 0-0;
SG_MUL_VAL_ 1814 ConsecutiveData1 IsoTpFrameType 2-2;
SG_MUL_VAL_ 1814 UnknownData1 IsoTpFrameType 4-15;
SG_MUL_VAL_ 1814 SeparationTimeRaw IsoTpFrameType 3-3;
SG_MUL_VAL_ 1814 SingleData2 IsoTpFrameType 0-0;
SG_MUL_VAL_ 1814 ConsecutiveData2 IsoTpFrameType 2-2;
SG_MUL_VAL_ 1814 UnknownData2 IsoTpFrameType 4-15;
SG_MUL_VAL_ 1814 FirstData1 IsoTpFrameType 1-1;
SG_MUL_VAL_ 1814 SingleData3 IsoTpFrameType 0-0;
SG_MUL_VAL_ 1814 ConsecutiveData3 IsoTpFrameType 2-2;
SG_MUL_VAL_ 1814 UnknownData3 IsoTpFrameType 4-15;
SG_MUL_VAL_ 1814 FirstData2 IsoTpFrameType 1-1;
SG_MUL_VAL_ 1814 FlowPadding1 IsoTpFrameType 3-3;
SG_MUL_VAL_ 1814 SingleData4 IsoTpFrameType 0-0;
SG_MUL_VAL_ 1814 ConsecutiveData4 IsoTpFrameType 2-2;
SG_MUL_VAL_ 1814 UnknownData4 IsoTpFrameType 4-15;
SG_MUL_VAL_ 1814 FirstData3 IsoTpFrameType 1-1;
SG_MUL_VAL_ 1814 FlowPadding2 IsoTpFrameType 3-3;
SG_MUL_VAL_ 1814 SingleData5 IsoTpFrameType 0-0;
SG_MUL_VAL_ 1814 ConsecutiveData5 IsoTpFrameType 2-2;
SG_MUL_VAL_ 1814 UnknownData5 IsoTpFrameType 4-15;
SG_MUL_VAL_ 1814 FirstData4 IsoTpFrameType 1-1;
SG_MUL_VAL_ 1814 FlowPadding3 IsoTpFrameType 3-3;
SG_MUL_VAL_ 1814 SingleData6 IsoTpFrameType 0-0;
SG_MUL_VAL_ 1814 ConsecutiveData6 IsoTpFrameType 2-2;
SG_MUL_VAL_ 1814 UnknownData6 IsoTpFrameType 4-15;
SG_MUL_VAL_ 1814 FirstData5 IsoTpFrameType 1-1;
SG_MUL_VAL_ 1814 FlowPadding4 IsoTpFrameType 3-3;
SG_MUL_VAL_ 1814 SingleData7 IsoTpFrameType 0-0;
SG_MUL_VAL_ 1814 ConsecutiveData7 IsoTpFrameType 2-2;
SG_MUL_VAL_ 1814 UnknownData7 IsoTpFrameType 4-15;
SG_MUL_VAL_ 1814 FirstData6 IsoTpFrameType 1-1;
SG_MUL_VAL_ 1814 FlowPadding5 IsoTpFrameType 3-3;
SG_MUL_VAL_ 1816 SingleFrameLength IsoTpFrameType 0-0;
SG_MUL_VAL_ 1816 FirstFrameLength IsoTpFrameType 1-1;
SG_MUL_VAL_ 1816 ConsecutiveSequence IsoTpFrameType 2-2;
SG_MUL_VAL_ 1816 FlowStatus IsoTpFrameType 3-3;
SG_MUL_VAL_ 1816 UnknownPciLow IsoTpFrameType 4-15;
SG_MUL_VAL_ 1816 BlockSize IsoTpFrameType 3-3;
SG_MUL_VAL_ 1816 SingleData1 IsoTpFrameType 0-0;
SG_MUL_VAL_ 1816 ConsecutiveData1 IsoTpFrameType 2-2;
SG_MUL_VAL_ 1816 UnknownData1 IsoTpFrameType 4-15;
SG_MUL_VAL_ 1816 SeparationTimeRaw IsoTpFrameType 3-3;
SG_MUL_VAL_ 1816 SingleData2 IsoTpFrameType 0-0;
SG_MUL_VAL_ 1816 ConsecutiveData2 IsoTpFrameType 2-2;
SG_MUL_VAL_ 1816 UnknownData2 IsoTpFrameType 4-15;
SG_MUL_VAL_ 1816 FirstData1 IsoTpFrameType 1-1;
SG_MUL_VAL_ 1816 SingleData3 IsoTpFrameType 0-0;
SG_MUL_VAL_ 1816 ConsecutiveData3 IsoTpFrameType 2-2;
SG_MUL_VAL_ 1816 UnknownData3 IsoTpFrameType 4-15;
SG_MUL_VAL_ 1816 FirstData2 IsoTpFrameType 1-1;
SG_MUL_VAL_ 1816 FlowPadding1 IsoTpFrameType 3-3;
SG_MUL_VAL_ 1816 SingleData4 IsoTpFrameType 0-0;
SG_MUL_VAL_ 1816 ConsecutiveData4 IsoTpFrameType 2-2;
SG_MUL_VAL_ 1816 UnknownData4 IsoTpFrameType 4-15;
SG_MUL_VAL_ 1816 FirstData3 IsoTpFrameType 1-1;
SG_MUL_VAL_ 1816 FlowPadding2 IsoTpFrameType 3-3;
SG_MUL_VAL_ 1816 SingleData5 IsoTpFrameType 0-0;
SG_MUL_VAL_ 1816 ConsecutiveData5 IsoTpFrameType 2-2;
SG_MUL_VAL_ 1816 UnknownData5 IsoTpFrameType 4-15;
SG_MUL_VAL_ 1816 FirstData4 IsoTpFrameType 1-1;
SG_MUL_VAL_ 1816 FlowPadding3 IsoTpFrameType 3-3;
SG_MUL_VAL_ 1816 SingleData6 IsoTpFrameType 0-0;
SG_MUL_VAL_ 1816 ConsecutiveData6 IsoTpFrameType 2-2;
SG_MUL_VAL_ 1816 UnknownData6 IsoTpFrameType 4-15;
SG_MUL_VAL_ 1816 FirstData5 IsoTpFrameType 1-1;
SG_MUL_VAL_ 1816 FlowPadding4 IsoTpFrameType 3-3;
SG_MUL_VAL_ 1816 SingleData7 IsoTpFrameType 0-0;
SG_MUL_VAL_ 1816 ConsecutiveData7 IsoTpFrameType 2-2;
SG_MUL_VAL_ 1816 UnknownData7 IsoTpFrameType 4-15;
SG_MUL_VAL_ 1816 FirstData6 IsoTpFrameType 1-1;
SG_MUL_VAL_ 1816 FlowPadding5 IsoTpFrameType 3-3;
SG_MUL_VAL_ 1846 SingleFrameLength IsoTpFrameType 0-0;
SG_MUL_VAL_ 1846 FirstFrameLength IsoTpFrameType 1-1;
SG_MUL_VAL_ 1846 ConsecutiveSequence IsoTpFrameType 2-2;
SG_MUL_VAL_ 1846 FlowStatus IsoTpFrameType 3-3;
SG_MUL_VAL_ 1846 UnknownPciLow IsoTpFrameType 4-15;
SG_MUL_VAL_ 1846 BlockSize IsoTpFrameType 3-3;
SG_MUL_VAL_ 1846 SingleData1 IsoTpFrameType 0-0;
SG_MUL_VAL_ 1846 ConsecutiveData1 IsoTpFrameType 2-2;
SG_MUL_VAL_ 1846 UnknownData1 IsoTpFrameType 4-15;
SG_MUL_VAL_ 1846 SeparationTimeRaw IsoTpFrameType 3-3;
SG_MUL_VAL_ 1846 SingleData2 IsoTpFrameType 0-0;
SG_MUL_VAL_ 1846 ConsecutiveData2 IsoTpFrameType 2-2;
SG_MUL_VAL_ 1846 UnknownData2 IsoTpFrameType 4-15;
SG_MUL_VAL_ 1846 FirstData1 IsoTpFrameType 1-1;
SG_MUL_VAL_ 1846 SingleData3 IsoTpFrameType 0-0;
SG_MUL_VAL_ 1846 ConsecutiveData3 IsoTpFrameType 2-2;
SG_MUL_VAL_ 1846 UnknownData3 IsoTpFrameType 4-15;
SG_MUL_VAL_ 1846 FirstData2 IsoTpFrameType 1-1;
SG_MUL_VAL_ 1846 FlowPadding1 IsoTpFrameType 3-3;
SG_MUL_VAL_ 1846 SingleData4 IsoTpFrameType 0-0;
SG_MUL_VAL_ 1846 ConsecutiveData4 IsoTpFrameType 2-2;
SG_MUL_VAL_ 1846 UnknownData4 IsoTpFrameType 4-15;
SG_MUL_VAL_ 1846 FirstData3 IsoTpFrameType 1-1;
SG_MUL_VAL_ 1846 FlowPadding2 IsoTpFrameType 3-3;
SG_MUL_VAL_ 1846 SingleData5 IsoTpFrameType 0-0;
SG_MUL_VAL_ 1846 ConsecutiveData5 IsoTpFrameType 2-2;
SG_MUL_VAL_ 1846 UnknownData5 IsoTpFrameType 4-15;
SG_MUL_VAL_ 1846 FirstData4 IsoTpFrameType 1-1;
SG_MUL_VAL_ 1846 FlowPadding3 IsoTpFrameType 3-3;
SG_MUL_VAL_ 1846 SingleData6 IsoTpFrameType 0-0;
SG_MUL_VAL_ 1846 ConsecutiveData6 IsoTpFrameType 2-2;
SG_MUL_VAL_ 1846 UnknownData6 IsoTpFrameType 4-15;
SG_MUL_VAL_ 1846 FirstData5 IsoTpFrameType 1-1;
SG_MUL_VAL_ 1846 FlowPadding4 IsoTpFrameType 3-3;
SG_MUL_VAL_ 1846 SingleData7 IsoTpFrameType 0-0;
SG_MUL_VAL_ 1846 ConsecutiveData7 IsoTpFrameType 2-2;
SG_MUL_VAL_ 1846 UnknownData7 IsoTpFrameType 4-15;
SG_MUL_VAL_ 1846 FirstData6 IsoTpFrameType 1-1;
SG_MUL_VAL_ 1846 FlowPadding5 IsoTpFrameType 3-3;
SG_MUL_VAL_ 1848 SingleFrameLength IsoTpFrameType 0-0;
SG_MUL_VAL_ 1848 FirstFrameLength IsoTpFrameType 1-1;
SG_MUL_VAL_ 1848 ConsecutiveSequence IsoTpFrameType 2-2;
SG_MUL_VAL_ 1848 FlowStatus IsoTpFrameType 3-3;
SG_MUL_VAL_ 1848 UnknownPciLow IsoTpFrameType 4-15;
SG_MUL_VAL_ 1848 BlockSize IsoTpFrameType 3-3;
SG_MUL_VAL_ 1848 SingleData1 IsoTpFrameType 0-0;
SG_MUL_VAL_ 1848 ConsecutiveData1 IsoTpFrameType 2-2;
SG_MUL_VAL_ 1848 UnknownData1 IsoTpFrameType 4-15;
SG_MUL_VAL_ 1848 SeparationTimeRaw IsoTpFrameType 3-3;
SG_MUL_VAL_ 1848 SingleData2 IsoTpFrameType 0-0;
SG_MUL_VAL_ 1848 ConsecutiveData2 IsoTpFrameType 2-2;
SG_MUL_VAL_ 1848 UnknownData2 IsoTpFrameType 4-15;
SG_MUL_VAL_ 1848 FirstData1 IsoTpFrameType 1-1;
SG_MUL_VAL_ 1848 SingleData3 IsoTpFrameType 0-0;
SG_MUL_VAL_ 1848 ConsecutiveData3 IsoTpFrameType 2-2;
SG_MUL_VAL_ 1848 UnknownData3 IsoTpFrameType 4-15;
SG_MUL_VAL_ 1848 FirstData2 IsoTpFrameType 1-1;
SG_MUL_VAL_ 1848 FlowPadding1 IsoTpFrameType 3-3;
SG_MUL_VAL_ 1848 SingleData4 IsoTpFrameType 0-0;
SG_MUL_VAL_ 1848 ConsecutiveData4 IsoTpFrameType 2-2;
SG_MUL_VAL_ 1848 UnknownData4 IsoTpFrameType 4-15;
SG_MUL_VAL_ 1848 FirstData3 IsoTpFrameType 1-1;
SG_MUL_VAL_ 1848 FlowPadding2 IsoTpFrameType 3-3;
SG_MUL_VAL_ 1848 SingleData5 IsoTpFrameType 0-0;
SG_MUL_VAL_ 1848 ConsecutiveData5 IsoTpFrameType 2-2;
SG_MUL_VAL_ 1848 UnknownData5 IsoTpFrameType 4-15;
SG_MUL_VAL_ 1848 FirstData4 IsoTpFrameType 1-1;
SG_MUL_VAL_ 1848 FlowPadding3 IsoTpFrameType 3-3;
SG_MUL_VAL_ 1848 SingleData6 IsoTpFrameType 0-0;
SG_MUL_VAL_ 1848 ConsecutiveData6 IsoTpFrameType 2-2;
SG_MUL_VAL_ 1848 UnknownData6 IsoTpFrameType 4-15;
SG_MUL_VAL_ 1848 FirstData5 IsoTpFrameType 1-1;
SG_MUL_VAL_ 1848 FlowPadding4 IsoTpFrameType 3-3;
SG_MUL_VAL_ 1848 SingleData7 IsoTpFrameType 0-0;
SG_MUL_VAL_ 1848 ConsecutiveData7 IsoTpFrameType 2-2;
SG_MUL_VAL_ 1848 UnknownData7 IsoTpFrameType 4-15;
SG_MUL_VAL_ 1848 FirstData6 IsoTpFrameType 1-1;
SG_MUL_VAL_ 1848 FlowPadding5 IsoTpFrameType 3-3;
SG_MUL_VAL_ 1857 SingleFrameLength IsoTpFrameType 0-0;
SG_MUL_VAL_ 1857 FirstFrameLength IsoTpFrameType 1-1;
SG_MUL_VAL_ 1857 ConsecutiveSequence IsoTpFrameType 2-2;
SG_MUL_VAL_ 1857 FlowStatus IsoTpFrameType 3-3;
SG_MUL_VAL_ 1857 UnknownPciLow IsoTpFrameType 4-15;
SG_MUL_VAL_ 1857 BlockSize IsoTpFrameType 3-3;
SG_MUL_VAL_ 1857 SingleData1 IsoTpFrameType 0-0;
SG_MUL_VAL_ 1857 ConsecutiveData1 IsoTpFrameType 2-2;
SG_MUL_VAL_ 1857 UnknownData1 IsoTpFrameType 4-15;
SG_MUL_VAL_ 1857 SeparationTimeRaw IsoTpFrameType 3-3;
SG_MUL_VAL_ 1857 SingleData2 IsoTpFrameType 0-0;
SG_MUL_VAL_ 1857 ConsecutiveData2 IsoTpFrameType 2-2;
SG_MUL_VAL_ 1857 UnknownData2 IsoTpFrameType 4-15;
SG_MUL_VAL_ 1857 FirstData1 IsoTpFrameType 1-1;
SG_MUL_VAL_ 1857 SingleData3 IsoTpFrameType 0-0;
SG_MUL_VAL_ 1857 ConsecutiveData3 IsoTpFrameType 2-2;
SG_MUL_VAL_ 1857 UnknownData3 IsoTpFrameType 4-15;
SG_MUL_VAL_ 1857 FirstData2 IsoTpFrameType 1-1;
SG_MUL_VAL_ 1857 FlowPadding1 IsoTpFrameType 3-3;
SG_MUL_VAL_ 1857 SingleData4 IsoTpFrameType 0-0;
SG_MUL_VAL_ 1857 ConsecutiveData4 IsoTpFrameType 2-2;
SG_MUL_VAL_ 1857 UnknownData4 IsoTpFrameType 4-15;
SG_MUL_VAL_ 1857 FirstData3 IsoTpFrameType 1-1;
SG_MUL_VAL_ 1857 FlowPadding2 IsoTpFrameType 3-3;
SG_MUL_VAL_ 1857 SingleData5 IsoTpFrameType 0-0;
SG_MUL_VAL_ 1857 ConsecutiveData5 IsoTpFrameType 2-2;
SG_MUL_VAL_ 1857 UnknownData5 IsoTpFrameType 4-15;
SG_MUL_VAL_ 1857 FirstData4 IsoTpFrameType 1-1;
SG_MUL_VAL_ 1857 FlowPadding3 IsoTpFrameType 3-3;
SG_MUL_VAL_ 1857 SingleData6 IsoTpFrameType 0-0;
SG_MUL_VAL_ 1857 ConsecutiveData6 IsoTpFrameType 2-2;
SG_MUL_VAL_ 1857 UnknownData6 IsoTpFrameType 4-15;
SG_MUL_VAL_ 1857 FirstData5 IsoTpFrameType 1-1;
SG_MUL_VAL_ 1857 FlowPadding4 IsoTpFrameType 3-3;
SG_MUL_VAL_ 1857 SingleData7 IsoTpFrameType 0-0;
SG_MUL_VAL_ 1857 ConsecutiveData7 IsoTpFrameType 2-2;
SG_MUL_VAL_ 1857 UnknownData7 IsoTpFrameType 4-15;
SG_MUL_VAL_ 1857 FirstData6 IsoTpFrameType 1-1;
SG_MUL_VAL_ 1857 FlowPadding5 IsoTpFrameType 3-3;
SG_MUL_VAL_ 1858 SingleFrameLength IsoTpFrameType 0-0;
SG_MUL_VAL_ 1858 FirstFrameLength IsoTpFrameType 1-1;
SG_MUL_VAL_ 1858 ConsecutiveSequence IsoTpFrameType 2-2;
SG_MUL_VAL_ 1858 FlowStatus IsoTpFrameType 3-3;
SG_MUL_VAL_ 1858 UnknownPciLow IsoTpFrameType 4-15;
SG_MUL_VAL_ 1858 BlockSize IsoTpFrameType 3-3;
SG_MUL_VAL_ 1858 SingleData1 IsoTpFrameType 0-0;
SG_MUL_VAL_ 1858 ConsecutiveData1 IsoTpFrameType 2-2;
SG_MUL_VAL_ 1858 UnknownData1 IsoTpFrameType 4-15;
SG_MUL_VAL_ 1858 SeparationTimeRaw IsoTpFrameType 3-3;
SG_MUL_VAL_ 1858 SingleData2 IsoTpFrameType 0-0;
SG_MUL_VAL_ 1858 ConsecutiveData2 IsoTpFrameType 2-2;
SG_MUL_VAL_ 1858 UnknownData2 IsoTpFrameType 4-15;
SG_MUL_VAL_ 1858 FirstData1 IsoTpFrameType 1-1;
SG_MUL_VAL_ 1858 SingleData3 IsoTpFrameType 0-0;
SG_MUL_VAL_ 1858 ConsecutiveData3 IsoTpFrameType 2-2;
SG_MUL_VAL_ 1858 UnknownData3 IsoTpFrameType 4-15;
SG_MUL_VAL_ 1858 FirstData2 IsoTpFrameType 1-1;
SG_MUL_VAL_ 1858 FlowPadding1 IsoTpFrameType 3-3;
SG_MUL_VAL_ 1858 SingleData4 IsoTpFrameType 0-0;
SG_MUL_VAL_ 1858 ConsecutiveData4 IsoTpFrameType 2-2;
SG_MUL_VAL_ 1858 UnknownData4 IsoTpFrameType 4-15;
SG_MUL_VAL_ 1858 FirstData3 IsoTpFrameType 1-1;
SG_MUL_VAL_ 1858 FlowPadding2 IsoTpFrameType 3-3;
SG_MUL_VAL_ 1858 SingleData5 IsoTpFrameType 0-0;
SG_MUL_VAL_ 1858 ConsecutiveData5 IsoTpFrameType 2-2;
SG_MUL_VAL_ 1858 UnknownData5 IsoTpFrameType 4-15;
SG_MUL_VAL_ 1858 FirstData4 IsoTpFrameType 1-1;
SG_MUL_VAL_ 1858 FlowPadding3 IsoTpFrameType 3-3;
SG_MUL_VAL_ 1858 SingleData6 IsoTpFrameType 0-0;
SG_MUL_VAL_ 1858 ConsecutiveData6 IsoTpFrameType 2-2;
SG_MUL_VAL_ 1858 UnknownData6 IsoTpFrameType 4-15;
SG_MUL_VAL_ 1858 FirstData5 IsoTpFrameType 1-1;
SG_MUL_VAL_ 1858 FlowPadding4 IsoTpFrameType 3-3;
SG_MUL_VAL_ 1858 SingleData7 IsoTpFrameType 0-0;
SG_MUL_VAL_ 1858 ConsecutiveData7 IsoTpFrameType 2-2;
SG_MUL_VAL_ 1858 UnknownData7 IsoTpFrameType 4-15;
SG_MUL_VAL_ 1858 FirstData6 IsoTpFrameType 1-1;
SG_MUL_VAL_ 1858 FlowPadding5 IsoTpFrameType 3-3;
SG_MUL_VAL_ 1860 SingleFrameLength IsoTpFrameType 0-0;
SG_MUL_VAL_ 1860 FirstFrameLength IsoTpFrameType 1-1;
SG_MUL_VAL_ 1860 ConsecutiveSequence IsoTpFrameType 2-2;
SG_MUL_VAL_ 1860 FlowStatus IsoTpFrameType 3-3;
SG_MUL_VAL_ 1860 UnknownPciLow IsoTpFrameType 4-15;
SG_MUL_VAL_ 1860 BlockSize IsoTpFrameType 3-3;
SG_MUL_VAL_ 1860 SingleData1 IsoTpFrameType 0-0;
SG_MUL_VAL_ 1860 ConsecutiveData1 IsoTpFrameType 2-2;
SG_MUL_VAL_ 1860 UnknownData1 IsoTpFrameType 4-15;
SG_MUL_VAL_ 1860 SeparationTimeRaw IsoTpFrameType 3-3;
SG_MUL_VAL_ 1860 SingleData2 IsoTpFrameType 0-0;
SG_MUL_VAL_ 1860 ConsecutiveData2 IsoTpFrameType 2-2;
SG_MUL_VAL_ 1860 UnknownData2 IsoTpFrameType 4-15;
SG_MUL_VAL_ 1860 FirstData1 IsoTpFrameType 1-1;
SG_MUL_VAL_ 1860 SingleData3 IsoTpFrameType 0-0;
SG_MUL_VAL_ 1860 ConsecutiveData3 IsoTpFrameType 2-2;
SG_MUL_VAL_ 1860 UnknownData3 IsoTpFrameType 4-15;
SG_MUL_VAL_ 1860 FirstData2 IsoTpFrameType 1-1;
SG_MUL_VAL_ 1860 FlowPadding1 IsoTpFrameType 3-3;
SG_MUL_VAL_ 1860 SingleData4 IsoTpFrameType 0-0;
SG_MUL_VAL_ 1860 ConsecutiveData4 IsoTpFrameType 2-2;
SG_MUL_VAL_ 1860 UnknownData4 IsoTpFrameType 4-15;
SG_MUL_VAL_ 1860 FirstData3 IsoTpFrameType 1-1;
SG_MUL_VAL_ 1860 FlowPadding2 IsoTpFrameType 3-3;
SG_MUL_VAL_ 1860 SingleData5 IsoTpFrameType 0-0;
SG_MUL_VAL_ 1860 ConsecutiveData5 IsoTpFrameType 2-2;
SG_MUL_VAL_ 1860 UnknownData5 IsoTpFrameType 4-15;
SG_MUL_VAL_ 1860 FirstData4 IsoTpFrameType 1-1;
SG_MUL_VAL_ 1860 FlowPadding3 IsoTpFrameType 3-3;
SG_MUL_VAL_ 1860 SingleData6 IsoTpFrameType 0-0;
SG_MUL_VAL_ 1860 ConsecutiveData6 IsoTpFrameType 2-2;
SG_MUL_VAL_ 1860 UnknownData6 IsoTpFrameType 4-15;
SG_MUL_VAL_ 1860 FirstData5 IsoTpFrameType 1-1;
SG_MUL_VAL_ 1860 FlowPadding4 IsoTpFrameType 3-3;
SG_MUL_VAL_ 1860 SingleData7 IsoTpFrameType 0-0;
SG_MUL_VAL_ 1860 ConsecutiveData7 IsoTpFrameType 2-2;
SG_MUL_VAL_ 1860 UnknownData7 IsoTpFrameType 4-15;
SG_MUL_VAL_ 1860 FirstData6 IsoTpFrameType 1-1;
SG_MUL_VAL_ 1860 FlowPadding5 IsoTpFrameType 3-3;
SG_MUL_VAL_ 1861 SingleFrameLength IsoTpFrameType 0-0;
SG_MUL_VAL_ 1861 FirstFrameLength IsoTpFrameType 1-1;
SG_MUL_VAL_ 1861 ConsecutiveSequence IsoTpFrameType 2-2;
SG_MUL_VAL_ 1861 FlowStatus IsoTpFrameType 3-3;
SG_MUL_VAL_ 1861 UnknownPciLow IsoTpFrameType 4-15;
SG_MUL_VAL_ 1861 BlockSize IsoTpFrameType 3-3;
SG_MUL_VAL_ 1861 SingleData1 IsoTpFrameType 0-0;
SG_MUL_VAL_ 1861 ConsecutiveData1 IsoTpFrameType 2-2;
SG_MUL_VAL_ 1861 UnknownData1 IsoTpFrameType 4-15;
SG_MUL_VAL_ 1861 SeparationTimeRaw IsoTpFrameType 3-3;
SG_MUL_VAL_ 1861 SingleData2 IsoTpFrameType 0-0;
SG_MUL_VAL_ 1861 ConsecutiveData2 IsoTpFrameType 2-2;
SG_MUL_VAL_ 1861 UnknownData2 IsoTpFrameType 4-15;
SG_MUL_VAL_ 1861 FirstData1 IsoTpFrameType 1-1;
SG_MUL_VAL_ 1861 SingleData3 IsoTpFrameType 0-0;
SG_MUL_VAL_ 1861 ConsecutiveData3 IsoTpFrameType 2-2;
SG_MUL_VAL_ 1861 UnknownData3 IsoTpFrameType 4-15;
SG_MUL_VAL_ 1861 FirstData2 IsoTpFrameType 1-1;
SG_MUL_VAL_ 1861 FlowPadding1 IsoTpFrameType 3-3;
SG_MUL_VAL_ 1861 SingleData4 IsoTpFrameType 0-0;
SG_MUL_VAL_ 1861 ConsecutiveData4 IsoTpFrameType 2-2;
SG_MUL_VAL_ 1861 UnknownData4 IsoTpFrameType 4-15;
SG_MUL_VAL_ 1861 FirstData3 IsoTpFrameType 1-1;
SG_MUL_VAL_ 1861 FlowPadding2 IsoTpFrameType 3-3;
SG_MUL_VAL_ 1861 SingleData5 IsoTpFrameType 0-0;
SG_MUL_VAL_ 1861 ConsecutiveData5 IsoTpFrameType 2-2;
SG_MUL_VAL_ 1861 UnknownData5 IsoTpFrameType 4-15;
SG_MUL_VAL_ 1861 FirstData4 IsoTpFrameType 1-1;
SG_MUL_VAL_ 1861 FlowPadding3 IsoTpFrameType 3-3;
SG_MUL_VAL_ 1861 SingleData6 IsoTpFrameType 0-0;
SG_MUL_VAL_ 1861 ConsecutiveData6 IsoTpFrameType 2-2;
SG_MUL_VAL_ 1861 UnknownData6 IsoTpFrameType 4-15;
SG_MUL_VAL_ 1861 FirstData5 IsoTpFrameType 1-1;
SG_MUL_VAL_ 1861 FlowPadding4 IsoTpFrameType 3-3;
SG_MUL_VAL_ 1861 SingleData7 IsoTpFrameType 0-0;
SG_MUL_VAL_ 1861 ConsecutiveData7 IsoTpFrameType 2-2;
SG_MUL_VAL_ 1861 UnknownData7 IsoTpFrameType 4-15;
SG_MUL_VAL_ 1861 FirstData6 IsoTpFrameType 1-1;
SG_MUL_VAL_ 1861 FlowPadding5 IsoTpFrameType 3-3;
