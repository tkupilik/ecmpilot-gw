VERSION "eCMP INFO-DIV vehicle review 2026-11-03; 125000 bit/s; PSA-RE 67f7581e7622410efdbb29c7eda3b86982b9b450; Apache-2.0"

NS_ :

BS_:

BU_: AAS AMPLI AVP BCM BGP BSG BSI BTA BTEL BTT CDC CMB CRT DIAG_TOOL EDP_C EMF FMUX IC ICSV IDVR IVC_D MATT MDS OVIP PDS_C RAD RBG SDCM VTH WLC

BO_ 1862 MDS_DiagRequestToBSI_6: 8 MDS
 SG_ FlowPadding5 m3 : 63|8@0+ (1,0) [0|255] "raw"  BSI
 SG_ FirstData6 m1 : 63|8@0+ (1,0) [0|255] "raw"  BSI
 SG_ UnknownData7 m4 : 63|8@0+ (1,0) [0|255] "raw"  BSI
 SG_ ConsecutiveData7 m2 : 63|8@0+ (1,0) [0|255] "raw"  BSI
 SG_ SingleData7 m0 : 63|8@0+ (1,0) [0|255] "raw"  BSI
 SG_ FlowPadding4 m3 : 55|8@0+ (1,0) [0|255] "raw"  BSI
 SG_ FirstData5 m1 : 55|8@0+ (1,0) [0|255] "raw"  BSI
 SG_ UnknownData6 m4 : 55|8@0+ (1,0) [0|255] "raw"  BSI
 SG_ ConsecutiveData6 m2 : 55|8@0+ (1,0) [0|255] "raw"  BSI
 SG_ SingleData6 m0 : 55|8@0+ (1,0) [0|255] "raw"  BSI
 SG_ FlowPadding3 m3 : 47|8@0+ (1,0) [0|255] "raw"  BSI
 SG_ FirstData4 m1 : 47|8@0+ (1,0) [0|255] "raw"  BSI
 SG_ UnknownData5 m4 : 47|8@0+ (1,0) [0|255] "raw"  BSI
 SG_ ConsecutiveData5 m2 : 47|8@0+ (1,0) [0|255] "raw"  BSI
 SG_ SingleData5 m0 : 47|8@0+ (1,0) [0|255] "raw"  BSI
 SG_ FlowPadding2 m3 : 39|8@0+ (1,0) [0|255] "raw"  BSI
 SG_ FirstData3 m1 : 39|8@0+ (1,0) [0|255] "raw"  BSI
 SG_ UnknownData4 m4 : 39|8@0+ (1,0) [0|255] "raw"  BSI
 SG_ ConsecutiveData4 m2 : 39|8@0+ (1,0) [0|255] "raw"  BSI
 SG_ SingleData4 m0 : 39|8@0+ (1,0) [0|255] "raw"  BSI
 SG_ FlowPadding1 m3 : 31|8@0+ (1,0) [0|255] "raw"  BSI
 SG_ FirstData2 m1 : 31|8@0+ (1,0) [0|255] "raw"  BSI
 SG_ UnknownData3 m4 : 31|8@0+ (1,0) [0|255] "raw"  BSI
 SG_ ConsecutiveData3 m2 : 31|8@0+ (1,0) [0|255] "raw"  BSI
 SG_ SingleData3 m0 : 31|8@0+ (1,0) [0|255] "raw"  BSI
 SG_ FirstData1 m1 : 23|8@0+ (1,0) [0|255] "raw"  BSI
 SG_ UnknownData2 m4 : 23|8@0+ (1,0) [0|255] "raw"  BSI
 SG_ ConsecutiveData2 m2 : 23|8@0+ (1,0) [0|255] "raw"  BSI
 SG_ SingleData2 m0 : 23|8@0+ (1,0) [0|255] "raw"  BSI
 SG_ SeparationTimeRaw m3 : 23|8@0+ (1,0) [0|255] "raw"  BSI
 SG_ UnknownData1 m4 : 15|8@0+ (1,0) [0|255] "raw"  BSI
 SG_ ConsecutiveData1 m2 : 15|8@0+ (1,0) [0|255] "raw"  BSI
 SG_ SingleData1 m0 : 15|8@0+ (1,0) [0|255] "raw"  BSI
 SG_ BlockSize m3 : 15|8@0+ (1,0) [0|255] "raw"  BSI
 SG_ UnknownPciLow m4 : 3|4@0+ (1,0) [0|15] "raw"  BSI
 SG_ FlowStatus m3 : 3|4@0+ (1,0) [0|15] "raw"  BSI
 SG_ ConsecutiveSequence m2 : 3|4@0+ (1,0) [0|15] "raw"  BSI
 SG_ FirstFrameLength m1 : 3|12@0+ (1,0) [0|4095] "raw"  BSI
 SG_ SingleFrameLength m0 : 3|4@0+ (1,0) [0|15] "raw"  BSI
 SG_ IsoTpFrameType M : 7|4@0+ (1,0) [0|15] ""  BSI

BO_ 1863 MDS_DiagRequestToBSI_7: 8 MDS
 SG_ FlowPadding5 m3 : 63|8@0+ (1,0) [0|255] "raw"  BSI
 SG_ FirstData6 m1 : 63|8@0+ (1,0) [0|255] "raw"  BSI
 SG_ UnknownData7 m4 : 63|8@0+ (1,0) [0|255] "raw"  BSI
 SG_ ConsecutiveData7 m2 : 63|8@0+ (1,0) [0|255] "raw"  BSI
 SG_ SingleData7 m0 : 63|8@0+ (1,0) [0|255] "raw"  BSI
 SG_ FlowPadding4 m3 : 55|8@0+ (1,0) [0|255] "raw"  BSI
 SG_ FirstData5 m1 : 55|8@0+ (1,0) [0|255] "raw"  BSI
 SG_ UnknownData6 m4 : 55|8@0+ (1,0) [0|255] "raw"  BSI
 SG_ ConsecutiveData6 m2 : 55|8@0+ (1,0) [0|255] "raw"  BSI
 SG_ SingleData6 m0 : 55|8@0+ (1,0) [0|255] "raw"  BSI
 SG_ FlowPadding3 m3 : 47|8@0+ (1,0) [0|255] "raw"  BSI
 SG_ FirstData4 m1 : 47|8@0+ (1,0) [0|255] "raw"  BSI
 SG_ UnknownData5 m4 : 47|8@0+ (1,0) [0|255] "raw"  BSI
 SG_ ConsecutiveData5 m2 : 47|8@0+ (1,0) [0|255] "raw"  BSI
 SG_ SingleData5 m0 : 47|8@0+ (1,0) [0|255] "raw"  BSI
 SG_ FlowPadding2 m3 : 39|8@0+ (1,0) [0|255] "raw"  BSI
 SG_ FirstData3 m1 : 39|8@0+ (1,0) [0|255] "raw"  BSI
 SG_ UnknownData4 m4 : 39|8@0+ (1,0) [0|255] "raw"  BSI
 SG_ ConsecutiveData4 m2 : 39|8@0+ (1,0) [0|255] "raw"  BSI
 SG_ SingleData4 m0 : 39|8@0+ (1,0) [0|255] "raw"  BSI
 SG_ FlowPadding1 m3 : 31|8@0+ (1,0) [0|255] "raw"  BSI
 SG_ FirstData2 m1 : 31|8@0+ (1,0) [0|255] "raw"  BSI
 SG_ UnknownData3 m4 : 31|8@0+ (1,0) [0|255] "raw"  BSI
 SG_ ConsecutiveData3 m2 : 31|8@0+ (1,0) [0|255] "raw"  BSI
 SG_ SingleData3 m0 : 31|8@0+ (1,0) [0|255] "raw"  BSI
 SG_ FirstData1 m1 : 23|8@0+ (1,0) [0|255] "raw"  BSI
 SG_ UnknownData2 m4 : 23|8@0+ (1,0) [0|255] "raw"  BSI
 SG_ ConsecutiveData2 m2 : 23|8@0+ (1,0) [0|255] "raw"  BSI
 SG_ SingleData2 m0 : 23|8@0+ (1,0) [0|255] "raw"  BSI
 SG_ SeparationTimeRaw m3 : 23|8@0+ (1,0) [0|255] "raw"  BSI
 SG_ UnknownData1 m4 : 15|8@0+ (1,0) [0|255] "raw"  BSI
 SG_ ConsecutiveData1 m2 : 15|8@0+ (1,0) [0|255] "raw"  BSI
 SG_ SingleData1 m0 : 15|8@0+ (1,0) [0|255] "raw"  BSI
 SG_ BlockSize m3 : 15|8@0+ (1,0) [0|255] "raw"  BSI
 SG_ UnknownPciLow m4 : 3|4@0+ (1,0) [0|15] "raw"  BSI
 SG_ FlowStatus m3 : 3|4@0+ (1,0) [0|15] "raw"  BSI
 SG_ ConsecutiveSequence m2 : 3|4@0+ (1,0) [0|15] "raw"  BSI
 SG_ FirstFrameLength m1 : 3|12@0+ (1,0) [0|4095] "raw"  BSI
 SG_ SingleFrameLength m0 : 3|4@0+ (1,0) [0|15] "raw"  BSI
 SG_ IsoTpFrameType M : 7|4@0+ (1,0) [0|15] ""  BSI

BO_ 1864 MDS_DiagRequestToBSI_8: 8 MDS
 SG_ FlowPadding5 m3 : 63|8@0+ (1,0) [0|255] "raw"  BSI
 SG_ FirstData6 m1 : 63|8@0+ (1,0) [0|255] "raw"  BSI
 SG_ UnknownData7 m4 : 63|8@0+ (1,0) [0|255] "raw"  BSI
 SG_ ConsecutiveData7 m2 : 63|8@0+ (1,0) [0|255] "raw"  BSI
 SG_ SingleData7 m0 : 63|8@0+ (1,0) [0|255] "raw"  BSI
 SG_ FlowPadding4 m3 : 55|8@0+ (1,0) [0|255] "raw"  BSI
 SG_ FirstData5 m1 : 55|8@0+ (1,0) [0|255] "raw"  BSI
 SG_ UnknownData6 m4 : 55|8@0+ (1,0) [0|255] "raw"  BSI
 SG_ ConsecutiveData6 m2 : 55|8@0+ (1,0) [0|255] "raw"  BSI
 SG_ SingleData6 m0 : 55|8@0+ (1,0) [0|255] "raw"  BSI
 SG_ FlowPadding3 m3 : 47|8@0+ (1,0) [0|255] "raw"  BSI
 SG_ FirstData4 m1 : 47|8@0+ (1,0) [0|255] "raw"  BSI
 SG_ UnknownData5 m4 : 47|8@0+ (1,0) [0|255] "raw"  BSI
 SG_ ConsecutiveData5 m2 : 47|8@0+ (1,0) [0|255] "raw"  BSI
 SG_ SingleData5 m0 : 47|8@0+ (1,0) [0|255] "raw"  BSI
 SG_ FlowPadding2 m3 : 39|8@0+ (1,0) [0|255] "raw"  BSI
 SG_ FirstData3 m1 : 39|8@0+ (1,0) [0|255] "raw"  BSI
 SG_ UnknownData4 m4 : 39|8@0+ (1,0) [0|255] "raw"  BSI
 SG_ ConsecutiveData4 m2 : 39|8@0+ (1,0) [0|255] "raw"  BSI
 SG_ SingleData4 m0 : 39|8@0+ (1,0) [0|255] "raw"  BSI
 SG_ FlowPadding1 m3 : 31|8@0+ (1,0) [0|255] "raw"  BSI
 SG_ FirstData2 m1 : 31|8@0+ (1,0) [0|255] "raw"  BSI
 SG_ UnknownData3 m4 : 31|8@0+ (1,0) [0|255] "raw"  BSI
 SG_ ConsecutiveData3 m2 : 31|8@0+ (1,0) [0|255] "raw"  BSI
 SG_ SingleData3 m0 : 31|8@0+ (1,0) [0|255] "raw"  BSI
 SG_ FirstData1 m1 : 23|8@0+ (1,0) [0|255] "raw"  BSI
 SG_ UnknownData2 m4 : 23|8@0+ (1,0) [0|255] "raw"  BSI
 SG_ ConsecutiveData2 m2 : 23|8@0+ (1,0) [0|255] "raw"  BSI
 SG_ SingleData2 m0 : 23|8@0+ (1,0) [0|255] "raw"  BSI
 SG_ SeparationTimeRaw m3 : 23|8@0+ (1,0) [0|255] "raw"  BSI
 SG_ UnknownData1 m4 : 15|8@0+ (1,0) [0|255] "raw"  BSI
 SG_ ConsecutiveData1 m2 : 15|8@0+ (1,0) [0|255] "raw"  BSI
 SG_ SingleData1 m0 : 15|8@0+ (1,0) [0|255] "raw"  BSI
 SG_ BlockSize m3 : 15|8@0+ (1,0) [0|255] "raw"  BSI
 SG_ UnknownPciLow m4 : 3|4@0+ (1,0) [0|15] "raw"  BSI
 SG_ FlowStatus m3 : 3|4@0+ (1,0) [0|15] "raw"  BSI
 SG_ ConsecutiveSequence m2 : 3|4@0+ (1,0) [0|15] "raw"  BSI
 SG_ FirstFrameLength m1 : 3|12@0+ (1,0) [0|4095] "raw"  BSI
 SG_ SingleFrameLength m0 : 3|4@0+ (1,0) [0|15] "raw"  BSI
 SG_ IsoTpFrameType M : 7|4@0+ (1,0) [0|15] ""  BSI

BO_ 1865 MDS_DiagRequestToBSI_9: 8 MDS
 SG_ FlowPadding5 m3 : 63|8@0+ (1,0) [0|255] "raw"  BSI
 SG_ FirstData6 m1 : 63|8@0+ (1,0) [0|255] "raw"  BSI
 SG_ UnknownData7 m4 : 63|8@0+ (1,0) [0|255] "raw"  BSI
 SG_ ConsecutiveData7 m2 : 63|8@0+ (1,0) [0|255] "raw"  BSI
 SG_ SingleData7 m0 : 63|8@0+ (1,0) [0|255] "raw"  BSI
 SG_ FlowPadding4 m3 : 55|8@0+ (1,0) [0|255] "raw"  BSI
 SG_ FirstData5 m1 : 55|8@0+ (1,0) [0|255] "raw"  BSI
 SG_ UnknownData6 m4 : 55|8@0+ (1,0) [0|255] "raw"  BSI
 SG_ ConsecutiveData6 m2 : 55|8@0+ (1,0) [0|255] "raw"  BSI
 SG_ SingleData6 m0 : 55|8@0+ (1,0) [0|255] "raw"  BSI
 SG_ FlowPadding3 m3 : 47|8@0+ (1,0) [0|255] "raw"  BSI
 SG_ FirstData4 m1 : 47|8@0+ (1,0) [0|255] "raw"  BSI
 SG_ UnknownData5 m4 : 47|8@0+ (1,0) [0|255] "raw"  BSI
 SG_ ConsecutiveData5 m2 : 47|8@0+ (1,0) [0|255] "raw"  BSI
 SG_ SingleData5 m0 : 47|8@0+ (1,0) [0|255] "raw"  BSI
 SG_ FlowPadding2 m3 : 39|8@0+ (1,0) [0|255] "raw"  BSI
 SG_ FirstData3 m1 : 39|8@0+ (1,0) [0|255] "raw"  BSI
 SG_ UnknownData4 m4 : 39|8@0+ (1,0) [0|255] "raw"  BSI
 SG_ ConsecutiveData4 m2 : 39|8@0+ (1,0) [0|255] "raw"  BSI
 SG_ SingleData4 m0 : 39|8@0+ (1,0) [0|255] "raw"  BSI
 SG_ FlowPadding1 m3 : 31|8@0+ (1,0) [0|255] "raw"  BSI
 SG_ FirstData2 m1 : 31|8@0+ (1,0) [0|255] "raw"  BSI
 SG_ UnknownData3 m4 : 31|8@0+ (1,0) [0|255] "raw"  BSI
 SG_ ConsecutiveData3 m2 : 31|8@0+ (1,0) [0|255] "raw"  BSI
 SG_ SingleData3 m0 : 31|8@0+ (1,0) [0|255] "raw"  BSI
 SG_ FirstData1 m1 : 23|8@0+ (1,0) [0|255] "raw"  BSI
 SG_ UnknownData2 m4 : 23|8@0+ (1,0) [0|255] "raw"  BSI
 SG_ ConsecutiveData2 m2 : 23|8@0+ (1,0) [0|255] "raw"  BSI
 SG_ SingleData2 m0 : 23|8@0+ (1,0) [0|255] "raw"  BSI
 SG_ SeparationTimeRaw m3 : 23|8@0+ (1,0) [0|255] "raw"  BSI
 SG_ UnknownData1 m4 : 15|8@0+ (1,0) [0|255] "raw"  BSI
 SG_ ConsecutiveData1 m2 : 15|8@0+ (1,0) [0|255] "raw"  BSI
 SG_ SingleData1 m0 : 15|8@0+ (1,0) [0|255] "raw"  BSI
 SG_ BlockSize m3 : 15|8@0+ (1,0) [0|255] "raw"  BSI
 SG_ UnknownPciLow m4 : 3|4@0+ (1,0) [0|15] "raw"  BSI
 SG_ FlowStatus m3 : 3|4@0+ (1,0) [0|15] "raw"  BSI
 SG_ ConsecutiveSequence m2 : 3|4@0+ (1,0) [0|15] "raw"  BSI
 SG_ FirstFrameLength m1 : 3|12@0+ (1,0) [0|4095] "raw"  BSI
 SG_ SingleFrameLength m0 : 3|4@0+ (1,0) [0|15] "raw"  BSI
 SG_ IsoTpFrameType M : 7|4@0+ (1,0) [0|15] ""  BSI

BO_ 1866 MDS_DiagRequestToBSI_10: 8 MDS
 SG_ FlowPadding5 m3 : 63|8@0+ (1,0) [0|255] "raw"  BSI
 SG_ FirstData6 m1 : 63|8@0+ (1,0) [0|255] "raw"  BSI
 SG_ UnknownData7 m4 : 63|8@0+ (1,0) [0|255] "raw"  BSI
 SG_ ConsecutiveData7 m2 : 63|8@0+ (1,0) [0|255] "raw"  BSI
 SG_ SingleData7 m0 : 63|8@0+ (1,0) [0|255] "raw"  BSI
 SG_ FlowPadding4 m3 : 55|8@0+ (1,0) [0|255] "raw"  BSI
 SG_ FirstData5 m1 : 55|8@0+ (1,0) [0|255] "raw"  BSI
 SG_ UnknownData6 m4 : 55|8@0+ (1,0) [0|255] "raw"  BSI
 SG_ ConsecutiveData6 m2 : 55|8@0+ (1,0) [0|255] "raw"  BSI
 SG_ SingleData6 m0 : 55|8@0+ (1,0) [0|255] "raw"  BSI
 SG_ FlowPadding3 m3 : 47|8@0+ (1,0) [0|255] "raw"  BSI
 SG_ FirstData4 m1 : 47|8@0+ (1,0) [0|255] "raw"  BSI
 SG_ UnknownData5 m4 : 47|8@0+ (1,0) [0|255] "raw"  BSI
 SG_ ConsecutiveData5 m2 : 47|8@0+ (1,0) [0|255] "raw"  BSI
 SG_ SingleData5 m0 : 47|8@0+ (1,0) [0|255] "raw"  BSI
 SG_ FlowPadding2 m3 : 39|8@0+ (1,0) [0|255] "raw"  BSI
 SG_ FirstData3 m1 : 39|8@0+ (1,0) [0|255] "raw"  BSI
 SG_ UnknownData4 m4 : 39|8@0+ (1,0) [0|255] "raw"  BSI
 SG_ ConsecutiveData4 m2 : 39|8@0+ (1,0) [0|255] "raw"  BSI
 SG_ SingleData4 m0 : 39|8@0+ (1,0) [0|255] "raw"  BSI
 SG_ FlowPadding1 m3 : 31|8@0+ (1,0) [0|255] "raw"  BSI
 SG_ FirstData2 m1 : 31|8@0+ (1,0) [0|255] "raw"  BSI
 SG_ UnknownData3 m4 : 31|8@0+ (1,0) [0|255] "raw"  BSI
 SG_ ConsecutiveData3 m2 : 31|8@0+ (1,0) [0|255] "raw"  BSI
 SG_ SingleData3 m0 : 31|8@0+ (1,0) [0|255] "raw"  BSI
 SG_ FirstData1 m1 : 23|8@0+ (1,0) [0|255] "raw"  BSI
 SG_ UnknownData2 m4 : 23|8@0+ (1,0) [0|255] "raw"  BSI
 SG_ ConsecutiveData2 m2 : 23|8@0+ (1,0) [0|255] "raw"  BSI
 SG_ SingleData2 m0 : 23|8@0+ (1,0) [0|255] "raw"  BSI
 SG_ SeparationTimeRaw m3 : 23|8@0+ (1,0) [0|255] "raw"  BSI
 SG_ UnknownData1 m4 : 15|8@0+ (1,0) [0|255] "raw"  BSI
 SG_ ConsecutiveData1 m2 : 15|8@0+ (1,0) [0|255] "raw"  BSI
 SG_ SingleData1 m0 : 15|8@0+ (1,0) [0|255] "raw"  BSI
 SG_ BlockSize m3 : 15|8@0+ (1,0) [0|255] "raw"  BSI
 SG_ UnknownPciLow m4 : 3|4@0+ (1,0) [0|15] "raw"  BSI
 SG_ FlowStatus m3 : 3|4@0+ (1,0) [0|15] "raw"  BSI
 SG_ ConsecutiveSequence m2 : 3|4@0+ (1,0) [0|15] "raw"  BSI
 SG_ FirstFrameLength m1 : 3|12@0+ (1,0) [0|4095] "raw"  BSI
 SG_ SingleFrameLength m0 : 3|4@0+ (1,0) [0|15] "raw"  BSI
 SG_ IsoTpFrameType M : 7|4@0+ (1,0) [0|15] ""  BSI

BO_ 1867 MDS_DiagRequestToBSI_11: 8 MDS
 SG_ FlowPadding5 m3 : 63|8@0+ (1,0) [0|255] "raw"  BSI
 SG_ FirstData6 m1 : 63|8@0+ (1,0) [0|255] "raw"  BSI
 SG_ UnknownData7 m4 : 63|8@0+ (1,0) [0|255] "raw"  BSI
 SG_ ConsecutiveData7 m2 : 63|8@0+ (1,0) [0|255] "raw"  BSI
 SG_ SingleData7 m0 : 63|8@0+ (1,0) [0|255] "raw"  BSI
 SG_ FlowPadding4 m3 : 55|8@0+ (1,0) [0|255] "raw"  BSI
 SG_ FirstData5 m1 : 55|8@0+ (1,0) [0|255] "raw"  BSI
 SG_ UnknownData6 m4 : 55|8@0+ (1,0) [0|255] "raw"  BSI
 SG_ ConsecutiveData6 m2 : 55|8@0+ (1,0) [0|255] "raw"  BSI
 SG_ SingleData6 m0 : 55|8@0+ (1,0) [0|255] "raw"  BSI
 SG_ FlowPadding3 m3 : 47|8@0+ (1,0) [0|255] "raw"  BSI
 SG_ FirstData4 m1 : 47|8@0+ (1,0) [0|255] "raw"  BSI
 SG_ UnknownData5 m4 : 47|8@0+ (1,0) [0|255] "raw"  BSI
 SG_ ConsecutiveData5 m2 : 47|8@0+ (1,0) [0|255] "raw"  BSI
 SG_ SingleData5 m0 : 47|8@0+ (1,0) [0|255] "raw"  BSI
 SG_ FlowPadding2 m3 : 39|8@0+ (1,0) [0|255] "raw"  BSI
 SG_ FirstData3 m1 : 39|8@0+ (1,0) [0|255] "raw"  BSI
 SG_ UnknownData4 m4 : 39|8@0+ (1,0) [0|255] "raw"  BSI
 SG_ ConsecutiveData4 m2 : 39|8@0+ (1,0) [0|255] "raw"  BSI
 SG_ SingleData4 m0 : 39|8@0+ (1,0) [0|255] "raw"  BSI
 SG_ FlowPadding1 m3 : 31|8@0+ (1,0) [0|255] "raw"  BSI
 SG_ FirstData2 m1 : 31|8@0+ (1,0) [0|255] "raw"  BSI
 SG_ UnknownData3 m4 : 31|8@0+ (1,0) [0|255] "raw"  BSI
 SG_ ConsecutiveData3 m2 : 31|8@0+ (1,0) [0|255] "raw"  BSI
 SG_ SingleData3 m0 : 31|8@0+ (1,0) [0|255] "raw"  BSI
 SG_ FirstData1 m1 : 23|8@0+ (1,0) [0|255] "raw"  BSI
 SG_ UnknownData2 m4 : 23|8@0+ (1,0) [0|255] "raw"  BSI
 SG_ ConsecutiveData2 m2 : 23|8@0+ (1,0) [0|255] "raw"  BSI
 SG_ SingleData2 m0 : 23|8@0+ (1,0) [0|255] "raw"  BSI
 SG_ SeparationTimeRaw m3 : 23|8@0+ (1,0) [0|255] "raw"  BSI
 SG_ UnknownData1 m4 : 15|8@0+ (1,0) [0|255] "raw"  BSI
 SG_ ConsecutiveData1 m2 : 15|8@0+ (1,0) [0|255] "raw"  BSI
 SG_ SingleData1 m0 : 15|8@0+ (1,0) [0|255] "raw"  BSI
 SG_ BlockSize m3 : 15|8@0+ (1,0) [0|255] "raw"  BSI
 SG_ UnknownPciLow m4 : 3|4@0+ (1,0) [0|15] "raw"  BSI
 SG_ FlowStatus m3 : 3|4@0+ (1,0) [0|15] "raw"  BSI
 SG_ ConsecutiveSequence m2 : 3|4@0+ (1,0) [0|15] "raw"  BSI
 SG_ FirstFrameLength m1 : 3|12@0+ (1,0) [0|4095] "raw"  BSI
 SG_ SingleFrameLength m0 : 3|4@0+ (1,0) [0|15] "raw"  BSI
 SG_ IsoTpFrameType M : 7|4@0+ (1,0) [0|15] ""  BSI

BO_ 1868 BSI_DiagRequestToCRT: 8 BSI
 SG_ FlowPadding5 m3 : 63|8@0+ (1,0) [0|255] "raw"  CRT
 SG_ FirstData6 m1 : 63|8@0+ (1,0) [0|255] "raw"  CRT
 SG_ UnknownData7 m4 : 63|8@0+ (1,0) [0|255] "raw"  CRT
 SG_ ConsecutiveData7 m2 : 63|8@0+ (1,0) [0|255] "raw"  CRT
 SG_ SingleData7 m0 : 63|8@0+ (1,0) [0|255] "raw"  CRT
 SG_ FlowPadding4 m3 : 55|8@0+ (1,0) [0|255] "raw"  CRT
 SG_ FirstData5 m1 : 55|8@0+ (1,0) [0|255] "raw"  CRT
 SG_ UnknownData6 m4 : 55|8@0+ (1,0) [0|255] "raw"  CRT
 SG_ ConsecutiveData6 m2 : 55|8@0+ (1,0) [0|255] "raw"  CRT
 SG_ SingleData6 m0 : 55|8@0+ (1,0) [0|255] "raw"  CRT
 SG_ FlowPadding3 m3 : 47|8@0+ (1,0) [0|255] "raw"  CRT
 SG_ FirstData4 m1 : 47|8@0+ (1,0) [0|255] "raw"  CRT
 SG_ UnknownData5 m4 : 47|8@0+ (1,0) [0|255] "raw"  CRT
 SG_ ConsecutiveData5 m2 : 47|8@0+ (1,0) [0|255] "raw"  CRT
 SG_ SingleData5 m0 : 47|8@0+ (1,0) [0|255] "raw"  CRT
 SG_ FlowPadding2 m3 : 39|8@0+ (1,0) [0|255] "raw"  CRT
 SG_ FirstData3 m1 : 39|8@0+ (1,0) [0|255] "raw"  CRT
 SG_ UnknownData4 m4 : 39|8@0+ (1,0) [0|255] "raw"  CRT
 SG_ ConsecutiveData4 m2 : 39|8@0+ (1,0) [0|255] "raw"  CRT
 SG_ SingleData4 m0 : 39|8@0+ (1,0) [0|255] "raw"  CRT
 SG_ FlowPadding1 m3 : 31|8@0+ (1,0) [0|255] "raw"  CRT
 SG_ FirstData2 m1 : 31|8@0+ (1,0) [0|255] "raw"  CRT
 SG_ UnknownData3 m4 : 31|8@0+ (1,0) [0|255] "raw"  CRT
 SG_ ConsecutiveData3 m2 : 31|8@0+ (1,0) [0|255] "raw"  CRT
 SG_ SingleData3 m0 : 31|8@0+ (1,0) [0|255] "raw"  CRT
 SG_ FirstData1 m1 : 23|8@0+ (1,0) [0|255] "raw"  CRT
 SG_ UnknownData2 m4 : 23|8@0+ (1,0) [0|255] "raw"  CRT
 SG_ ConsecutiveData2 m2 : 23|8@0+ (1,0) [0|255] "raw"  CRT
 SG_ SingleData2 m0 : 23|8@0+ (1,0) [0|255] "raw"  CRT
 SG_ SeparationTimeRaw m3 : 23|8@0+ (1,0) [0|255] "raw"  CRT
 SG_ UnknownData1 m4 : 15|8@0+ (1,0) [0|255] "raw"  CRT
 SG_ ConsecutiveData1 m2 : 15|8@0+ (1,0) [0|255] "raw"  CRT
 SG_ SingleData1 m0 : 15|8@0+ (1,0) [0|255] "raw"  CRT
 SG_ BlockSize m3 : 15|8@0+ (1,0) [0|255] "raw"  CRT
 SG_ UnknownPciLow m4 : 3|4@0+ (1,0) [0|15] "raw"  CRT
 SG_ FlowStatus m3 : 3|4@0+ (1,0) [0|15] "raw"  CRT
 SG_ ConsecutiveSequence m2 : 3|4@0+ (1,0) [0|15] "raw"  CRT
 SG_ FirstFrameLength m1 : 3|12@0+ (1,0) [0|4095] "raw"  CRT
 SG_ SingleFrameLength m0 : 3|4@0+ (1,0) [0|15] "raw"  CRT
 SG_ IsoTpFrameType M : 7|4@0+ (1,0) [0|15] ""  CRT

BO_ 1871 MDS_DiagRequestToBSI_12: 8 MDS
 SG_ FlowPadding5 m3 : 63|8@0+ (1,0) [0|255] "raw"  BSI
 SG_ FirstData6 m1 : 63|8@0+ (1,0) [0|255] "raw"  BSI
 SG_ UnknownData7 m4 : 63|8@0+ (1,0) [0|255] "raw"  BSI
 SG_ ConsecutiveData7 m2 : 63|8@0+ (1,0) [0|255] "raw"  BSI
 SG_ SingleData7 m0 : 63|8@0+ (1,0) [0|255] "raw"  BSI
 SG_ FlowPadding4 m3 : 55|8@0+ (1,0) [0|255] "raw"  BSI
 SG_ FirstData5 m1 : 55|8@0+ (1,0) [0|255] "raw"  BSI
 SG_ UnknownData6 m4 : 55|8@0+ (1,0) [0|255] "raw"  BSI
 SG_ ConsecutiveData6 m2 : 55|8@0+ (1,0) [0|255] "raw"  BSI
 SG_ SingleData6 m0 : 55|8@0+ (1,0) [0|255] "raw"  BSI
 SG_ FlowPadding3 m3 : 47|8@0+ (1,0) [0|255] "raw"  BSI
 SG_ FirstData4 m1 : 47|8@0+ (1,0) [0|255] "raw"  BSI
 SG_ UnknownData5 m4 : 47|8@0+ (1,0) [0|255] "raw"  BSI
 SG_ ConsecutiveData5 m2 : 47|8@0+ (1,0) [0|255] "raw"  BSI
 SG_ SingleData5 m0 : 47|8@0+ (1,0) [0|255] "raw"  BSI
 SG_ FlowPadding2 m3 : 39|8@0+ (1,0) [0|255] "raw"  BSI
 SG_ FirstData3 m1 : 39|8@0+ (1,0) [0|255] "raw"  BSI
 SG_ UnknownData4 m4 : 39|8@0+ (1,0) [0|255] "raw"  BSI
 SG_ ConsecutiveData4 m2 : 39|8@0+ (1,0) [0|255] "raw"  BSI
 SG_ SingleData4 m0 : 39|8@0+ (1,0) [0|255] "raw"  BSI
 SG_ FlowPadding1 m3 : 31|8@0+ (1,0) [0|255] "raw"  BSI
 SG_ FirstData2 m1 : 31|8@0+ (1,0) [0|255] "raw"  BSI
 SG_ UnknownData3 m4 : 31|8@0+ (1,0) [0|255] "raw"  BSI
 SG_ ConsecutiveData3 m2 : 31|8@0+ (1,0) [0|255] "raw"  BSI
 SG_ SingleData3 m0 : 31|8@0+ (1,0) [0|255] "raw"  BSI
 SG_ FirstData1 m1 : 23|8@0+ (1,0) [0|255] "raw"  BSI
 SG_ UnknownData2 m4 : 23|8@0+ (1,0) [0|255] "raw"  BSI
 SG_ ConsecutiveData2 m2 : 23|8@0+ (1,0) [0|255] "raw"  BSI
 SG_ SingleData2 m0 : 23|8@0+ (1,0) [0|255] "raw"  BSI
 SG_ SeparationTimeRaw m3 : 23|8@0+ (1,0) [0|255] "raw"  BSI
 SG_ UnknownData1 m4 : 15|8@0+ (1,0) [0|255] "raw"  BSI
 SG_ ConsecutiveData1 m2 : 15|8@0+ (1,0) [0|255] "raw"  BSI
 SG_ SingleData1 m0 : 15|8@0+ (1,0) [0|255] "raw"  BSI
 SG_ BlockSize m3 : 15|8@0+ (1,0) [0|255] "raw"  BSI
 SG_ UnknownPciLow m4 : 3|4@0+ (1,0) [0|15] "raw"  BSI
 SG_ FlowStatus m3 : 3|4@0+ (1,0) [0|15] "raw"  BSI
 SG_ ConsecutiveSequence m2 : 3|4@0+ (1,0) [0|15] "raw"  BSI
 SG_ FirstFrameLength m1 : 3|12@0+ (1,0) [0|4095] "raw"  BSI
 SG_ SingleFrameLength m0 : 3|4@0+ (1,0) [0|15] "raw"  BSI
 SG_ IsoTpFrameType M : 7|4@0+ (1,0) [0|15] ""  BSI

BO_ 1875 MDS_DiagRequestToBSI_13: 8 MDS
 SG_ FlowPadding5 m3 : 63|8@0+ (1,0) [0|255] "raw"  BSI
 SG_ FirstData6 m1 : 63|8@0+ (1,0) [0|255] "raw"  BSI
 SG_ UnknownData7 m4 : 63|8@0+ (1,0) [0|255] "raw"  BSI
 SG_ ConsecutiveData7 m2 : 63|8@0+ (1,0) [0|255] "raw"  BSI
 SG_ SingleData7 m0 : 63|8@0+ (1,0) [0|255] "raw"  BSI
 SG_ FlowPadding4 m3 : 55|8@0+ (1,0) [0|255] "raw"  BSI
 SG_ FirstData5 m1 : 55|8@0+ (1,0) [0|255] "raw"  BSI
 SG_ UnknownData6 m4 : 55|8@0+ (1,0) [0|255] "raw"  BSI
 SG_ ConsecutiveData6 m2 : 55|8@0+ (1,0) [0|255] "raw"  BSI
 SG_ SingleData6 m0 : 55|8@0+ (1,0) [0|255] "raw"  BSI
 SG_ FlowPadding3 m3 : 47|8@0+ (1,0) [0|255] "raw"  BSI
 SG_ FirstData4 m1 : 47|8@0+ (1,0) [0|255] "raw"  BSI
 SG_ UnknownData5 m4 : 47|8@0+ (1,0) [0|255] "raw"  BSI
 SG_ ConsecutiveData5 m2 : 47|8@0+ (1,0) [0|255] "raw"  BSI
 SG_ SingleData5 m0 : 47|8@0+ (1,0) [0|255] "raw"  BSI
 SG_ FlowPadding2 m3 : 39|8@0+ (1,0) [0|255] "raw"  BSI
 SG_ FirstData3 m1 : 39|8@0+ (1,0) [0|255] "raw"  BSI
 SG_ UnknownData4 m4 : 39|8@0+ (1,0) [0|255] "raw"  BSI
 SG_ ConsecutiveData4 m2 : 39|8@0+ (1,0) [0|255] "raw"  BSI
 SG_ SingleData4 m0 : 39|8@0+ (1,0) [0|255] "raw"  BSI
 SG_ FlowPadding1 m3 : 31|8@0+ (1,0) [0|255] "raw"  BSI
 SG_ FirstData2 m1 : 31|8@0+ (1,0) [0|255] "raw"  BSI
 SG_ UnknownData3 m4 : 31|8@0+ (1,0) [0|255] "raw"  BSI
 SG_ ConsecutiveData3 m2 : 31|8@0+ (1,0) [0|255] "raw"  BSI
 SG_ SingleData3 m0 : 31|8@0+ (1,0) [0|255] "raw"  BSI
 SG_ FirstData1 m1 : 23|8@0+ (1,0) [0|255] "raw"  BSI
 SG_ UnknownData2 m4 : 23|8@0+ (1,0) [0|255] "raw"  BSI
 SG_ ConsecutiveData2 m2 : 23|8@0+ (1,0) [0|255] "raw"  BSI
 SG_ SingleData2 m0 : 23|8@0+ (1,0) [0|255] "raw"  BSI
 SG_ SeparationTimeRaw m3 : 23|8@0+ (1,0) [0|255] "raw"  BSI
 SG_ UnknownData1 m4 : 15|8@0+ (1,0) [0|255] "raw"  BSI
 SG_ ConsecutiveData1 m2 : 15|8@0+ (1,0) [0|255] "raw"  BSI
 SG_ SingleData1 m0 : 15|8@0+ (1,0) [0|255] "raw"  BSI
 SG_ BlockSize m3 : 15|8@0+ (1,0) [0|255] "raw"  BSI
 SG_ UnknownPciLow m4 : 3|4@0+ (1,0) [0|15] "raw"  BSI
 SG_ FlowStatus m3 : 3|4@0+ (1,0) [0|15] "raw"  BSI
 SG_ ConsecutiveSequence m2 : 3|4@0+ (1,0) [0|15] "raw"  BSI
 SG_ FirstFrameLength m1 : 3|12@0+ (1,0) [0|4095] "raw"  BSI
 SG_ SingleFrameLength m0 : 3|4@0+ (1,0) [0|15] "raw"  BSI
 SG_ IsoTpFrameType M : 7|4@0+ (1,0) [0|15] ""  BSI

BO_ 1880 MDS_BopDiagRequest: 8 MDS
 SG_ DiagnosticData : 7|64@0+ (1,0) [0|18446744073709551615] ""  BSI

BO_ 1881 MDS_DiagRequestToBSI_14: 8 MDS
 SG_ FlowPadding5 m3 : 63|8@0+ (1,0) [0|255] "raw"  BSI
 SG_ FirstData6 m1 : 63|8@0+ (1,0) [0|255] "raw"  BSI
 SG_ UnknownData7 m4 : 63|8@0+ (1,0) [0|255] "raw"  BSI
 SG_ ConsecutiveData7 m2 : 63|8@0+ (1,0) [0|255] "raw"  BSI
 SG_ SingleData7 m0 : 63|8@0+ (1,0) [0|255] "raw"  BSI
 SG_ FlowPadding4 m3 : 55|8@0+ (1,0) [0|255] "raw"  BSI
 SG_ FirstData5 m1 : 55|8@0+ (1,0) [0|255] "raw"  BSI
 SG_ UnknownData6 m4 : 55|8@0+ (1,0) [0|255] "raw"  BSI
 SG_ ConsecutiveData6 m2 : 55|8@0+ (1,0) [0|255] "raw"  BSI
 SG_ SingleData6 m0 : 55|8@0+ (1,0) [0|255] "raw"  BSI
 SG_ FlowPadding3 m3 : 47|8@0+ (1,0) [0|255] "raw"  BSI
 SG_ FirstData4 m1 : 47|8@0+ (1,0) [0|255] "raw"  BSI
 SG_ UnknownData5 m4 : 47|8@0+ (1,0) [0|255] "raw"  BSI
 SG_ ConsecutiveData5 m2 : 47|8@0+ (1,0) [0|255] "raw"  BSI
 SG_ SingleData5 m0 : 47|8@0+ (1,0) [0|255] "raw"  BSI
 SG_ FlowPadding2 m3 : 39|8@0+ (1,0) [0|255] "raw"  BSI
 SG_ FirstData3 m1 : 39|8@0+ (1,0) [0|255] "raw"  BSI
 SG_ UnknownData4 m4 : 39|8@0+ (1,0) [0|255] "raw"  BSI
 SG_ ConsecutiveData4 m2 : 39|8@0+ (1,0) [0|255] "raw"  BSI
 SG_ SingleData4 m0 : 39|8@0+ (1,0) [0|255] "raw"  BSI
 SG_ FlowPadding1 m3 : 31|8@0+ (1,0) [0|255] "raw"  BSI
 SG_ FirstData2 m1 : 31|8@0+ (1,0) [0|255] "raw"  BSI
 SG_ UnknownData3 m4 : 31|8@0+ (1,0) [0|255] "raw"  BSI
 SG_ ConsecutiveData3 m2 : 31|8@0+ (1,0) [0|255] "raw"  BSI
 SG_ SingleData3 m0 : 31|8@0+ (1,0) [0|255] "raw"  BSI
 SG_ FirstData1 m1 : 23|8@0+ (1,0) [0|255] "raw"  BSI
 SG_ UnknownData2 m4 : 23|8@0+ (1,0) [0|255] "raw"  BSI
 SG_ ConsecutiveData2 m2 : 23|8@0+ (1,0) [0|255] "raw"  BSI
 SG_ SingleData2 m0 : 23|8@0+ (1,0) [0|255] "raw"  BSI
 SG_ SeparationTimeRaw m3 : 23|8@0+ (1,0) [0|255] "raw"  BSI
 SG_ UnknownData1 m4 : 15|8@0+ (1,0) [0|255] "raw"  BSI
 SG_ ConsecutiveData1 m2 : 15|8@0+ (1,0) [0|255] "raw"  BSI
 SG_ SingleData1 m0 : 15|8@0+ (1,0) [0|255] "raw"  BSI
 SG_ BlockSize m3 : 15|8@0+ (1,0) [0|255] "raw"  BSI
 SG_ UnknownPciLow m4 : 3|4@0+ (1,0) [0|15] "raw"  BSI
 SG_ FlowStatus m3 : 3|4@0+ (1,0) [0|15] "raw"  BSI
 SG_ ConsecutiveSequence m2 : 3|4@0+ (1,0) [0|15] "raw"  BSI
 SG_ FirstFrameLength m1 : 3|12@0+ (1,0) [0|4095] "raw"  BSI
 SG_ SingleFrameLength m0 : 3|4@0+ (1,0) [0|15] "raw"  BSI
 SG_ IsoTpFrameType M : 7|4@0+ (1,0) [0|15] ""  BSI

BO_ 1883 MDS_DiagRequestToBSI_15: 8 MDS
 SG_ FlowPadding5 m3 : 63|8@0+ (1,0) [0|255] "raw"  BSI
 SG_ FirstData6 m1 : 63|8@0+ (1,0) [0|255] "raw"  BSI
 SG_ UnknownData7 m4 : 63|8@0+ (1,0) [0|255] "raw"  BSI
 SG_ ConsecutiveData7 m2 : 63|8@0+ (1,0) [0|255] "raw"  BSI
 SG_ SingleData7 m0 : 63|8@0+ (1,0) [0|255] "raw"  BSI
 SG_ FlowPadding4 m3 : 55|8@0+ (1,0) [0|255] "raw"  BSI
 SG_ FirstData5 m1 : 55|8@0+ (1,0) [0|255] "raw"  BSI
 SG_ UnknownData6 m4 : 55|8@0+ (1,0) [0|255] "raw"  BSI
 SG_ ConsecutiveData6 m2 : 55|8@0+ (1,0) [0|255] "raw"  BSI
 SG_ SingleData6 m0 : 55|8@0+ (1,0) [0|255] "raw"  BSI
 SG_ FlowPadding3 m3 : 47|8@0+ (1,0) [0|255] "raw"  BSI
 SG_ FirstData4 m1 : 47|8@0+ (1,0) [0|255] "raw"  BSI
 SG_ UnknownData5 m4 : 47|8@0+ (1,0) [0|255] "raw"  BSI
 SG_ ConsecutiveData5 m2 : 47|8@0+ (1,0) [0|255] "raw"  BSI
 SG_ SingleData5 m0 : 47|8@0+ (1,0) [0|255] "raw"  BSI
 SG_ FlowPadding2 m3 : 39|8@0+ (1,0) [0|255] "raw"  BSI
 SG_ FirstData3 m1 : 39|8@0+ (1,0) [0|255] "raw"  BSI
 SG_ UnknownData4 m4 : 39|8@0+ (1,0) [0|255] "raw"  BSI
 SG_ ConsecutiveData4 m2 : 39|8@0+ (1,0) [0|255] "raw"  BSI
 SG_ SingleData4 m0 : 39|8@0+ (1,0) [0|255] "raw"  BSI
 SG_ FlowPadding1 m3 : 31|8@0+ (1,0) [0|255] "raw"  BSI
 SG_ FirstData2 m1 : 31|8@0+ (1,0) [0|255] "raw"  BSI
 SG_ UnknownData3 m4 : 31|8@0+ (1,0) [0|255] "raw"  BSI
 SG_ ConsecutiveData3 m2 : 31|8@0+ (1,0) [0|255] "raw"  BSI
 SG_ SingleData3 m0 : 31|8@0+ (1,0) [0|255] "raw"  BSI
 SG_ FirstData1 m1 : 23|8@0+ (1,0) [0|255] "raw"  BSI
 SG_ UnknownData2 m4 : 23|8@0+ (1,0) [0|255] "raw"  BSI
 SG_ ConsecutiveData2 m2 : 23|8@0+ (1,0) [0|255] "raw"  BSI
 SG_ SingleData2 m0 : 23|8@0+ (1,0) [0|255] "raw"  BSI
 SG_ SeparationTimeRaw m3 : 23|8@0+ (1,0) [0|255] "raw"  BSI
 SG_ UnknownData1 m4 : 15|8@0+ (1,0) [0|255] "raw"  BSI
 SG_ ConsecutiveData1 m2 : 15|8@0+ (1,0) [0|255] "raw"  BSI
 SG_ SingleData1 m0 : 15|8@0+ (1,0) [0|255] "raw"  BSI
 SG_ BlockSize m3 : 15|8@0+ (1,0) [0|255] "raw"  BSI
 SG_ UnknownPciLow m4 : 3|4@0+ (1,0) [0|15] "raw"  BSI
 SG_ FlowStatus m3 : 3|4@0+ (1,0) [0|15] "raw"  BSI
 SG_ ConsecutiveSequence m2 : 3|4@0+ (1,0) [0|15] "raw"  BSI
 SG_ FirstFrameLength m1 : 3|12@0+ (1,0) [0|4095] "raw"  BSI
 SG_ SingleFrameLength m0 : 3|4@0+ (1,0) [0|15] "raw"  BSI
 SG_ IsoTpFrameType M : 7|4@0+ (1,0) [0|15] ""  BSI

BO_ 1884 MDS_DiagRequestToBSI_16: 8 MDS
 SG_ FlowPadding5 m3 : 63|8@0+ (1,0) [0|255] "raw"  BSI
 SG_ FirstData6 m1 : 63|8@0+ (1,0) [0|255] "raw"  BSI
 SG_ UnknownData7 m4 : 63|8@0+ (1,0) [0|255] "raw"  BSI
 SG_ ConsecutiveData7 m2 : 63|8@0+ (1,0) [0|255] "raw"  BSI
 SG_ SingleData7 m0 : 63|8@0+ (1,0) [0|255] "raw"  BSI
 SG_ FlowPadding4 m3 : 55|8@0+ (1,0) [0|255] "raw"  BSI
 SG_ FirstData5 m1 : 55|8@0+ (1,0) [0|255] "raw"  BSI
 SG_ UnknownData6 m4 : 55|8@0+ (1,0) [0|255] "raw"  BSI
 SG_ ConsecutiveData6 m2 : 55|8@0+ (1,0) [0|255] "raw"  BSI
 SG_ SingleData6 m0 : 55|8@0+ (1,0) [0|255] "raw"  BSI
 SG_ FlowPadding3 m3 : 47|8@0+ (1,0) [0|255] "raw"  BSI
 SG_ FirstData4 m1 : 47|8@0+ (1,0) [0|255] "raw"  BSI
 SG_ UnknownData5 m4 : 47|8@0+ (1,0) [0|255] "raw"  BSI
 SG_ ConsecutiveData5 m2 : 47|8@0+ (1,0) [0|255] "raw"  BSI
 SG_ SingleData5 m0 : 47|8@0+ (1,0) [0|255] "raw"  BSI
 SG_ FlowPadding2 m3 : 39|8@0+ (1,0) [0|255] "raw"  BSI
 SG_ FirstData3 m1 : 39|8@0+ (1,0) [0|255] "raw"  BSI
 SG_ UnknownData4 m4 : 39|8@0+ (1,0) [0|255] "raw"  BSI
 SG_ ConsecutiveData4 m2 : 39|8@0+ (1,0) [0|255] "raw"  BSI
 SG_ SingleData4 m0 : 39|8@0+ (1,0) [0|255] "raw"  BSI
 SG_ FlowPadding1 m3 : 31|8@0+ (1,0) [0|255] "raw"  BSI
 SG_ FirstData2 m1 : 31|8@0+ (1,0) [0|255] "raw"  BSI
 SG_ UnknownData3 m4 : 31|8@0+ (1,0) [0|255] "raw"  BSI
 SG_ ConsecutiveData3 m2 : 31|8@0+ (1,0) [0|255] "raw"  BSI
 SG_ SingleData3 m0 : 31|8@0+ (1,0) [0|255] "raw"  BSI
 SG_ FirstData1 m1 : 23|8@0+ (1,0) [0|255] "raw"  BSI
 SG_ UnknownData2 m4 : 23|8@0+ (1,0) [0|255] "raw"  BSI
 SG_ ConsecutiveData2 m2 : 23|8@0+ (1,0) [0|255] "raw"  BSI
 SG_ SingleData2 m0 : 23|8@0+ (1,0) [0|255] "raw"  BSI
 SG_ SeparationTimeRaw m3 : 23|8@0+ (1,0) [0|255] "raw"  BSI
 SG_ UnknownData1 m4 : 15|8@0+ (1,0) [0|255] "raw"  BSI
 SG_ ConsecutiveData1 m2 : 15|8@0+ (1,0) [0|255] "raw"  BSI
 SG_ SingleData1 m0 : 15|8@0+ (1,0) [0|255] "raw"  BSI
 SG_ BlockSize m3 : 15|8@0+ (1,0) [0|255] "raw"  BSI
 SG_ UnknownPciLow m4 : 3|4@0+ (1,0) [0|15] "raw"  BSI
 SG_ FlowStatus m3 : 3|4@0+ (1,0) [0|15] "raw"  BSI
 SG_ ConsecutiveSequence m2 : 3|4@0+ (1,0) [0|15] "raw"  BSI
 SG_ FirstFrameLength m1 : 3|12@0+ (1,0) [0|4095] "raw"  BSI
 SG_ SingleFrameLength m0 : 3|4@0+ (1,0) [0|15] "raw"  BSI
 SG_ IsoTpFrameType M : 7|4@0+ (1,0) [0|15] ""  BSI

BO_ 1885 BSI_DiagRequestToAAS: 8 BSI
 SG_ FlowPadding5 m3 : 63|8@0+ (1,0) [0|255] "raw"  AAS
 SG_ FirstData6 m1 : 63|8@0+ (1,0) [0|255] "raw"  AAS
 SG_ UnknownData7 m4 : 63|8@0+ (1,0) [0|255] "raw"  AAS
 SG_ ConsecutiveData7 m2 : 63|8@0+ (1,0) [0|255] "raw"  AAS
 SG_ SingleData7 m0 : 63|8@0+ (1,0) [0|255] "raw"  AAS
 SG_ FlowPadding4 m3 : 55|8@0+ (1,0) [0|255] "raw"  AAS
 SG_ FirstData5 m1 : 55|8@0+ (1,0) [0|255] "raw"  AAS
 SG_ UnknownData6 m4 : 55|8@0+ (1,0) [0|255] "raw"  AAS
 SG_ ConsecutiveData6 m2 : 55|8@0+ (1,0) [0|255] "raw"  AAS
 SG_ SingleData6 m0 : 55|8@0+ (1,0) [0|255] "raw"  AAS
 SG_ FlowPadding3 m3 : 47|8@0+ (1,0) [0|255] "raw"  AAS
 SG_ FirstData4 m1 : 47|8@0+ (1,0) [0|255] "raw"  AAS
 SG_ UnknownData5 m4 : 47|8@0+ (1,0) [0|255] "raw"  AAS
 SG_ ConsecutiveData5 m2 : 47|8@0+ (1,0) [0|255] "raw"  AAS
 SG_ SingleData5 m0 : 47|8@0+ (1,0) [0|255] "raw"  AAS
 SG_ FlowPadding2 m3 : 39|8@0+ (1,0) [0|255] "raw"  AAS
 SG_ FirstData3 m1 : 39|8@0+ (1,0) [0|255] "raw"  AAS
 SG_ UnknownData4 m4 : 39|8@0+ (1,0) [0|255] "raw"  AAS
 SG_ ConsecutiveData4 m2 : 39|8@0+ (1,0) [0|255] "raw"  AAS
 SG_ SingleData4 m0 : 39|8@0+ (1,0) [0|255] "raw"  AAS
 SG_ FlowPadding1 m3 : 31|8@0+ (1,0) [0|255] "raw"  AAS
 SG_ FirstData2 m1 : 31|8@0+ (1,0) [0|255] "raw"  AAS
 SG_ UnknownData3 m4 : 31|8@0+ (1,0) [0|255] "raw"  AAS
 SG_ ConsecutiveData3 m2 : 31|8@0+ (1,0) [0|255] "raw"  AAS
 SG_ SingleData3 m0 : 31|8@0+ (1,0) [0|255] "raw"  AAS
 SG_ FirstData1 m1 : 23|8@0+ (1,0) [0|255] "raw"  AAS
 SG_ UnknownData2 m4 : 23|8@0+ (1,0) [0|255] "raw"  AAS
 SG_ ConsecutiveData2 m2 : 23|8@0+ (1,0) [0|255] "raw"  AAS
 SG_ SingleData2 m0 : 23|8@0+ (1,0) [0|255] "raw"  AAS
 SG_ SeparationTimeRaw m3 : 23|8@0+ (1,0) [0|255] "raw"  AAS
 SG_ UnknownData1 m4 : 15|8@0+ (1,0) [0|255] "raw"  AAS
 SG_ ConsecutiveData1 m2 : 15|8@0+ (1,0) [0|255] "raw"  AAS
 SG_ SingleData1 m0 : 15|8@0+ (1,0) [0|255] "raw"  AAS
 SG_ BlockSize m3 : 15|8@0+ (1,0) [0|255] "raw"  AAS
 SG_ UnknownPciLow m4 : 3|4@0+ (1,0) [0|15] "raw"  AAS
 SG_ FlowStatus m3 : 3|4@0+ (1,0) [0|15] "raw"  AAS
 SG_ ConsecutiveSequence m2 : 3|4@0+ (1,0) [0|15] "raw"  AAS
 SG_ FirstFrameLength m1 : 3|12@0+ (1,0) [0|4095] "raw"  AAS
 SG_ SingleFrameLength m0 : 3|4@0+ (1,0) [0|15] "raw"  AAS
 SG_ IsoTpFrameType M : 7|4@0+ (1,0) [0|15] ""  AAS

BO_ 1886 MDS_DiagRequestToBSI_17: 8 MDS
 SG_ FlowPadding5 m3 : 63|8@0+ (1,0) [0|255] "raw"  BSI
 SG_ FirstData6 m1 : 63|8@0+ (1,0) [0|255] "raw"  BSI
 SG_ UnknownData7 m4 : 63|8@0+ (1,0) [0|255] "raw"  BSI
 SG_ ConsecutiveData7 m2 : 63|8@0+ (1,0) [0|255] "raw"  BSI
 SG_ SingleData7 m0 : 63|8@0+ (1,0) [0|255] "raw"  BSI
 SG_ FlowPadding4 m3 : 55|8@0+ (1,0) [0|255] "raw"  BSI
 SG_ FirstData5 m1 : 55|8@0+ (1,0) [0|255] "raw"  BSI
 SG_ UnknownData6 m4 : 55|8@0+ (1,0) [0|255] "raw"  BSI
 SG_ ConsecutiveData6 m2 : 55|8@0+ (1,0) [0|255] "raw"  BSI
 SG_ SingleData6 m0 : 55|8@0+ (1,0) [0|255] "raw"  BSI
 SG_ FlowPadding3 m3 : 47|8@0+ (1,0) [0|255] "raw"  BSI
 SG_ FirstData4 m1 : 47|8@0+ (1,0) [0|255] "raw"  BSI
 SG_ UnknownData5 m4 : 47|8@0+ (1,0) [0|255] "raw"  BSI
 SG_ ConsecutiveData5 m2 : 47|8@0+ (1,0) [0|255] "raw"  BSI
 SG_ SingleData5 m0 : 47|8@0+ (1,0) [0|255] "raw"  BSI
 SG_ FlowPadding2 m3 : 39|8@0+ (1,0) [0|255] "raw"  BSI
 SG_ FirstData3 m1 : 39|8@0+ (1,0) [0|255] "raw"  BSI
 SG_ UnknownData4 m4 : 39|8@0+ (1,0) [0|255] "raw"  BSI
 SG_ ConsecutiveData4 m2 : 39|8@0+ (1,0) [0|255] "raw"  BSI
 SG_ SingleData4 m0 : 39|8@0+ (1,0) [0|255] "raw"  BSI
 SG_ FlowPadding1 m3 : 31|8@0+ (1,0) [0|255] "raw"  BSI
 SG_ FirstData2 m1 : 31|8@0+ (1,0) [0|255] "raw"  BSI
 SG_ UnknownData3 m4 : 31|8@0+ (1,0) [0|255] "raw"  BSI
 SG_ ConsecutiveData3 m2 : 31|8@0+ (1,0) [0|255] "raw"  BSI
 SG_ SingleData3 m0 : 31|8@0+ (1,0) [0|255] "raw"  BSI
 SG_ FirstData1 m1 : 23|8@0+ (1,0) [0|255] "raw"  BSI
 SG_ UnknownData2 m4 : 23|8@0+ (1,0) [0|255] "raw"  BSI
 SG_ ConsecutiveData2 m2 : 23|8@0+ (1,0) [0|255] "raw"  BSI
 SG_ SingleData2 m0 : 23|8@0+ (1,0) [0|255] "raw"  BSI
 SG_ SeparationTimeRaw m3 : 23|8@0+ (1,0) [0|255] "raw"  BSI
 SG_ UnknownData1 m4 : 15|8@0+ (1,0) [0|255] "raw"  BSI
 SG_ ConsecutiveData1 m2 : 15|8@0+ (1,0) [0|255] "raw"  BSI
 SG_ SingleData1 m0 : 15|8@0+ (1,0) [0|255] "raw"  BSI
 SG_ BlockSize m3 : 15|8@0+ (1,0) [0|255] "raw"  BSI
 SG_ UnknownPciLow m4 : 3|4@0+ (1,0) [0|15] "raw"  BSI
 SG_ FlowStatus m3 : 3|4@0+ (1,0) [0|15] "raw"  BSI
 SG_ ConsecutiveSequence m2 : 3|4@0+ (1,0) [0|15] "raw"  BSI
 SG_ FirstFrameLength m1 : 3|12@0+ (1,0) [0|4095] "raw"  BSI
 SG_ SingleFrameLength m0 : 3|4@0+ (1,0) [0|15] "raw"  BSI
 SG_ IsoTpFrameType M : 7|4@0+ (1,0) [0|15] ""  BSI

BO_ 1887 BSI_DiagRequestToCMB_2: 8 BSI
 SG_ FlowPadding5 m3 : 63|8@0+ (1,0) [0|255] "raw"  CMB
 SG_ FirstData6 m1 : 63|8@0+ (1,0) [0|255] "raw"  CMB
 SG_ UnknownData7 m4 : 63|8@0+ (1,0) [0|255] "raw"  CMB
 SG_ ConsecutiveData7 m2 : 63|8@0+ (1,0) [0|255] "raw"  CMB
 SG_ SingleData7 m0 : 63|8@0+ (1,0) [0|255] "raw"  CMB
 SG_ FlowPadding4 m3 : 55|8@0+ (1,0) [0|255] "raw"  CMB
 SG_ FirstData5 m1 : 55|8@0+ (1,0) [0|255] "raw"  CMB
 SG_ UnknownData6 m4 : 55|8@0+ (1,0) [0|255] "raw"  CMB
 SG_ ConsecutiveData6 m2 : 55|8@0+ (1,0) [0|255] "raw"  CMB
 SG_ SingleData6 m0 : 55|8@0+ (1,0) [0|255] "raw"  CMB
 SG_ FlowPadding3 m3 : 47|8@0+ (1,0) [0|255] "raw"  CMB
 SG_ FirstData4 m1 : 47|8@0+ (1,0) [0|255] "raw"  CMB
 SG_ UnknownData5 m4 : 47|8@0+ (1,0) [0|255] "raw"  CMB
 SG_ ConsecutiveData5 m2 : 47|8@0+ (1,0) [0|255] "raw"  CMB
 SG_ SingleData5 m0 : 47|8@0+ (1,0) [0|255] "raw"  CMB
 SG_ FlowPadding2 m3 : 39|8@0+ (1,0) [0|255] "raw"  CMB
 SG_ FirstData3 m1 : 39|8@0+ (1,0) [0|255] "raw"  CMB
 SG_ UnknownData4 m4 : 39|8@0+ (1,0) [0|255] "raw"  CMB
 SG_ ConsecutiveData4 m2 : 39|8@0+ (1,0) [0|255] "raw"  CMB
 SG_ SingleData4 m0 : 39|8@0+ (1,0) [0|255] "raw"  CMB
 SG_ FlowPadding1 m3 : 31|8@0+ (1,0) [0|255] "raw"  CMB
 SG_ FirstData2 m1 : 31|8@0+ (1,0) [0|255] "raw"  CMB
 SG_ UnknownData3 m4 : 31|8@0+ (1,0) [0|255] "raw"  CMB
 SG_ ConsecutiveData3 m2 : 31|8@0+ (1,0) [0|255] "raw"  CMB
 SG_ SingleData3 m0 : 31|8@0+ (1,0) [0|255] "raw"  CMB
 SG_ FirstData1 m1 : 23|8@0+ (1,0) [0|255] "raw"  CMB
 SG_ UnknownData2 m4 : 23|8@0+ (1,0) [0|255] "raw"  CMB
 SG_ ConsecutiveData2 m2 : 23|8@0+ (1,0) [0|255] "raw"  CMB
 SG_ SingleData2 m0 : 23|8@0+ (1,0) [0|255] "raw"  CMB
 SG_ SeparationTimeRaw m3 : 23|8@0+ (1,0) [0|255] "raw"  CMB
 SG_ UnknownData1 m4 : 15|8@0+ (1,0) [0|255] "raw"  CMB
 SG_ ConsecutiveData1 m2 : 15|8@0+ (1,0) [0|255] "raw"  CMB
 SG_ SingleData1 m0 : 15|8@0+ (1,0) [0|255] "raw"  CMB
 SG_ BlockSize m3 : 15|8@0+ (1,0) [0|255] "raw"  CMB
 SG_ UnknownPciLow m4 : 3|4@0+ (1,0) [0|15] "raw"  CMB
 SG_ FlowStatus m3 : 3|4@0+ (1,0) [0|15] "raw"  CMB
 SG_ ConsecutiveSequence m2 : 3|4@0+ (1,0) [0|15] "raw"  CMB
 SG_ FirstFrameLength m1 : 3|12@0+ (1,0) [0|4095] "raw"  CMB
 SG_ SingleFrameLength m0 : 3|4@0+ (1,0) [0|15] "raw"  CMB
 SG_ IsoTpFrameType M : 7|4@0+ (1,0) [0|15] ""  CMB

BO_ 1888 BSI_DiagRequestToBTEL: 8 BSI
 SG_ FlowPadding5 m3 : 63|8@0+ (1,0) [0|255] "raw"  BTEL,RAD
 SG_ FirstData6 m1 : 63|8@0+ (1,0) [0|255] "raw"  BTEL,RAD
 SG_ UnknownData7 m4 : 63|8@0+ (1,0) [0|255] "raw"  BTEL,RAD
 SG_ ConsecutiveData7 m2 : 63|8@0+ (1,0) [0|255] "raw"  BTEL,RAD
 SG_ SingleData7 m0 : 63|8@0+ (1,0) [0|255] "raw"  BTEL,RAD
 SG_ FlowPadding4 m3 : 55|8@0+ (1,0) [0|255] "raw"  BTEL,RAD
 SG_ FirstData5 m1 : 55|8@0+ (1,0) [0|255] "raw"  BTEL,RAD
 SG_ UnknownData6 m4 : 55|8@0+ (1,0) [0|255] "raw"  BTEL,RAD
 SG_ ConsecutiveData6 m2 : 55|8@0+ (1,0) [0|255] "raw"  BTEL,RAD
 SG_ SingleData6 m0 : 55|8@0+ (1,0) [0|255] "raw"  BTEL,RAD
 SG_ FlowPadding3 m3 : 47|8@0+ (1,0) [0|255] "raw"  BTEL,RAD
 SG_ FirstData4 m1 : 47|8@0+ (1,0) [0|255] "raw"  BTEL,RAD
 SG_ UnknownData5 m4 : 47|8@0+ (1,0) [0|255] "raw"  BTEL,RAD
 SG_ ConsecutiveData5 m2 : 47|8@0+ (1,0) [0|255] "raw"  BTEL,RAD
 SG_ SingleData5 m0 : 47|8@0+ (1,0) [0|255] "raw"  BTEL,RAD
 SG_ FlowPadding2 m3 : 39|8@0+ (1,0) [0|255] "raw"  BTEL,RAD
 SG_ FirstData3 m1 : 39|8@0+ (1,0) [0|255] "raw"  BTEL,RAD
 SG_ UnknownData4 m4 : 39|8@0+ (1,0) [0|255] "raw"  BTEL,RAD
 SG_ ConsecutiveData4 m2 : 39|8@0+ (1,0) [0|255] "raw"  BTEL,RAD
 SG_ SingleData4 m0 : 39|8@0+ (1,0) [0|255] "raw"  BTEL,RAD
 SG_ FlowPadding1 m3 : 31|8@0+ (1,0) [0|255] "raw"  BTEL,RAD
 SG_ FirstData2 m1 : 31|8@0+ (1,0) [0|255] "raw"  BTEL,RAD
 SG_ UnknownData3 m4 : 31|8@0+ (1,0) [0|255] "raw"  BTEL,RAD
 SG_ ConsecutiveData3 m2 : 31|8@0+ (1,0) [0|255] "raw"  BTEL,RAD
 SG_ SingleData3 m0 : 31|8@0+ (1,0) [0|255] "raw"  BTEL,RAD
 SG_ FirstData1 m1 : 23|8@0+ (1,0) [0|255] "raw"  BTEL,RAD
 SG_ UnknownData2 m4 : 23|8@0+ (1,0) [0|255] "raw"  BTEL,RAD
 SG_ ConsecutiveData2 m2 : 23|8@0+ (1,0) [0|255] "raw"  BTEL,RAD
 SG_ SingleData2 m0 : 23|8@0+ (1,0) [0|255] "raw"  BTEL,RAD
 SG_ SeparationTimeRaw m3 : 23|8@0+ (1,0) [0|255] "raw"  BTEL,RAD
 SG_ UnknownData1 m4 : 15|8@0+ (1,0) [0|255] "raw"  BTEL,RAD
 SG_ ConsecutiveData1 m2 : 15|8@0+ (1,0) [0|255] "raw"  BTEL,RAD
 SG_ SingleData1 m0 : 15|8@0+ (1,0) [0|255] "raw"  BTEL,RAD
 SG_ BlockSize m3 : 15|8@0+ (1,0) [0|255] "raw"  BTEL,RAD
 SG_ UnknownPciLow m4 : 3|4@0+ (1,0) [0|15] "raw"  BTEL,RAD
 SG_ FlowStatus m3 : 3|4@0+ (1,0) [0|15] "raw"  BTEL,RAD
 SG_ ConsecutiveSequence m2 : 3|4@0+ (1,0) [0|15] "raw"  BTEL,RAD
 SG_ FirstFrameLength m1 : 3|12@0+ (1,0) [0|4095] "raw"  BTEL,RAD
 SG_ SingleFrameLength m0 : 3|4@0+ (1,0) [0|15] "raw"  BTEL,RAD
 SG_ IsoTpFrameType M : 7|4@0+ (1,0) [0|15] ""  BTEL,RAD

BO_ 1889 MDS_DiagRequestToBSI_18: 8 MDS
 SG_ FlowPadding5 m3 : 63|8@0+ (1,0) [0|255] "raw"  BSI
 SG_ FirstData6 m1 : 63|8@0+ (1,0) [0|255] "raw"  BSI
 SG_ UnknownData7 m4 : 63|8@0+ (1,0) [0|255] "raw"  BSI
 SG_ ConsecutiveData7 m2 : 63|8@0+ (1,0) [0|255] "raw"  BSI
 SG_ SingleData7 m0 : 63|8@0+ (1,0) [0|255] "raw"  BSI
 SG_ FlowPadding4 m3 : 55|8@0+ (1,0) [0|255] "raw"  BSI
 SG_ FirstData5 m1 : 55|8@0+ (1,0) [0|255] "raw"  BSI
 SG_ UnknownData6 m4 : 55|8@0+ (1,0) [0|255] "raw"  BSI
 SG_ ConsecutiveData6 m2 : 55|8@0+ (1,0) [0|255] "raw"  BSI
 SG_ SingleData6 m0 : 55|8@0+ (1,0) [0|255] "raw"  BSI
 SG_ FlowPadding3 m3 : 47|8@0+ (1,0) [0|255] "raw"  BSI
 SG_ FirstData4 m1 : 47|8@0+ (1,0) [0|255] "raw"  BSI
 SG_ UnknownData5 m4 : 47|8@0+ (1,0) [0|255] "raw"  BSI
 SG_ ConsecutiveData5 m2 : 47|8@0+ (1,0) [0|255] "raw"  BSI
 SG_ SingleData5 m0 : 47|8@0+ (1,0) [0|255] "raw"  BSI
 SG_ FlowPadding2 m3 : 39|8@0+ (1,0) [0|255] "raw"  BSI
 SG_ FirstData3 m1 : 39|8@0+ (1,0) [0|255] "raw"  BSI
 SG_ UnknownData4 m4 : 39|8@0+ (1,0) [0|255] "raw"  BSI
 SG_ ConsecutiveData4 m2 : 39|8@0+ (1,0) [0|255] "raw"  BSI
 SG_ SingleData4 m0 : 39|8@0+ (1,0) [0|255] "raw"  BSI
 SG_ FlowPadding1 m3 : 31|8@0+ (1,0) [0|255] "raw"  BSI
 SG_ FirstData2 m1 : 31|8@0+ (1,0) [0|255] "raw"  BSI
 SG_ UnknownData3 m4 : 31|8@0+ (1,0) [0|255] "raw"  BSI
 SG_ ConsecutiveData3 m2 : 31|8@0+ (1,0) [0|255] "raw"  BSI
 SG_ SingleData3 m0 : 31|8@0+ (1,0) [0|255] "raw"  BSI
 SG_ FirstData1 m1 : 23|8@0+ (1,0) [0|255] "raw"  BSI
 SG_ UnknownData2 m4 : 23|8@0+ (1,0) [0|255] "raw"  BSI
 SG_ ConsecutiveData2 m2 : 23|8@0+ (1,0) [0|255] "raw"  BSI
 SG_ SingleData2 m0 : 23|8@0+ (1,0) [0|255] "raw"  BSI
 SG_ SeparationTimeRaw m3 : 23|8@0+ (1,0) [0|255] "raw"  BSI
 SG_ UnknownData1 m4 : 15|8@0+ (1,0) [0|255] "raw"  BSI
 SG_ ConsecutiveData1 m2 : 15|8@0+ (1,0) [0|255] "raw"  BSI
 SG_ SingleData1 m0 : 15|8@0+ (1,0) [0|255] "raw"  BSI
 SG_ BlockSize m3 : 15|8@0+ (1,0) [0|255] "raw"  BSI
 SG_ UnknownPciLow m4 : 3|4@0+ (1,0) [0|15] "raw"  BSI
 SG_ FlowStatus m3 : 3|4@0+ (1,0) [0|15] "raw"  BSI
 SG_ ConsecutiveSequence m2 : 3|4@0+ (1,0) [0|15] "raw"  BSI
 SG_ FirstFrameLength m1 : 3|12@0+ (1,0) [0|4095] "raw"  BSI
 SG_ SingleFrameLength m0 : 3|4@0+ (1,0) [0|15] "raw"  BSI
 SG_ IsoTpFrameType M : 7|4@0+ (1,0) [0|15] ""  BSI

BO_ 1890 MDS_DiagRequestToBSI_19: 8 MDS
 SG_ FlowPadding5 m3 : 63|8@0+ (1,0) [0|255] "raw"  BSI
 SG_ FirstData6 m1 : 63|8@0+ (1,0) [0|255] "raw"  BSI
 SG_ UnknownData7 m4 : 63|8@0+ (1,0) [0|255] "raw"  BSI
 SG_ ConsecutiveData7 m2 : 63|8@0+ (1,0) [0|255] "raw"  BSI
 SG_ SingleData7 m0 : 63|8@0+ (1,0) [0|255] "raw"  BSI
 SG_ FlowPadding4 m3 : 55|8@0+ (1,0) [0|255] "raw"  BSI
 SG_ FirstData5 m1 : 55|8@0+ (1,0) [0|255] "raw"  BSI
 SG_ UnknownData6 m4 : 55|8@0+ (1,0) [0|255] "raw"  BSI
 SG_ ConsecutiveData6 m2 : 55|8@0+ (1,0) [0|255] "raw"  BSI
 SG_ SingleData6 m0 : 55|8@0+ (1,0) [0|255] "raw"  BSI
 SG_ FlowPadding3 m3 : 47|8@0+ (1,0) [0|255] "raw"  BSI
 SG_ FirstData4 m1 : 47|8@0+ (1,0) [0|255] "raw"  BSI
 SG_ UnknownData5 m4 : 47|8@0+ (1,0) [0|255] "raw"  BSI
 SG_ ConsecutiveData5 m2 : 47|8@0+ (1,0) [0|255] "raw"  BSI
 SG_ SingleData5 m0 : 47|8@0+ (1,0) [0|255] "raw"  BSI
 SG_ FlowPadding2 m3 : 39|8@0+ (1,0) [0|255] "raw"  BSI
 SG_ FirstData3 m1 : 39|8@0+ (1,0) [0|255] "raw"  BSI
 SG_ UnknownData4 m4 : 39|8@0+ (1,0) [0|255] "raw"  BSI
 SG_ ConsecutiveData4 m2 : 39|8@0+ (1,0) [0|255] "raw"  BSI
 SG_ SingleData4 m0 : 39|8@0+ (1,0) [0|255] "raw"  BSI
 SG_ FlowPadding1 m3 : 31|8@0+ (1,0) [0|255] "raw"  BSI
 SG_ FirstData2 m1 : 31|8@0+ (1,0) [0|255] "raw"  BSI
 SG_ UnknownData3 m4 : 31|8@0+ (1,0) [0|255] "raw"  BSI
 SG_ ConsecutiveData3 m2 : 31|8@0+ (1,0) [0|255] "raw"  BSI
 SG_ SingleData3 m0 : 31|8@0+ (1,0) [0|255] "raw"  BSI
 SG_ FirstData1 m1 : 23|8@0+ (1,0) [0|255] "raw"  BSI
 SG_ UnknownData2 m4 : 23|8@0+ (1,0) [0|255] "raw"  BSI
 SG_ ConsecutiveData2 m2 : 23|8@0+ (1,0) [0|255] "raw"  BSI
 SG_ SingleData2 m0 : 23|8@0+ (1,0) [0|255] "raw"  BSI
 SG_ SeparationTimeRaw m3 : 23|8@0+ (1,0) [0|255] "raw"  BSI
 SG_ UnknownData1 m4 : 15|8@0+ (1,0) [0|255] "raw"  BSI
 SG_ ConsecutiveData1 m2 : 15|8@0+ (1,0) [0|255] "raw"  BSI
 SG_ SingleData1 m0 : 15|8@0+ (1,0) [0|255] "raw"  BSI
 SG_ BlockSize m3 : 15|8@0+ (1,0) [0|255] "raw"  BSI
 SG_ UnknownPciLow m4 : 3|4@0+ (1,0) [0|15] "raw"  BSI
 SG_ FlowStatus m3 : 3|4@0+ (1,0) [0|15] "raw"  BSI
 SG_ ConsecutiveSequence m2 : 3|4@0+ (1,0) [0|15] "raw"  BSI
 SG_ FirstFrameLength m1 : 3|12@0+ (1,0) [0|4095] "raw"  BSI
 SG_ SingleFrameLength m0 : 3|4@0+ (1,0) [0|15] "raw"  BSI
 SG_ IsoTpFrameType M : 7|4@0+ (1,0) [0|15] ""  BSI

BO_ 1892 ICSV_DiagRequestToBTEL: 8 ICSV
 SG_ FlowPadding5 m3 : 63|8@0+ (1,0) [0|255] "raw"  BTEL,OVIP,RAD
 SG_ FirstData6 m1 : 63|8@0+ (1,0) [0|255] "raw"  BTEL,OVIP,RAD
 SG_ UnknownData7 m4 : 63|8@0+ (1,0) [0|255] "raw"  BTEL,OVIP,RAD
 SG_ ConsecutiveData7 m2 : 63|8@0+ (1,0) [0|255] "raw"  BTEL,OVIP,RAD
 SG_ SingleData7 m0 : 63|8@0+ (1,0) [0|255] "raw"  BTEL,OVIP,RAD
 SG_ FlowPadding4 m3 : 55|8@0+ (1,0) [0|255] "raw"  BTEL,OVIP,RAD
 SG_ FirstData5 m1 : 55|8@0+ (1,0) [0|255] "raw"  BTEL,OVIP,RAD
 SG_ UnknownData6 m4 : 55|8@0+ (1,0) [0|255] "raw"  BTEL,OVIP,RAD
 SG_ ConsecutiveData6 m2 : 55|8@0+ (1,0) [0|255] "raw"  BTEL,OVIP,RAD
 SG_ SingleData6 m0 : 55|8@0+ (1,0) [0|255] "raw"  BTEL,OVIP,RAD
 SG_ FlowPadding3 m3 : 47|8@0+ (1,0) [0|255] "raw"  BTEL,OVIP,RAD
 SG_ FirstData4 m1 : 47|8@0+ (1,0) [0|255] "raw"  BTEL,OVIP,RAD
 SG_ UnknownData5 m4 : 47|8@0+ (1,0) [0|255] "raw"  BTEL,OVIP,RAD
 SG_ ConsecutiveData5 m2 : 47|8@0+ (1,0) [0|255] "raw"  BTEL,OVIP,RAD
 SG_ SingleData5 m0 : 47|8@0+ (1,0) [0|255] "raw"  BTEL,OVIP,RAD
 SG_ FlowPadding2 m3 : 39|8@0+ (1,0) [0|255] "raw"  BTEL,OVIP,RAD
 SG_ FirstData3 m1 : 39|8@0+ (1,0) [0|255] "raw"  BTEL,OVIP,RAD
 SG_ UnknownData4 m4 : 39|8@0+ (1,0) [0|255] "raw"  BTEL,OVIP,RAD
 SG_ ConsecutiveData4 m2 : 39|8@0+ (1,0) [0|255] "raw"  BTEL,OVIP,RAD
 SG_ SingleData4 m0 : 39|8@0+ (1,0) [0|255] "raw"  BTEL,OVIP,RAD
 SG_ FlowPadding1 m3 : 31|8@0+ (1,0) [0|255] "raw"  BTEL,OVIP,RAD
 SG_ FirstData2 m1 : 31|8@0+ (1,0) [0|255] "raw"  BTEL,OVIP,RAD
 SG_ UnknownData3 m4 : 31|8@0+ (1,0) [0|255] "raw"  BTEL,OVIP,RAD
 SG_ ConsecutiveData3 m2 : 31|8@0+ (1,0) [0|255] "raw"  BTEL,OVIP,RAD
 SG_ SingleData3 m0 : 31|8@0+ (1,0) [0|255] "raw"  BTEL,OVIP,RAD
 SG_ FirstData1 m1 : 23|8@0+ (1,0) [0|255] "raw"  BTEL,OVIP,RAD
 SG_ UnknownData2 m4 : 23|8@0+ (1,0) [0|255] "raw"  BTEL,OVIP,RAD
 SG_ ConsecutiveData2 m2 : 23|8@0+ (1,0) [0|255] "raw"  BTEL,OVIP,RAD
 SG_ SingleData2 m0 : 23|8@0+ (1,0) [0|255] "raw"  BTEL,OVIP,RAD
 SG_ SeparationTimeRaw m3 : 23|8@0+ (1,0) [0|255] "raw"  BTEL,OVIP,RAD
 SG_ UnknownData1 m4 : 15|8@0+ (1,0) [0|255] "raw"  BTEL,OVIP,RAD
 SG_ ConsecutiveData1 m2 : 15|8@0+ (1,0) [0|255] "raw"  BTEL,OVIP,RAD
 SG_ SingleData1 m0 : 15|8@0+ (1,0) [0|255] "raw"  BTEL,OVIP,RAD
 SG_ BlockSize m3 : 15|8@0+ (1,0) [0|255] "raw"  BTEL,OVIP,RAD
 SG_ UnknownPciLow m4 : 3|4@0+ (1,0) [0|15] "raw"  BTEL,OVIP,RAD
 SG_ FlowStatus m3 : 3|4@0+ (1,0) [0|15] "raw"  BTEL,OVIP,RAD
 SG_ ConsecutiveSequence m2 : 3|4@0+ (1,0) [0|15] "raw"  BTEL,OVIP,RAD
 SG_ FirstFrameLength m1 : 3|12@0+ (1,0) [0|4095] "raw"  BTEL,OVIP,RAD
 SG_ SingleFrameLength m0 : 3|4@0+ (1,0) [0|15] "raw"  BTEL,OVIP,RAD
 SG_ IsoTpFrameType M : 7|4@0+ (1,0) [0|15] ""  BTEL,OVIP,RAD

BO_ 1893 BSI_DiagRequestToEMF: 8 BSI
 SG_ FlowPadding5 m3 : 63|8@0+ (1,0) [0|255] "raw"  EMF
 SG_ FirstData6 m1 : 63|8@0+ (1,0) [0|255] "raw"  EMF
 SG_ UnknownData7 m4 : 63|8@0+ (1,0) [0|255] "raw"  EMF
 SG_ ConsecutiveData7 m2 : 63|8@0+ (1,0) [0|255] "raw"  EMF
 SG_ SingleData7 m0 : 63|8@0+ (1,0) [0|255] "raw"  EMF
 SG_ FlowPadding4 m3 : 55|8@0+ (1,0) [0|255] "raw"  EMF
 SG_ FirstData5 m1 : 55|8@0+ (1,0) [0|255] "raw"  EMF
 SG_ UnknownData6 m4 : 55|8@0+ (1,0) [0|255] "raw"  EMF
 SG_ ConsecutiveData6 m2 : 55|8@0+ (1,0) [0|255] "raw"  EMF
 SG_ SingleData6 m0 : 55|8@0+ (1,0) [0|255] "raw"  EMF
 SG_ FlowPadding3 m3 : 47|8@0+ (1,0) [0|255] "raw"  EMF
 SG_ FirstData4 m1 : 47|8@0+ (1,0) [0|255] "raw"  EMF
 SG_ UnknownData5 m4 : 47|8@0+ (1,0) [0|255] "raw"  EMF
 SG_ ConsecutiveData5 m2 : 47|8@0+ (1,0) [0|255] "raw"  EMF
 SG_ SingleData5 m0 : 47|8@0+ (1,0) [0|255] "raw"  EMF
 SG_ FlowPadding2 m3 : 39|8@0+ (1,0) [0|255] "raw"  EMF
 SG_ FirstData3 m1 : 39|8@0+ (1,0) [0|255] "raw"  EMF
 SG_ UnknownData4 m4 : 39|8@0+ (1,0) [0|255] "raw"  EMF
 SG_ ConsecutiveData4 m2 : 39|8@0+ (1,0) [0|255] "raw"  EMF
 SG_ SingleData4 m0 : 39|8@0+ (1,0) [0|255] "raw"  EMF
 SG_ FlowPadding1 m3 : 31|8@0+ (1,0) [0|255] "raw"  EMF
 SG_ FirstData2 m1 : 31|8@0+ (1,0) [0|255] "raw"  EMF
 SG_ UnknownData3 m4 : 31|8@0+ (1,0) [0|255] "raw"  EMF
 SG_ ConsecutiveData3 m2 : 31|8@0+ (1,0) [0|255] "raw"  EMF
 SG_ SingleData3 m0 : 31|8@0+ (1,0) [0|255] "raw"  EMF
 SG_ FirstData1 m1 : 23|8@0+ (1,0) [0|255] "raw"  EMF
 SG_ UnknownData2 m4 : 23|8@0+ (1,0) [0|255] "raw"  EMF
 SG_ ConsecutiveData2 m2 : 23|8@0+ (1,0) [0|255] "raw"  EMF
 SG_ SingleData2 m0 : 23|8@0+ (1,0) [0|255] "raw"  EMF
 SG_ SeparationTimeRaw m3 : 23|8@0+ (1,0) [0|255] "raw"  EMF
 SG_ UnknownData1 m4 : 15|8@0+ (1,0) [0|255] "raw"  EMF
 SG_ ConsecutiveData1 m2 : 15|8@0+ (1,0) [0|255] "raw"  EMF
 SG_ SingleData1 m0 : 15|8@0+ (1,0) [0|255] "raw"  EMF
 SG_ BlockSize m3 : 15|8@0+ (1,0) [0|255] "raw"  EMF
 SG_ UnknownPciLow m4 : 3|4@0+ (1,0) [0|15] "raw"  EMF
 SG_ FlowStatus m3 : 3|4@0+ (1,0) [0|15] "raw"  EMF
 SG_ ConsecutiveSequence m2 : 3|4@0+ (1,0) [0|15] "raw"  EMF
 SG_ FirstFrameLength m1 : 3|12@0+ (1,0) [0|4095] "raw"  EMF
 SG_ SingleFrameLength m0 : 3|4@0+ (1,0) [0|15] "raw"  EMF
 SG_ IsoTpFrameType M : 7|4@0+ (1,0) [0|15] ""  EMF

BO_TX_BU_ 1868 : BSI,MDS;
BO_TX_BU_ 1885 : BSI,MDS;
BO_TX_BU_ 1887 : BSI,MDS;
BO_TX_BU_ 1888 : BSI,MDS,ICSV;
BO_TX_BU_ 1892 : ICSV,BSI,MDS;
BO_TX_BU_ 1893 : BSI,MDS;
CM_ BO_ 1862 "DATABASE_CANDIDATE: physical interpretation unverified; capture/layout evidence reported separately. INFO-DIV CAN, 125000 bit/s; CAN ID 0x746. PSA-RE title: RHF_DIAG_REQUEST. Diagnostic session request frame addressed to this module Source: https://github.com/prototux/PSA-RE/blob/67f7581e7622410efdbb29c7eda3b86982b9b450/buses/AEE2010.full/LS.INFO-DIV/746.yml. Source sender alternatives: MDS; physical TX/gateway forwarding not verified. WIRE ISO-TP ONLY: normal addressing candidate, maximum Classical CAN DLC 8; actual DLC may be shorter. Data includes padding. No reassembly, text, DID or application-layer decoding. Original application layouts are preserved in source JSON; do not decode them at wire offsets. ";
CM_ SG_ 1862 FlowPadding5 "TRANSPORT_CANDIDATE: normal-addressing ISO-TP. PSA-RE bits 8.7-8.0. ";
CM_ SG_ 1862 FirstData6 "TRANSPORT_CANDIDATE: normal-addressing ISO-TP. PSA-RE bits 8.7-8.0. ";
CM_ SG_ 1862 UnknownData7 "TRANSPORT_CANDIDATE: normal-addressing ISO-TP. PSA-RE bits 8.7-8.0. ";
CM_ SG_ 1862 ConsecutiveData7 "TRANSPORT_CANDIDATE: normal-addressing ISO-TP. PSA-RE bits 8.7-8.0. ";
CM_ SG_ 1862 SingleData7 "TRANSPORT_CANDIDATE: normal-addressing ISO-TP. PSA-RE bits 8.7-8.0. ";
CM_ SG_ 1862 FlowPadding4 "TRANSPORT_CANDIDATE: normal-addressing ISO-TP. PSA-RE bits 7.7-7.0. ";
CM_ SG_ 1862 FirstData5 "TRANSPORT_CANDIDATE: normal-addressing ISO-TP. PSA-RE bits 7.7-7.0. ";
CM_ SG_ 1862 UnknownData6 "TRANSPORT_CANDIDATE: normal-addressing ISO-TP. PSA-RE bits 7.7-7.0. ";
CM_ SG_ 1862 ConsecutiveData6 "TRANSPORT_CANDIDATE: normal-addressing ISO-TP. PSA-RE bits 7.7-7.0. ";
CM_ SG_ 1862 SingleData6 "TRANSPORT_CANDIDATE: normal-addressing ISO-TP. PSA-RE bits 7.7-7.0. ";
CM_ SG_ 1862 FlowPadding3 "TRANSPORT_CANDIDATE: normal-addressing ISO-TP. PSA-RE bits 6.7-6.0. ";
CM_ SG_ 1862 FirstData4 "TRANSPORT_CANDIDATE: normal-addressing ISO-TP. PSA-RE bits 6.7-6.0. ";
CM_ SG_ 1862 UnknownData5 "TRANSPORT_CANDIDATE: normal-addressing ISO-TP. PSA-RE bits 6.7-6.0. ";
CM_ SG_ 1862 ConsecutiveData5 "TRANSPORT_CANDIDATE: normal-addressing ISO-TP. PSA-RE bits 6.7-6.0. ";
CM_ SG_ 1862 SingleData5 "TRANSPORT_CANDIDATE: normal-addressing ISO-TP. PSA-RE bits 6.7-6.0. ";
CM_ SG_ 1862 FlowPadding2 "TRANSPORT_CANDIDATE: normal-addressing ISO-TP. PSA-RE bits 5.7-5.0. ";
CM_ SG_ 1862 FirstData3 "TRANSPORT_CANDIDATE: normal-addressing ISO-TP. PSA-RE bits 5.7-5.0. ";
CM_ SG_ 1862 UnknownData4 "TRANSPORT_CANDIDATE: normal-addressing ISO-TP. PSA-RE bits 5.7-5.0. ";
CM_ SG_ 1862 ConsecutiveData4 "TRANSPORT_CANDIDATE: normal-addressing ISO-TP. PSA-RE bits 5.7-5.0. ";
CM_ SG_ 1862 SingleData4 "TRANSPORT_CANDIDATE: normal-addressing ISO-TP. PSA-RE bits 5.7-5.0. ";
CM_ SG_ 1862 FlowPadding1 "TRANSPORT_CANDIDATE: normal-addressing ISO-TP. PSA-RE bits 4.7-4.0. ";
CM_ SG_ 1862 FirstData2 "TRANSPORT_CANDIDATE: normal-addressing ISO-TP. PSA-RE bits 4.7-4.0. ";
CM_ SG_ 1862 UnknownData3 "TRANSPORT_CANDIDATE: normal-addressing ISO-TP. PSA-RE bits 4.7-4.0. ";
CM_ SG_ 1862 ConsecutiveData3 "TRANSPORT_CANDIDATE: normal-addressing ISO-TP. PSA-RE bits 4.7-4.0. ";
CM_ SG_ 1862 SingleData3 "TRANSPORT_CANDIDATE: normal-addressing ISO-TP. PSA-RE bits 4.7-4.0. ";
CM_ SG_ 1862 FirstData1 "TRANSPORT_CANDIDATE: normal-addressing ISO-TP. PSA-RE bits 3.7-3.0. ";
CM_ SG_ 1862 UnknownData2 "TRANSPORT_CANDIDATE: normal-addressing ISO-TP. PSA-RE bits 3.7-3.0. ";
CM_ SG_ 1862 ConsecutiveData2 "TRANSPORT_CANDIDATE: normal-addressing ISO-TP. PSA-RE bits 3.7-3.0. ";
CM_ SG_ 1862 SingleData2 "TRANSPORT_CANDIDATE: normal-addressing ISO-TP. PSA-RE bits 3.7-3.0. ";
CM_ SG_ 1862 SeparationTimeRaw "TRANSPORT_CANDIDATE: normal-addressing ISO-TP. PSA-RE bits 3.7-3.0. Raw STmin code; 0xF1..0xF9 are not milliseconds.";
CM_ SG_ 1862 UnknownData1 "TRANSPORT_CANDIDATE: normal-addressing ISO-TP. PSA-RE bits 2.7-2.0. ";
CM_ SG_ 1862 ConsecutiveData1 "TRANSPORT_CANDIDATE: normal-addressing ISO-TP. PSA-RE bits 2.7-2.0. ";
CM_ SG_ 1862 SingleData1 "TRANSPORT_CANDIDATE: normal-addressing ISO-TP. PSA-RE bits 2.7-2.0. ";
CM_ SG_ 1862 BlockSize "TRANSPORT_CANDIDATE: normal-addressing ISO-TP. PSA-RE bits 2.7-2.0. ";
CM_ SG_ 1862 UnknownPciLow "TRANSPORT_CANDIDATE: normal-addressing ISO-TP. PSA-RE bits 1.3-1.0. ";
CM_ SG_ 1862 FlowStatus "TRANSPORT_CANDIDATE: normal-addressing ISO-TP. PSA-RE bits 1.3-1.0. ";
CM_ SG_ 1862 ConsecutiveSequence "TRANSPORT_CANDIDATE: normal-addressing ISO-TP. PSA-RE bits 1.3-1.0. ";
CM_ SG_ 1862 FirstFrameLength "TRANSPORT_CANDIDATE: normal-addressing ISO-TP. PSA-RE bits 1.3-2.0. 12-bit declared PDU length; not a reassembled value.";
CM_ SG_ 1862 SingleFrameLength "TRANSPORT_CANDIDATE: normal-addressing ISO-TP. PSA-RE bits 1.3-1.0. Declared data length; not a validity check.";
CM_ SG_ 1862 IsoTpFrameType "TRANSPORT_CANDIDATE: normal-addressing ISO-TP. PSA-RE bits 1.7-1.4. PCI high nibble; normal addressing candidate.";
CM_ BO_ 1863 "DATABASE_CANDIDATE: physical interpretation unverified; capture/layout evidence reported separately. INFO-DIV CAN, 125000 bit/s; CAN ID 0x747. PSA-RE title: BSM_DIAG_REQUEST. Diagnostic request addressed to the BSM ECU. Source: https://github.com/prototux/PSA-RE/blob/67f7581e7622410efdbb29c7eda3b86982b9b450/buses/AEE2010.full/LS.INFO-DIV/747.yml. Source sender alternatives: MDS; physical TX/gateway forwarding not verified. WIRE ISO-TP ONLY: normal addressing candidate, maximum Classical CAN DLC 8; actual DLC may be shorter. Data includes padding. No reassembly, text, DID or application-layer decoding. Original application layouts are preserved in source JSON; do not decode them at wire offsets. ";
CM_ SG_ 1863 FlowPadding5 "TRANSPORT_CANDIDATE: normal-addressing ISO-TP. PSA-RE bits 8.7-8.0. ";
CM_ SG_ 1863 FirstData6 "TRANSPORT_CANDIDATE: normal-addressing ISO-TP. PSA-RE bits 8.7-8.0. ";
CM_ SG_ 1863 UnknownData7 "TRANSPORT_CANDIDATE: normal-addressing ISO-TP. PSA-RE bits 8.7-8.0. ";
CM_ SG_ 1863 ConsecutiveData7 "TRANSPORT_CANDIDATE: normal-addressing ISO-TP. PSA-RE bits 8.7-8.0. ";
CM_ SG_ 1863 SingleData7 "TRANSPORT_CANDIDATE: normal-addressing ISO-TP. PSA-RE bits 8.7-8.0. ";
CM_ SG_ 1863 FlowPadding4 "TRANSPORT_CANDIDATE: normal-addressing ISO-TP. PSA-RE bits 7.7-7.0. ";
CM_ SG_ 1863 FirstData5 "TRANSPORT_CANDIDATE: normal-addressing ISO-TP. PSA-RE bits 7.7-7.0. ";
CM_ SG_ 1863 UnknownData6 "TRANSPORT_CANDIDATE: normal-addressing ISO-TP. PSA-RE bits 7.7-7.0. ";
CM_ SG_ 1863 ConsecutiveData6 "TRANSPORT_CANDIDATE: normal-addressing ISO-TP. PSA-RE bits 7.7-7.0. ";
CM_ SG_ 1863 SingleData6 "TRANSPORT_CANDIDATE: normal-addressing ISO-TP. PSA-RE bits 7.7-7.0. ";
CM_ SG_ 1863 FlowPadding3 "TRANSPORT_CANDIDATE: normal-addressing ISO-TP. PSA-RE bits 6.7-6.0. ";
CM_ SG_ 1863 FirstData4 "TRANSPORT_CANDIDATE: normal-addressing ISO-TP. PSA-RE bits 6.7-6.0. ";
CM_ SG_ 1863 UnknownData5 "TRANSPORT_CANDIDATE: normal-addressing ISO-TP. PSA-RE bits 6.7-6.0. ";
CM_ SG_ 1863 ConsecutiveData5 "TRANSPORT_CANDIDATE: normal-addressing ISO-TP. PSA-RE bits 6.7-6.0. ";
CM_ SG_ 1863 SingleData5 "TRANSPORT_CANDIDATE: normal-addressing ISO-TP. PSA-RE bits 6.7-6.0. ";
CM_ SG_ 1863 FlowPadding2 "TRANSPORT_CANDIDATE: normal-addressing ISO-TP. PSA-RE bits 5.7-5.0. ";
CM_ SG_ 1863 FirstData3 "TRANSPORT_CANDIDATE: normal-addressing ISO-TP. PSA-RE bits 5.7-5.0. ";
CM_ SG_ 1863 UnknownData4 "TRANSPORT_CANDIDATE: normal-addressing ISO-TP. PSA-RE bits 5.7-5.0. ";
CM_ SG_ 1863 ConsecutiveData4 "TRANSPORT_CANDIDATE: normal-addressing ISO-TP. PSA-RE bits 5.7-5.0. ";
CM_ SG_ 1863 SingleData4 "TRANSPORT_CANDIDATE: normal-addressing ISO-TP. PSA-RE bits 5.7-5.0. ";
CM_ SG_ 1863 FlowPadding1 "TRANSPORT_CANDIDATE: normal-addressing ISO-TP. PSA-RE bits 4.7-4.0. ";
CM_ SG_ 1863 FirstData2 "TRANSPORT_CANDIDATE: normal-addressing ISO-TP. PSA-RE bits 4.7-4.0. ";
CM_ SG_ 1863 UnknownData3 "TRANSPORT_CANDIDATE: normal-addressing ISO-TP. PSA-RE bits 4.7-4.0. ";
CM_ SG_ 1863 ConsecutiveData3 "TRANSPORT_CANDIDATE: normal-addressing ISO-TP. PSA-RE bits 4.7-4.0. ";
CM_ SG_ 1863 SingleData3 "TRANSPORT_CANDIDATE: normal-addressing ISO-TP. PSA-RE bits 4.7-4.0. ";
CM_ SG_ 1863 FirstData1 "TRANSPORT_CANDIDATE: normal-addressing ISO-TP. PSA-RE bits 3.7-3.0. ";
CM_ SG_ 1863 UnknownData2 "TRANSPORT_CANDIDATE: normal-addressing ISO-TP. PSA-RE bits 3.7-3.0. ";
CM_ SG_ 1863 ConsecutiveData2 "TRANSPORT_CANDIDATE: normal-addressing ISO-TP. PSA-RE bits 3.7-3.0. ";
CM_ SG_ 1863 SingleData2 "TRANSPORT_CANDIDATE: normal-addressing ISO-TP. PSA-RE bits 3.7-3.0. ";
CM_ SG_ 1863 SeparationTimeRaw "TRANSPORT_CANDIDATE: normal-addressing ISO-TP. PSA-RE bits 3.7-3.0. Raw STmin code; 0xF1..0xF9 are not milliseconds.";
CM_ SG_ 1863 UnknownData1 "TRANSPORT_CANDIDATE: normal-addressing ISO-TP. PSA-RE bits 2.7-2.0. ";
CM_ SG_ 1863 ConsecutiveData1 "TRANSPORT_CANDIDATE: normal-addressing ISO-TP. PSA-RE bits 2.7-2.0. ";
CM_ SG_ 1863 SingleData1 "TRANSPORT_CANDIDATE: normal-addressing ISO-TP. PSA-RE bits 2.7-2.0. ";
CM_ SG_ 1863 BlockSize "TRANSPORT_CANDIDATE: normal-addressing ISO-TP. PSA-RE bits 2.7-2.0. ";
CM_ SG_ 1863 UnknownPciLow "TRANSPORT_CANDIDATE: normal-addressing ISO-TP. PSA-RE bits 1.3-1.0. ";
CM_ SG_ 1863 FlowStatus "TRANSPORT_CANDIDATE: normal-addressing ISO-TP. PSA-RE bits 1.3-1.0. ";
CM_ SG_ 1863 ConsecutiveSequence "TRANSPORT_CANDIDATE: normal-addressing ISO-TP. PSA-RE bits 1.3-1.0. ";
CM_ SG_ 1863 FirstFrameLength "TRANSPORT_CANDIDATE: normal-addressing ISO-TP. PSA-RE bits 1.3-2.0. 12-bit declared PDU length; not a reassembled value.";
CM_ SG_ 1863 SingleFrameLength "TRANSPORT_CANDIDATE: normal-addressing ISO-TP. PSA-RE bits 1.3-1.0. Declared data length; not a validity check.";
CM_ SG_ 1863 IsoTpFrameType "TRANSPORT_CANDIDATE: normal-addressing ISO-TP. PSA-RE bits 1.7-1.4. PCI high nibble; normal addressing candidate.";
CM_ BO_ 1864 "DATABASE_CANDIDATE: physical interpretation unverified; capture/layout evidence reported separately. INFO-DIV CAN, 125000 bit/s; CAN ID 0x748. PSA-RE title: BSG_TC_DIAG_REQUEST. Diagnostic request addressed to the BSG ECU. Source: https://github.com/prototux/PSA-RE/blob/67f7581e7622410efdbb29c7eda3b86982b9b450/buses/AEE2010.full/LS.INFO-DIV/748.yml. Source sender alternatives: MDS; physical TX/gateway forwarding not verified. WIRE ISO-TP ONLY: normal addressing candidate, maximum Classical CAN DLC 8; actual DLC may be shorter. Data includes padding. No reassembly, text, DID or application-layer decoding. Original application layouts are preserved in source JSON; do not decode them at wire offsets. ";
CM_ SG_ 1864 FlowPadding5 "TRANSPORT_CANDIDATE: normal-addressing ISO-TP. PSA-RE bits 8.7-8.0. ";
CM_ SG_ 1864 FirstData6 "TRANSPORT_CANDIDATE: normal-addressing ISO-TP. PSA-RE bits 8.7-8.0. ";
CM_ SG_ 1864 UnknownData7 "TRANSPORT_CANDIDATE: normal-addressing ISO-TP. PSA-RE bits 8.7-8.0. ";
CM_ SG_ 1864 ConsecutiveData7 "TRANSPORT_CANDIDATE: normal-addressing ISO-TP. PSA-RE bits 8.7-8.0. ";
CM_ SG_ 1864 SingleData7 "TRANSPORT_CANDIDATE: normal-addressing ISO-TP. PSA-RE bits 8.7-8.0. ";
CM_ SG_ 1864 FlowPadding4 "TRANSPORT_CANDIDATE: normal-addressing ISO-TP. PSA-RE bits 7.7-7.0. ";
CM_ SG_ 1864 FirstData5 "TRANSPORT_CANDIDATE: normal-addressing ISO-TP. PSA-RE bits 7.7-7.0. ";
CM_ SG_ 1864 UnknownData6 "TRANSPORT_CANDIDATE: normal-addressing ISO-TP. PSA-RE bits 7.7-7.0. ";
CM_ SG_ 1864 ConsecutiveData6 "TRANSPORT_CANDIDATE: normal-addressing ISO-TP. PSA-RE bits 7.7-7.0. ";
CM_ SG_ 1864 SingleData6 "TRANSPORT_CANDIDATE: normal-addressing ISO-TP. PSA-RE bits 7.7-7.0. ";
CM_ SG_ 1864 FlowPadding3 "TRANSPORT_CANDIDATE: normal-addressing ISO-TP. PSA-RE bits 6.7-6.0. ";
CM_ SG_ 1864 FirstData4 "TRANSPORT_CANDIDATE: normal-addressing ISO-TP. PSA-RE bits 6.7-6.0. ";
CM_ SG_ 1864 UnknownData5 "TRANSPORT_CANDIDATE: normal-addressing ISO-TP. PSA-RE bits 6.7-6.0. ";
CM_ SG_ 1864 ConsecutiveData5 "TRANSPORT_CANDIDATE: normal-addressing ISO-TP. PSA-RE bits 6.7-6.0. ";
CM_ SG_ 1864 SingleData5 "TRANSPORT_CANDIDATE: normal-addressing ISO-TP. PSA-RE bits 6.7-6.0. ";
CM_ SG_ 1864 FlowPadding2 "TRANSPORT_CANDIDATE: normal-addressing ISO-TP. PSA-RE bits 5.7-5.0. ";
CM_ SG_ 1864 FirstData3 "TRANSPORT_CANDIDATE: normal-addressing ISO-TP. PSA-RE bits 5.7-5.0. ";
CM_ SG_ 1864 UnknownData4 "TRANSPORT_CANDIDATE: normal-addressing ISO-TP. PSA-RE bits 5.7-5.0. ";
CM_ SG_ 1864 ConsecutiveData4 "TRANSPORT_CANDIDATE: normal-addressing ISO-TP. PSA-RE bits 5.7-5.0. ";
CM_ SG_ 1864 SingleData4 "TRANSPORT_CANDIDATE: normal-addressing ISO-TP. PSA-RE bits 5.7-5.0. ";
CM_ SG_ 1864 FlowPadding1 "TRANSPORT_CANDIDATE: normal-addressing ISO-TP. PSA-RE bits 4.7-4.0. ";
CM_ SG_ 1864 FirstData2 "TRANSPORT_CANDIDATE: normal-addressing ISO-TP. PSA-RE bits 4.7-4.0. ";
CM_ SG_ 1864 UnknownData3 "TRANSPORT_CANDIDATE: normal-addressing ISO-TP. PSA-RE bits 4.7-4.0. ";
CM_ SG_ 1864 ConsecutiveData3 "TRANSPORT_CANDIDATE: normal-addressing ISO-TP. PSA-RE bits 4.7-4.0. ";
CM_ SG_ 1864 SingleData3 "TRANSPORT_CANDIDATE: normal-addressing ISO-TP. PSA-RE bits 4.7-4.0. ";
CM_ SG_ 1864 FirstData1 "TRANSPORT_CANDIDATE: normal-addressing ISO-TP. PSA-RE bits 3.7-3.0. ";
CM_ SG_ 1864 UnknownData2 "TRANSPORT_CANDIDATE: normal-addressing ISO-TP. PSA-RE bits 3.7-3.0. ";
CM_ SG_ 1864 ConsecutiveData2 "TRANSPORT_CANDIDATE: normal-addressing ISO-TP. PSA-RE bits 3.7-3.0. ";
CM_ SG_ 1864 SingleData2 "TRANSPORT_CANDIDATE: normal-addressing ISO-TP. PSA-RE bits 3.7-3.0. ";
CM_ SG_ 1864 SeparationTimeRaw "TRANSPORT_CANDIDATE: normal-addressing ISO-TP. PSA-RE bits 3.7-3.0. Raw STmin code; 0xF1..0xF9 are not milliseconds.";
CM_ SG_ 1864 UnknownData1 "TRANSPORT_CANDIDATE: normal-addressing ISO-TP. PSA-RE bits 2.7-2.0. ";
CM_ SG_ 1864 ConsecutiveData1 "TRANSPORT_CANDIDATE: normal-addressing ISO-TP. PSA-RE bits 2.7-2.0. ";
CM_ SG_ 1864 SingleData1 "TRANSPORT_CANDIDATE: normal-addressing ISO-TP. PSA-RE bits 2.7-2.0. ";
CM_ SG_ 1864 BlockSize "TRANSPORT_CANDIDATE: normal-addressing ISO-TP. PSA-RE bits 2.7-2.0. ";
CM_ SG_ 1864 UnknownPciLow "TRANSPORT_CANDIDATE: normal-addressing ISO-TP. PSA-RE bits 1.3-1.0. ";
CM_ SG_ 1864 FlowStatus "TRANSPORT_CANDIDATE: normal-addressing ISO-TP. PSA-RE bits 1.3-1.0. ";
CM_ SG_ 1864 ConsecutiveSequence "TRANSPORT_CANDIDATE: normal-addressing ISO-TP. PSA-RE bits 1.3-1.0. ";
CM_ SG_ 1864 FirstFrameLength "TRANSPORT_CANDIDATE: normal-addressing ISO-TP. PSA-RE bits 1.3-2.0. 12-bit declared PDU length; not a reassembled value.";
CM_ SG_ 1864 SingleFrameLength "TRANSPORT_CANDIDATE: normal-addressing ISO-TP. PSA-RE bits 1.3-1.0. Declared data length; not a validity check.";
CM_ SG_ 1864 IsoTpFrameType "TRANSPORT_CANDIDATE: normal-addressing ISO-TP. PSA-RE bits 1.7-1.4. PCI high nibble; normal addressing candidate.";
CM_ BO_ 1865 "DATABASE_CANDIDATE: physical interpretation unverified; capture/layout evidence reported separately. INFO-DIV CAN, 125000 bit/s; CAN ID 0x749. PSA-RE title: BDCP_DIAG_REQUEST. Diagnostic request addressed to the BDCP ECU. Source: https://github.com/prototux/PSA-RE/blob/67f7581e7622410efdbb29c7eda3b86982b9b450/buses/AEE2010.full/LS.INFO-DIV/749.yml. Source sender alternatives: MDS; physical TX/gateway forwarding not verified. WIRE ISO-TP ONLY: normal addressing candidate, maximum Classical CAN DLC 8; actual DLC may be shorter. Data includes padding. No reassembly, text, DID or application-layer decoding. Original application layouts are preserved in source JSON; do not decode them at wire offsets. ";
CM_ SG_ 1865 FlowPadding5 "TRANSPORT_CANDIDATE: normal-addressing ISO-TP. PSA-RE bits 8.7-8.0. ";
CM_ SG_ 1865 FirstData6 "TRANSPORT_CANDIDATE: normal-addressing ISO-TP. PSA-RE bits 8.7-8.0. ";
CM_ SG_ 1865 UnknownData7 "TRANSPORT_CANDIDATE: normal-addressing ISO-TP. PSA-RE bits 8.7-8.0. ";
CM_ SG_ 1865 ConsecutiveData7 "TRANSPORT_CANDIDATE: normal-addressing ISO-TP. PSA-RE bits 8.7-8.0. ";
CM_ SG_ 1865 SingleData7 "TRANSPORT_CANDIDATE: normal-addressing ISO-TP. PSA-RE bits 8.7-8.0. ";
CM_ SG_ 1865 FlowPadding4 "TRANSPORT_CANDIDATE: normal-addressing ISO-TP. PSA-RE bits 7.7-7.0. ";
CM_ SG_ 1865 FirstData5 "TRANSPORT_CANDIDATE: normal-addressing ISO-TP. PSA-RE bits 7.7-7.0. ";
CM_ SG_ 1865 UnknownData6 "TRANSPORT_CANDIDATE: normal-addressing ISO-TP. PSA-RE bits 7.7-7.0. ";
CM_ SG_ 1865 ConsecutiveData6 "TRANSPORT_CANDIDATE: normal-addressing ISO-TP. PSA-RE bits 7.7-7.0. ";
CM_ SG_ 1865 SingleData6 "TRANSPORT_CANDIDATE: normal-addressing ISO-TP. PSA-RE bits 7.7-7.0. ";
CM_ SG_ 1865 FlowPadding3 "TRANSPORT_CANDIDATE: normal-addressing ISO-TP. PSA-RE bits 6.7-6.0. ";
CM_ SG_ 1865 FirstData4 "TRANSPORT_CANDIDATE: normal-addressing ISO-TP. PSA-RE bits 6.7-6.0. ";
CM_ SG_ 1865 UnknownData5 "TRANSPORT_CANDIDATE: normal-addressing ISO-TP. PSA-RE bits 6.7-6.0. ";
CM_ SG_ 1865 ConsecutiveData5 "TRANSPORT_CANDIDATE: normal-addressing ISO-TP. PSA-RE bits 6.7-6.0. ";
CM_ SG_ 1865 SingleData5 "TRANSPORT_CANDIDATE: normal-addressing ISO-TP. PSA-RE bits 6.7-6.0. ";
CM_ SG_ 1865 FlowPadding2 "TRANSPORT_CANDIDATE: normal-addressing ISO-TP. PSA-RE bits 5.7-5.0. ";
CM_ SG_ 1865 FirstData3 "TRANSPORT_CANDIDATE: normal-addressing ISO-TP. PSA-RE bits 5.7-5.0. ";
CM_ SG_ 1865 UnknownData4 "TRANSPORT_CANDIDATE: normal-addressing ISO-TP. PSA-RE bits 5.7-5.0. ";
CM_ SG_ 1865 ConsecutiveData4 "TRANSPORT_CANDIDATE: normal-addressing ISO-TP. PSA-RE bits 5.7-5.0. ";
CM_ SG_ 1865 SingleData4 "TRANSPORT_CANDIDATE: normal-addressing ISO-TP. PSA-RE bits 5.7-5.0. ";
CM_ SG_ 1865 FlowPadding1 "TRANSPORT_CANDIDATE: normal-addressing ISO-TP. PSA-RE bits 4.7-4.0. ";
CM_ SG_ 1865 FirstData2 "TRANSPORT_CANDIDATE: normal-addressing ISO-TP. PSA-RE bits 4.7-4.0. ";
CM_ SG_ 1865 UnknownData3 "TRANSPORT_CANDIDATE: normal-addressing ISO-TP. PSA-RE bits 4.7-4.0. ";
CM_ SG_ 1865 ConsecutiveData3 "TRANSPORT_CANDIDATE: normal-addressing ISO-TP. PSA-RE bits 4.7-4.0. ";
CM_ SG_ 1865 SingleData3 "TRANSPORT_CANDIDATE: normal-addressing ISO-TP. PSA-RE bits 4.7-4.0. ";
CM_ SG_ 1865 FirstData1 "TRANSPORT_CANDIDATE: normal-addressing ISO-TP. PSA-RE bits 3.7-3.0. ";
CM_ SG_ 1865 UnknownData2 "TRANSPORT_CANDIDATE: normal-addressing ISO-TP. PSA-RE bits 3.7-3.0. ";
CM_ SG_ 1865 ConsecutiveData2 "TRANSPORT_CANDIDATE: normal-addressing ISO-TP. PSA-RE bits 3.7-3.0. ";
CM_ SG_ 1865 SingleData2 "TRANSPORT_CANDIDATE: normal-addressing ISO-TP. PSA-RE bits 3.7-3.0. ";
CM_ SG_ 1865 SeparationTimeRaw "TRANSPORT_CANDIDATE: normal-addressing ISO-TP. PSA-RE bits 3.7-3.0. Raw STmin code; 0xF1..0xF9 are not milliseconds.";
CM_ SG_ 1865 UnknownData1 "TRANSPORT_CANDIDATE: normal-addressing ISO-TP. PSA-RE bits 2.7-2.0. ";
CM_ SG_ 1865 ConsecutiveData1 "TRANSPORT_CANDIDATE: normal-addressing ISO-TP. PSA-RE bits 2.7-2.0. ";
CM_ SG_ 1865 SingleData1 "TRANSPORT_CANDIDATE: normal-addressing ISO-TP. PSA-RE bits 2.7-2.0. ";
CM_ SG_ 1865 BlockSize "TRANSPORT_CANDIDATE: normal-addressing ISO-TP. PSA-RE bits 2.7-2.0. ";
CM_ SG_ 1865 UnknownPciLow "TRANSPORT_CANDIDATE: normal-addressing ISO-TP. PSA-RE bits 1.3-1.0. ";
CM_ SG_ 1865 FlowStatus "TRANSPORT_CANDIDATE: normal-addressing ISO-TP. PSA-RE bits 1.3-1.0. ";
CM_ SG_ 1865 ConsecutiveSequence "TRANSPORT_CANDIDATE: normal-addressing ISO-TP. PSA-RE bits 1.3-1.0. ";
CM_ SG_ 1865 FirstFrameLength "TRANSPORT_CANDIDATE: normal-addressing ISO-TP. PSA-RE bits 1.3-2.0. 12-bit declared PDU length; not a reassembled value.";
CM_ SG_ 1865 SingleFrameLength "TRANSPORT_CANDIDATE: normal-addressing ISO-TP. PSA-RE bits 1.3-1.0. Declared data length; not a validity check.";
CM_ SG_ 1865 IsoTpFrameType "TRANSPORT_CANDIDATE: normal-addressing ISO-TP. PSA-RE bits 1.7-1.4. PCI high nibble; normal addressing candidate.";
CM_ BO_ 1866 "DATABASE_CANDIDATE: physical interpretation unverified; capture/layout evidence reported separately. INFO-DIV CAN, 125000 bit/s; CAN ID 0x74A. PSA-RE title: ON_CAN_DIAG_REQUEST_31. Diagnostic request addressed to the CMF ECU. Source: https://github.com/prototux/PSA-RE/blob/67f7581e7622410efdbb29c7eda3b86982b9b450/buses/AEE2010.full/LS.INFO-DIV/74A.yml. Source sender alternatives: MDS; physical TX/gateway forwarding not verified. WIRE ISO-TP ONLY: normal addressing candidate, maximum Classical CAN DLC 8; actual DLC may be shorter. Data includes padding. No reassembly, text, DID or application-layer decoding. Original application layouts are preserved in source JSON; do not decode them at wire offsets. ";
CM_ SG_ 1866 FlowPadding5 "TRANSPORT_CANDIDATE: normal-addressing ISO-TP. PSA-RE bits 8.7-8.0. ";
CM_ SG_ 1866 FirstData6 "TRANSPORT_CANDIDATE: normal-addressing ISO-TP. PSA-RE bits 8.7-8.0. ";
CM_ SG_ 1866 UnknownData7 "TRANSPORT_CANDIDATE: normal-addressing ISO-TP. PSA-RE bits 8.7-8.0. ";
CM_ SG_ 1866 ConsecutiveData7 "TRANSPORT_CANDIDATE: normal-addressing ISO-TP. PSA-RE bits 8.7-8.0. ";
CM_ SG_ 1866 SingleData7 "TRANSPORT_CANDIDATE: normal-addressing ISO-TP. PSA-RE bits 8.7-8.0. ";
CM_ SG_ 1866 FlowPadding4 "TRANSPORT_CANDIDATE: normal-addressing ISO-TP. PSA-RE bits 7.7-7.0. ";
CM_ SG_ 1866 FirstData5 "TRANSPORT_CANDIDATE: normal-addressing ISO-TP. PSA-RE bits 7.7-7.0. ";
CM_ SG_ 1866 UnknownData6 "TRANSPORT_CANDIDATE: normal-addressing ISO-TP. PSA-RE bits 7.7-7.0. ";
CM_ SG_ 1866 ConsecutiveData6 "TRANSPORT_CANDIDATE: normal-addressing ISO-TP. PSA-RE bits 7.7-7.0. ";
CM_ SG_ 1866 SingleData6 "TRANSPORT_CANDIDATE: normal-addressing ISO-TP. PSA-RE bits 7.7-7.0. ";
CM_ SG_ 1866 FlowPadding3 "TRANSPORT_CANDIDATE: normal-addressing ISO-TP. PSA-RE bits 6.7-6.0. ";
CM_ SG_ 1866 FirstData4 "TRANSPORT_CANDIDATE: normal-addressing ISO-TP. PSA-RE bits 6.7-6.0. ";
CM_ SG_ 1866 UnknownData5 "TRANSPORT_CANDIDATE: normal-addressing ISO-TP. PSA-RE bits 6.7-6.0. ";
CM_ SG_ 1866 ConsecutiveData5 "TRANSPORT_CANDIDATE: normal-addressing ISO-TP. PSA-RE bits 6.7-6.0. ";
CM_ SG_ 1866 SingleData5 "TRANSPORT_CANDIDATE: normal-addressing ISO-TP. PSA-RE bits 6.7-6.0. ";
CM_ SG_ 1866 FlowPadding2 "TRANSPORT_CANDIDATE: normal-addressing ISO-TP. PSA-RE bits 5.7-5.0. ";
CM_ SG_ 1866 FirstData3 "TRANSPORT_CANDIDATE: normal-addressing ISO-TP. PSA-RE bits 5.7-5.0. ";
CM_ SG_ 1866 UnknownData4 "TRANSPORT_CANDIDATE: normal-addressing ISO-TP. PSA-RE bits 5.7-5.0. ";
CM_ SG_ 1866 ConsecutiveData4 "TRANSPORT_CANDIDATE: normal-addressing ISO-TP. PSA-RE bits 5.7-5.0. ";
CM_ SG_ 1866 SingleData4 "TRANSPORT_CANDIDATE: normal-addressing ISO-TP. PSA-RE bits 5.7-5.0. ";
CM_ SG_ 1866 FlowPadding1 "TRANSPORT_CANDIDATE: normal-addressing ISO-TP. PSA-RE bits 4.7-4.0. ";
CM_ SG_ 1866 FirstData2 "TRANSPORT_CANDIDATE: normal-addressing ISO-TP. PSA-RE bits 4.7-4.0. ";
CM_ SG_ 1866 UnknownData3 "TRANSPORT_CANDIDATE: normal-addressing ISO-TP. PSA-RE bits 4.7-4.0. ";
CM_ SG_ 1866 ConsecutiveData3 "TRANSPORT_CANDIDATE: normal-addressing ISO-TP. PSA-RE bits 4.7-4.0. ";
CM_ SG_ 1866 SingleData3 "TRANSPORT_CANDIDATE: normal-addressing ISO-TP. PSA-RE bits 4.7-4.0. ";
CM_ SG_ 1866 FirstData1 "TRANSPORT_CANDIDATE: normal-addressing ISO-TP. PSA-RE bits 3.7-3.0. ";
CM_ SG_ 1866 UnknownData2 "TRANSPORT_CANDIDATE: normal-addressing ISO-TP. PSA-RE bits 3.7-3.0. ";
CM_ SG_ 1866 ConsecutiveData2 "TRANSPORT_CANDIDATE: normal-addressing ISO-TP. PSA-RE bits 3.7-3.0. ";
CM_ SG_ 1866 SingleData2 "TRANSPORT_CANDIDATE: normal-addressing ISO-TP. PSA-RE bits 3.7-3.0. ";
CM_ SG_ 1866 SeparationTimeRaw "TRANSPORT_CANDIDATE: normal-addressing ISO-TP. PSA-RE bits 3.7-3.0. Raw STmin code; 0xF1..0xF9 are not milliseconds.";
CM_ SG_ 1866 UnknownData1 "TRANSPORT_CANDIDATE: normal-addressing ISO-TP. PSA-RE bits 2.7-2.0. ";
CM_ SG_ 1866 ConsecutiveData1 "TRANSPORT_CANDIDATE: normal-addressing ISO-TP. PSA-RE bits 2.7-2.0. ";
CM_ SG_ 1866 SingleData1 "TRANSPORT_CANDIDATE: normal-addressing ISO-TP. PSA-RE bits 2.7-2.0. ";
CM_ SG_ 1866 BlockSize "TRANSPORT_CANDIDATE: normal-addressing ISO-TP. PSA-RE bits 2.7-2.0. ";
CM_ SG_ 1866 UnknownPciLow "TRANSPORT_CANDIDATE: normal-addressing ISO-TP. PSA-RE bits 1.3-1.0. ";
CM_ SG_ 1866 FlowStatus "TRANSPORT_CANDIDATE: normal-addressing ISO-TP. PSA-RE bits 1.3-1.0. ";
CM_ SG_ 1866 ConsecutiveSequence "TRANSPORT_CANDIDATE: normal-addressing ISO-TP. PSA-RE bits 1.3-1.0. ";
CM_ SG_ 1866 FirstFrameLength "TRANSPORT_CANDIDATE: normal-addressing ISO-TP. PSA-RE bits 1.3-2.0. 12-bit declared PDU length; not a reassembled value.";
CM_ SG_ 1866 SingleFrameLength "TRANSPORT_CANDIDATE: normal-addressing ISO-TP. PSA-RE bits 1.3-1.0. Declared data length; not a validity check.";
CM_ SG_ 1866 IsoTpFrameType "TRANSPORT_CANDIDATE: normal-addressing ISO-TP. PSA-RE bits 1.7-1.4. PCI high nibble; normal addressing candidate.";
CM_ BO_ 1867 "DATABASE_CANDIDATE: physical interpretation unverified; capture/layout evidence reported separately. INFO-DIV CAN, 125000 bit/s; CAN ID 0x74B. PSA-RE title: PDPC_DIAG_REQUEST. Diagnostic request addressed to the PDPC ECU. Source: https://github.com/prototux/PSA-RE/blob/67f7581e7622410efdbb29c7eda3b86982b9b450/buses/AEE2010.full/LS.INFO-DIV/74B.yml. Source sender alternatives: MDS; physical TX/gateway forwarding not verified. WIRE ISO-TP ONLY: normal addressing candidate, maximum Classical CAN DLC 8; actual DLC may be shorter. Data includes padding. No reassembly, text, DID or application-layer decoding. Original application layouts are preserved in source JSON; do not decode them at wire offsets. ";
CM_ SG_ 1867 FlowPadding5 "TRANSPORT_CANDIDATE: normal-addressing ISO-TP. PSA-RE bits 8.7-8.0. ";
CM_ SG_ 1867 FirstData6 "TRANSPORT_CANDIDATE: normal-addressing ISO-TP. PSA-RE bits 8.7-8.0. ";
CM_ SG_ 1867 UnknownData7 "TRANSPORT_CANDIDATE: normal-addressing ISO-TP. PSA-RE bits 8.7-8.0. ";
CM_ SG_ 1867 ConsecutiveData7 "TRANSPORT_CANDIDATE: normal-addressing ISO-TP. PSA-RE bits 8.7-8.0. ";
CM_ SG_ 1867 SingleData7 "TRANSPORT_CANDIDATE: normal-addressing ISO-TP. PSA-RE bits 8.7-8.0. ";
CM_ SG_ 1867 FlowPadding4 "TRANSPORT_CANDIDATE: normal-addressing ISO-TP. PSA-RE bits 7.7-7.0. ";
CM_ SG_ 1867 FirstData5 "TRANSPORT_CANDIDATE: normal-addressing ISO-TP. PSA-RE bits 7.7-7.0. ";
CM_ SG_ 1867 UnknownData6 "TRANSPORT_CANDIDATE: normal-addressing ISO-TP. PSA-RE bits 7.7-7.0. ";
CM_ SG_ 1867 ConsecutiveData6 "TRANSPORT_CANDIDATE: normal-addressing ISO-TP. PSA-RE bits 7.7-7.0. ";
CM_ SG_ 1867 SingleData6 "TRANSPORT_CANDIDATE: normal-addressing ISO-TP. PSA-RE bits 7.7-7.0. ";
CM_ SG_ 1867 FlowPadding3 "TRANSPORT_CANDIDATE: normal-addressing ISO-TP. PSA-RE bits 6.7-6.0. ";
CM_ SG_ 1867 FirstData4 "TRANSPORT_CANDIDATE: normal-addressing ISO-TP. PSA-RE bits 6.7-6.0. ";
CM_ SG_ 1867 UnknownData5 "TRANSPORT_CANDIDATE: normal-addressing ISO-TP. PSA-RE bits 6.7-6.0. ";
CM_ SG_ 1867 ConsecutiveData5 "TRANSPORT_CANDIDATE: normal-addressing ISO-TP. PSA-RE bits 6.7-6.0. ";
CM_ SG_ 1867 SingleData5 "TRANSPORT_CANDIDATE: normal-addressing ISO-TP. PSA-RE bits 6.7-6.0. ";
CM_ SG_ 1867 FlowPadding2 "TRANSPORT_CANDIDATE: normal-addressing ISO-TP. PSA-RE bits 5.7-5.0. ";
CM_ SG_ 1867 FirstData3 "TRANSPORT_CANDIDATE: normal-addressing ISO-TP. PSA-RE bits 5.7-5.0. ";
CM_ SG_ 1867 UnknownData4 "TRANSPORT_CANDIDATE: normal-addressing ISO-TP. PSA-RE bits 5.7-5.0. ";
CM_ SG_ 1867 ConsecutiveData4 "TRANSPORT_CANDIDATE: normal-addressing ISO-TP. PSA-RE bits 5.7-5.0. ";
CM_ SG_ 1867 SingleData4 "TRANSPORT_CANDIDATE: normal-addressing ISO-TP. PSA-RE bits 5.7-5.0. ";
CM_ SG_ 1867 FlowPadding1 "TRANSPORT_CANDIDATE: normal-addressing ISO-TP. PSA-RE bits 4.7-4.0. ";
CM_ SG_ 1867 FirstData2 "TRANSPORT_CANDIDATE: normal-addressing ISO-TP. PSA-RE bits 4.7-4.0. ";
CM_ SG_ 1867 UnknownData3 "TRANSPORT_CANDIDATE: normal-addressing ISO-TP. PSA-RE bits 4.7-4.0. ";
CM_ SG_ 1867 ConsecutiveData3 "TRANSPORT_CANDIDATE: normal-addressing ISO-TP. PSA-RE bits 4.7-4.0. ";
CM_ SG_ 1867 SingleData3 "TRANSPORT_CANDIDATE: normal-addressing ISO-TP. PSA-RE bits 4.7-4.0. ";
CM_ SG_ 1867 FirstData1 "TRANSPORT_CANDIDATE: normal-addressing ISO-TP. PSA-RE bits 3.7-3.0. ";
CM_ SG_ 1867 UnknownData2 "TRANSPORT_CANDIDATE: normal-addressing ISO-TP. PSA-RE bits 3.7-3.0. ";
CM_ SG_ 1867 ConsecutiveData2 "TRANSPORT_CANDIDATE: normal-addressing ISO-TP. PSA-RE bits 3.7-3.0. ";
CM_ SG_ 1867 SingleData2 "TRANSPORT_CANDIDATE: normal-addressing ISO-TP. PSA-RE bits 3.7-3.0. ";
CM_ SG_ 1867 SeparationTimeRaw "TRANSPORT_CANDIDATE: normal-addressing ISO-TP. PSA-RE bits 3.7-3.0. Raw STmin code; 0xF1..0xF9 are not milliseconds.";
CM_ SG_ 1867 UnknownData1 "TRANSPORT_CANDIDATE: normal-addressing ISO-TP. PSA-RE bits 2.7-2.0. ";
CM_ SG_ 1867 ConsecutiveData1 "TRANSPORT_CANDIDATE: normal-addressing ISO-TP. PSA-RE bits 2.7-2.0. ";
CM_ SG_ 1867 SingleData1 "TRANSPORT_CANDIDATE: normal-addressing ISO-TP. PSA-RE bits 2.7-2.0. ";
CM_ SG_ 1867 BlockSize "TRANSPORT_CANDIDATE: normal-addressing ISO-TP. PSA-RE bits 2.7-2.0. ";
CM_ SG_ 1867 UnknownPciLow "TRANSPORT_CANDIDATE: normal-addressing ISO-TP. PSA-RE bits 1.3-1.0. ";
CM_ SG_ 1867 FlowStatus "TRANSPORT_CANDIDATE: normal-addressing ISO-TP. PSA-RE bits 1.3-1.0. ";
CM_ SG_ 1867 ConsecutiveSequence "TRANSPORT_CANDIDATE: normal-addressing ISO-TP. PSA-RE bits 1.3-1.0. ";
CM_ SG_ 1867 FirstFrameLength "TRANSPORT_CANDIDATE: normal-addressing ISO-TP. PSA-RE bits 1.3-2.0. 12-bit declared PDU length; not a reassembled value.";
CM_ SG_ 1867 SingleFrameLength "TRANSPORT_CANDIDATE: normal-addressing ISO-TP. PSA-RE bits 1.3-1.0. Declared data length; not a validity check.";
CM_ SG_ 1867 IsoTpFrameType "TRANSPORT_CANDIDATE: normal-addressing ISO-TP. PSA-RE bits 1.7-1.4. PCI high nibble; normal addressing candidate.";
CM_ BO_ 1868 "DATABASE_CANDIDATE: physical interpretation unverified; capture/layout evidence reported separately. INFO-DIV CAN, 125000 bit/s; CAN ID 0x74C. PSA-RE title: CRT_DIAG_REQUEST. Diagnostic request addressed to the CRT ECU. Source: https://github.com/prototux/PSA-RE/blob/67f7581e7622410efdbb29c7eda3b86982b9b450/buses/AEE2010.full/LS.INFO-DIV/74C.yml. Source sender alternatives: BSI,MDS; physical TX/gateway forwarding not verified. WIRE ISO-TP ONLY: normal addressing candidate, maximum Classical CAN DLC 8; actual DLC may be shorter. Data includes padding. No reassembly, text, DID or application-layer decoding. Original application layouts are preserved in source JSON; do not decode them at wire offsets. ";
CM_ SG_ 1868 FlowPadding5 "TRANSPORT_CANDIDATE: normal-addressing ISO-TP. PSA-RE bits 8.7-8.0. ";
CM_ SG_ 1868 FirstData6 "TRANSPORT_CANDIDATE: normal-addressing ISO-TP. PSA-RE bits 8.7-8.0. ";
CM_ SG_ 1868 UnknownData7 "TRANSPORT_CANDIDATE: normal-addressing ISO-TP. PSA-RE bits 8.7-8.0. ";
CM_ SG_ 1868 ConsecutiveData7 "TRANSPORT_CANDIDATE: normal-addressing ISO-TP. PSA-RE bits 8.7-8.0. ";
CM_ SG_ 1868 SingleData7 "TRANSPORT_CANDIDATE: normal-addressing ISO-TP. PSA-RE bits 8.7-8.0. ";
CM_ SG_ 1868 FlowPadding4 "TRANSPORT_CANDIDATE: normal-addressing ISO-TP. PSA-RE bits 7.7-7.0. ";
CM_ SG_ 1868 FirstData5 "TRANSPORT_CANDIDATE: normal-addressing ISO-TP. PSA-RE bits 7.7-7.0. ";
CM_ SG_ 1868 UnknownData6 "TRANSPORT_CANDIDATE: normal-addressing ISO-TP. PSA-RE bits 7.7-7.0. ";
CM_ SG_ 1868 ConsecutiveData6 "TRANSPORT_CANDIDATE: normal-addressing ISO-TP. PSA-RE bits 7.7-7.0. ";
CM_ SG_ 1868 SingleData6 "TRANSPORT_CANDIDATE: normal-addressing ISO-TP. PSA-RE bits 7.7-7.0. ";
CM_ SG_ 1868 FlowPadding3 "TRANSPORT_CANDIDATE: normal-addressing ISO-TP. PSA-RE bits 6.7-6.0. ";
CM_ SG_ 1868 FirstData4 "TRANSPORT_CANDIDATE: normal-addressing ISO-TP. PSA-RE bits 6.7-6.0. ";
CM_ SG_ 1868 UnknownData5 "TRANSPORT_CANDIDATE: normal-addressing ISO-TP. PSA-RE bits 6.7-6.0. ";
CM_ SG_ 1868 ConsecutiveData5 "TRANSPORT_CANDIDATE: normal-addressing ISO-TP. PSA-RE bits 6.7-6.0. ";
CM_ SG_ 1868 SingleData5 "TRANSPORT_CANDIDATE: normal-addressing ISO-TP. PSA-RE bits 6.7-6.0. ";
CM_ SG_ 1868 FlowPadding2 "TRANSPORT_CANDIDATE: normal-addressing ISO-TP. PSA-RE bits 5.7-5.0. ";
CM_ SG_ 1868 FirstData3 "TRANSPORT_CANDIDATE: normal-addressing ISO-TP. PSA-RE bits 5.7-5.0. ";
CM_ SG_ 1868 UnknownData4 "TRANSPORT_CANDIDATE: normal-addressing ISO-TP. PSA-RE bits 5.7-5.0. ";
CM_ SG_ 1868 ConsecutiveData4 "TRANSPORT_CANDIDATE: normal-addressing ISO-TP. PSA-RE bits 5.7-5.0. ";
CM_ SG_ 1868 SingleData4 "TRANSPORT_CANDIDATE: normal-addressing ISO-TP. PSA-RE bits 5.7-5.0. ";
CM_ SG_ 1868 FlowPadding1 "TRANSPORT_CANDIDATE: normal-addressing ISO-TP. PSA-RE bits 4.7-4.0. ";
CM_ SG_ 1868 FirstData2 "TRANSPORT_CANDIDATE: normal-addressing ISO-TP. PSA-RE bits 4.7-4.0. ";
CM_ SG_ 1868 UnknownData3 "TRANSPORT_CANDIDATE: normal-addressing ISO-TP. PSA-RE bits 4.7-4.0. ";
CM_ SG_ 1868 ConsecutiveData3 "TRANSPORT_CANDIDATE: normal-addressing ISO-TP. PSA-RE bits 4.7-4.0. ";
CM_ SG_ 1868 SingleData3 "TRANSPORT_CANDIDATE: normal-addressing ISO-TP. PSA-RE bits 4.7-4.0. ";
CM_ SG_ 1868 FirstData1 "TRANSPORT_CANDIDATE: normal-addressing ISO-TP. PSA-RE bits 3.7-3.0. ";
CM_ SG_ 1868 UnknownData2 "TRANSPORT_CANDIDATE: normal-addressing ISO-TP. PSA-RE bits 3.7-3.0. ";
CM_ SG_ 1868 ConsecutiveData2 "TRANSPORT_CANDIDATE: normal-addressing ISO-TP. PSA-RE bits 3.7-3.0. ";
CM_ SG_ 1868 SingleData2 "TRANSPORT_CANDIDATE: normal-addressing ISO-TP. PSA-RE bits 3.7-3.0. ";
CM_ SG_ 1868 SeparationTimeRaw "TRANSPORT_CANDIDATE: normal-addressing ISO-TP. PSA-RE bits 3.7-3.0. Raw STmin code; 0xF1..0xF9 are not milliseconds.";
CM_ SG_ 1868 UnknownData1 "TRANSPORT_CANDIDATE: normal-addressing ISO-TP. PSA-RE bits 2.7-2.0. ";
CM_ SG_ 1868 ConsecutiveData1 "TRANSPORT_CANDIDATE: normal-addressing ISO-TP. PSA-RE bits 2.7-2.0. ";
CM_ SG_ 1868 SingleData1 "TRANSPORT_CANDIDATE: normal-addressing ISO-TP. PSA-RE bits 2.7-2.0. ";
CM_ SG_ 1868 BlockSize "TRANSPORT_CANDIDATE: normal-addressing ISO-TP. PSA-RE bits 2.7-2.0. ";
CM_ SG_ 1868 UnknownPciLow "TRANSPORT_CANDIDATE: normal-addressing ISO-TP. PSA-RE bits 1.3-1.0. ";
CM_ SG_ 1868 FlowStatus "TRANSPORT_CANDIDATE: normal-addressing ISO-TP. PSA-RE bits 1.3-1.0. ";
CM_ SG_ 1868 ConsecutiveSequence "TRANSPORT_CANDIDATE: normal-addressing ISO-TP. PSA-RE bits 1.3-1.0. ";
CM_ SG_ 1868 FirstFrameLength "TRANSPORT_CANDIDATE: normal-addressing ISO-TP. PSA-RE bits 1.3-2.0. 12-bit declared PDU length; not a reassembled value.";
CM_ SG_ 1868 SingleFrameLength "TRANSPORT_CANDIDATE: normal-addressing ISO-TP. PSA-RE bits 1.3-1.0. Declared data length; not a validity check.";
CM_ SG_ 1868 IsoTpFrameType "TRANSPORT_CANDIDATE: normal-addressing ISO-TP. PSA-RE bits 1.7-1.4. PCI high nibble; normal addressing candidate.";
CM_ BO_ 1871 "DATABASE_CANDIDATE: physical interpretation unverified; capture/layout evidence reported separately. INFO-DIV CAN, 125000 bit/s; CAN ID 0x74F. PSA-RE title: AVE_DIAG_REQUEST. Diagnostic request addressed to the AVE ECU. Source: https://github.com/prototux/PSA-RE/blob/67f7581e7622410efdbb29c7eda3b86982b9b450/buses/AEE2010.full/LS.INFO-DIV/74F.yml. Source sender alternatives: MDS; physical TX/gateway forwarding not verified. WIRE ISO-TP ONLY: normal addressing candidate, maximum Classical CAN DLC 8; actual DLC may be shorter. Data includes padding. No reassembly, text, DID or application-layer decoding. Original application layouts are preserved in source JSON; do not decode them at wire offsets. ";
CM_ SG_ 1871 FlowPadding5 "TRANSPORT_CANDIDATE: normal-addressing ISO-TP. PSA-RE bits 8.7-8.0. ";
CM_ SG_ 1871 FirstData6 "TRANSPORT_CANDIDATE: normal-addressing ISO-TP. PSA-RE bits 8.7-8.0. ";
CM_ SG_ 1871 UnknownData7 "TRANSPORT_CANDIDATE: normal-addressing ISO-TP. PSA-RE bits 8.7-8.0. ";
CM_ SG_ 1871 ConsecutiveData7 "TRANSPORT_CANDIDATE: normal-addressing ISO-TP. PSA-RE bits 8.7-8.0. ";
CM_ SG_ 1871 SingleData7 "TRANSPORT_CANDIDATE: normal-addressing ISO-TP. PSA-RE bits 8.7-8.0. ";
CM_ SG_ 1871 FlowPadding4 "TRANSPORT_CANDIDATE: normal-addressing ISO-TP. PSA-RE bits 7.7-7.0. ";
CM_ SG_ 1871 FirstData5 "TRANSPORT_CANDIDATE: normal-addressing ISO-TP. PSA-RE bits 7.7-7.0. ";
CM_ SG_ 1871 UnknownData6 "TRANSPORT_CANDIDATE: normal-addressing ISO-TP. PSA-RE bits 7.7-7.0. ";
CM_ SG_ 1871 ConsecutiveData6 "TRANSPORT_CANDIDATE: normal-addressing ISO-TP. PSA-RE bits 7.7-7.0. ";
CM_ SG_ 1871 SingleData6 "TRANSPORT_CANDIDATE: normal-addressing ISO-TP. PSA-RE bits 7.7-7.0. ";
CM_ SG_ 1871 FlowPadding3 "TRANSPORT_CANDIDATE: normal-addressing ISO-TP. PSA-RE bits 6.7-6.0. ";
CM_ SG_ 1871 FirstData4 "TRANSPORT_CANDIDATE: normal-addressing ISO-TP. PSA-RE bits 6.7-6.0. ";
CM_ SG_ 1871 UnknownData5 "TRANSPORT_CANDIDATE: normal-addressing ISO-TP. PSA-RE bits 6.7-6.0. ";
CM_ SG_ 1871 ConsecutiveData5 "TRANSPORT_CANDIDATE: normal-addressing ISO-TP. PSA-RE bits 6.7-6.0. ";
CM_ SG_ 1871 SingleData5 "TRANSPORT_CANDIDATE: normal-addressing ISO-TP. PSA-RE bits 6.7-6.0. ";
CM_ SG_ 1871 FlowPadding2 "TRANSPORT_CANDIDATE: normal-addressing ISO-TP. PSA-RE bits 5.7-5.0. ";
CM_ SG_ 1871 FirstData3 "TRANSPORT_CANDIDATE: normal-addressing ISO-TP. PSA-RE bits 5.7-5.0. ";
CM_ SG_ 1871 UnknownData4 "TRANSPORT_CANDIDATE: normal-addressing ISO-TP. PSA-RE bits 5.7-5.0. ";
CM_ SG_ 1871 ConsecutiveData4 "TRANSPORT_CANDIDATE: normal-addressing ISO-TP. PSA-RE bits 5.7-5.0. ";
CM_ SG_ 1871 SingleData4 "TRANSPORT_CANDIDATE: normal-addressing ISO-TP. PSA-RE bits 5.7-5.0. ";
CM_ SG_ 1871 FlowPadding1 "TRANSPORT_CANDIDATE: normal-addressing ISO-TP. PSA-RE bits 4.7-4.0. ";
CM_ SG_ 1871 FirstData2 "TRANSPORT_CANDIDATE: normal-addressing ISO-TP. PSA-RE bits 4.7-4.0. ";
CM_ SG_ 1871 UnknownData3 "TRANSPORT_CANDIDATE: normal-addressing ISO-TP. PSA-RE bits 4.7-4.0. ";
CM_ SG_ 1871 ConsecutiveData3 "TRANSPORT_CANDIDATE: normal-addressing ISO-TP. PSA-RE bits 4.7-4.0. ";
CM_ SG_ 1871 SingleData3 "TRANSPORT_CANDIDATE: normal-addressing ISO-TP. PSA-RE bits 4.7-4.0. ";
CM_ SG_ 1871 FirstData1 "TRANSPORT_CANDIDATE: normal-addressing ISO-TP. PSA-RE bits 3.7-3.0. ";
CM_ SG_ 1871 UnknownData2 "TRANSPORT_CANDIDATE: normal-addressing ISO-TP. PSA-RE bits 3.7-3.0. ";
CM_ SG_ 1871 ConsecutiveData2 "TRANSPORT_CANDIDATE: normal-addressing ISO-TP. PSA-RE bits 3.7-3.0. ";
CM_ SG_ 1871 SingleData2 "TRANSPORT_CANDIDATE: normal-addressing ISO-TP. PSA-RE bits 3.7-3.0. ";
CM_ SG_ 1871 SeparationTimeRaw "TRANSPORT_CANDIDATE: normal-addressing ISO-TP. PSA-RE bits 3.7-3.0. Raw STmin code; 0xF1..0xF9 are not milliseconds.";
CM_ SG_ 1871 UnknownData1 "TRANSPORT_CANDIDATE: normal-addressing ISO-TP. PSA-RE bits 2.7-2.0. ";
CM_ SG_ 1871 ConsecutiveData1 "TRANSPORT_CANDIDATE: normal-addressing ISO-TP. PSA-RE bits 2.7-2.0. ";
CM_ SG_ 1871 SingleData1 "TRANSPORT_CANDIDATE: normal-addressing ISO-TP. PSA-RE bits 2.7-2.0. ";
CM_ SG_ 1871 BlockSize "TRANSPORT_CANDIDATE: normal-addressing ISO-TP. PSA-RE bits 2.7-2.0. ";
CM_ SG_ 1871 UnknownPciLow "TRANSPORT_CANDIDATE: normal-addressing ISO-TP. PSA-RE bits 1.3-1.0. ";
CM_ SG_ 1871 FlowStatus "TRANSPORT_CANDIDATE: normal-addressing ISO-TP. PSA-RE bits 1.3-1.0. ";
CM_ SG_ 1871 ConsecutiveSequence "TRANSPORT_CANDIDATE: normal-addressing ISO-TP. PSA-RE bits 1.3-1.0. ";
CM_ SG_ 1871 FirstFrameLength "TRANSPORT_CANDIDATE: normal-addressing ISO-TP. PSA-RE bits 1.3-2.0. 12-bit declared PDU length; not a reassembled value.";
CM_ SG_ 1871 SingleFrameLength "TRANSPORT_CANDIDATE: normal-addressing ISO-TP. PSA-RE bits 1.3-1.0. Declared data length; not a validity check.";
CM_ SG_ 1871 IsoTpFrameType "TRANSPORT_CANDIDATE: normal-addressing ISO-TP. PSA-RE bits 1.7-1.4. PCI high nibble; normal addressing candidate.";
CM_ BO_ 1875 "DATABASE_CANDIDATE: physical interpretation unverified; capture/layout evidence reported separately. INFO-DIV CAN, 125000 bit/s; CAN ID 0x753. PSA-RE title: CAFR_DIAG_REQUEST. Diagnostic request addressed to the CAFR ECU. Source: https://github.com/prototux/PSA-RE/blob/67f7581e7622410efdbb29c7eda3b86982b9b450/buses/AEE2010.full/LS.INFO-DIV/753.yml. Source sender alternatives: MDS; physical TX/gateway forwarding not verified. WIRE ISO-TP ONLY: normal addressing candidate, maximum Classical CAN DLC 8; actual DLC may be shorter. Data includes padding. No reassembly, text, DID or application-layer decoding. Original application layouts are preserved in source JSON; do not decode them at wire offsets. ";
CM_ SG_ 1875 FlowPadding5 "TRANSPORT_CANDIDATE: normal-addressing ISO-TP. PSA-RE bits 8.7-8.0. ";
CM_ SG_ 1875 FirstData6 "TRANSPORT_CANDIDATE: normal-addressing ISO-TP. PSA-RE bits 8.7-8.0. ";
CM_ SG_ 1875 UnknownData7 "TRANSPORT_CANDIDATE: normal-addressing ISO-TP. PSA-RE bits 8.7-8.0. ";
CM_ SG_ 1875 ConsecutiveData7 "TRANSPORT_CANDIDATE: normal-addressing ISO-TP. PSA-RE bits 8.7-8.0. ";
CM_ SG_ 1875 SingleData7 "TRANSPORT_CANDIDATE: normal-addressing ISO-TP. PSA-RE bits 8.7-8.0. ";
CM_ SG_ 1875 FlowPadding4 "TRANSPORT_CANDIDATE: normal-addressing ISO-TP. PSA-RE bits 7.7-7.0. ";
CM_ SG_ 1875 FirstData5 "TRANSPORT_CANDIDATE: normal-addressing ISO-TP. PSA-RE bits 7.7-7.0. ";
CM_ SG_ 1875 UnknownData6 "TRANSPORT_CANDIDATE: normal-addressing ISO-TP. PSA-RE bits 7.7-7.0. ";
CM_ SG_ 1875 ConsecutiveData6 "TRANSPORT_CANDIDATE: normal-addressing ISO-TP. PSA-RE bits 7.7-7.0. ";
CM_ SG_ 1875 SingleData6 "TRANSPORT_CANDIDATE: normal-addressing ISO-TP. PSA-RE bits 7.7-7.0. ";
CM_ SG_ 1875 FlowPadding3 "TRANSPORT_CANDIDATE: normal-addressing ISO-TP. PSA-RE bits 6.7-6.0. ";
CM_ SG_ 1875 FirstData4 "TRANSPORT_CANDIDATE: normal-addressing ISO-TP. PSA-RE bits 6.7-6.0. ";
CM_ SG_ 1875 UnknownData5 "TRANSPORT_CANDIDATE: normal-addressing ISO-TP. PSA-RE bits 6.7-6.0. ";
CM_ SG_ 1875 ConsecutiveData5 "TRANSPORT_CANDIDATE: normal-addressing ISO-TP. PSA-RE bits 6.7-6.0. ";
CM_ SG_ 1875 SingleData5 "TRANSPORT_CANDIDATE: normal-addressing ISO-TP. PSA-RE bits 6.7-6.0. ";
CM_ SG_ 1875 FlowPadding2 "TRANSPORT_CANDIDATE: normal-addressing ISO-TP. PSA-RE bits 5.7-5.0. ";
CM_ SG_ 1875 FirstData3 "TRANSPORT_CANDIDATE: normal-addressing ISO-TP. PSA-RE bits 5.7-5.0. ";
CM_ SG_ 1875 UnknownData4 "TRANSPORT_CANDIDATE: normal-addressing ISO-TP. PSA-RE bits 5.7-5.0. ";
CM_ SG_ 1875 ConsecutiveData4 "TRANSPORT_CANDIDATE: normal-addressing ISO-TP. PSA-RE bits 5.7-5.0. ";
CM_ SG_ 1875 SingleData4 "TRANSPORT_CANDIDATE: normal-addressing ISO-TP. PSA-RE bits 5.7-5.0. ";
CM_ SG_ 1875 FlowPadding1 "TRANSPORT_CANDIDATE: normal-addressing ISO-TP. PSA-RE bits 4.7-4.0. ";
CM_ SG_ 1875 FirstData2 "TRANSPORT_CANDIDATE: normal-addressing ISO-TP. PSA-RE bits 4.7-4.0. ";
CM_ SG_ 1875 UnknownData3 "TRANSPORT_CANDIDATE: normal-addressing ISO-TP. PSA-RE bits 4.7-4.0. ";
CM_ SG_ 1875 ConsecutiveData3 "TRANSPORT_CANDIDATE: normal-addressing ISO-TP. PSA-RE bits 4.7-4.0. ";
CM_ SG_ 1875 SingleData3 "TRANSPORT_CANDIDATE: normal-addressing ISO-TP. PSA-RE bits 4.7-4.0. ";
CM_ SG_ 1875 FirstData1 "TRANSPORT_CANDIDATE: normal-addressing ISO-TP. PSA-RE bits 3.7-3.0. ";
CM_ SG_ 1875 UnknownData2 "TRANSPORT_CANDIDATE: normal-addressing ISO-TP. PSA-RE bits 3.7-3.0. ";
CM_ SG_ 1875 ConsecutiveData2 "TRANSPORT_CANDIDATE: normal-addressing ISO-TP. PSA-RE bits 3.7-3.0. ";
CM_ SG_ 1875 SingleData2 "TRANSPORT_CANDIDATE: normal-addressing ISO-TP. PSA-RE bits 3.7-3.0. ";
CM_ SG_ 1875 SeparationTimeRaw "TRANSPORT_CANDIDATE: normal-addressing ISO-TP. PSA-RE bits 3.7-3.0. Raw STmin code; 0xF1..0xF9 are not milliseconds.";
CM_ SG_ 1875 UnknownData1 "TRANSPORT_CANDIDATE: normal-addressing ISO-TP. PSA-RE bits 2.7-2.0. ";
CM_ SG_ 1875 ConsecutiveData1 "TRANSPORT_CANDIDATE: normal-addressing ISO-TP. PSA-RE bits 2.7-2.0. ";
CM_ SG_ 1875 SingleData1 "TRANSPORT_CANDIDATE: normal-addressing ISO-TP. PSA-RE bits 2.7-2.0. ";
CM_ SG_ 1875 BlockSize "TRANSPORT_CANDIDATE: normal-addressing ISO-TP. PSA-RE bits 2.7-2.0. ";
CM_ SG_ 1875 UnknownPciLow "TRANSPORT_CANDIDATE: normal-addressing ISO-TP. PSA-RE bits 1.3-1.0. ";
CM_ SG_ 1875 FlowStatus "TRANSPORT_CANDIDATE: normal-addressing ISO-TP. PSA-RE bits 1.3-1.0. ";
CM_ SG_ 1875 ConsecutiveSequence "TRANSPORT_CANDIDATE: normal-addressing ISO-TP. PSA-RE bits 1.3-1.0. ";
CM_ SG_ 1875 FirstFrameLength "TRANSPORT_CANDIDATE: normal-addressing ISO-TP. PSA-RE bits 1.3-2.0. 12-bit declared PDU length; not a reassembled value.";
CM_ SG_ 1875 SingleFrameLength "TRANSPORT_CANDIDATE: normal-addressing ISO-TP. PSA-RE bits 1.3-1.0. Declared data length; not a validity check.";
CM_ SG_ 1875 IsoTpFrameType "TRANSPORT_CANDIDATE: normal-addressing ISO-TP. PSA-RE bits 1.7-1.4. PCI high nibble; normal addressing candidate.";
CM_ BO_ 1880 "DATABASE_CANDIDATE: physical interpretation unverified; capture/layout evidence reported separately. INFO-DIV CAN, 125000 bit/s; CAN ID 0x758. PSA-RE title: BOP_DIAG_REQUEST. Diagnostic request sent to the BOP node by the diagnostic socket interface module (MDS). Source: https://github.com/prototux/PSA-RE/blob/67f7581e7622410efdbb29c7eda3b86982b9b450/buses/AEE2010.full/LS.INFO-DIV/758.yml. Source sender alternatives: MDS; physical TX/gateway forwarding not verified. ";
CM_ SG_ 1880 DiagnosticData "DATABASE_CANDIDATE: physical interpretation unverified; capture/layout evidence reported separately. PSA-RE bits 1.7-8.0. Diagnostic data";
CM_ BO_ 1881 "DATABASE_CANDIDATE: physical interpretation unverified; capture/layout evidence reported separately. INFO-DIV CAN, 125000 bit/s; CAN ID 0x759. PSA-RE title: BSE_DIAG_REQUEST. Diagnostic request addressed to the BSE ECU. Source: https://github.com/prototux/PSA-RE/blob/67f7581e7622410efdbb29c7eda3b86982b9b450/buses/AEE2010.full/LS.INFO-DIV/759.yml. Source sender alternatives: MDS; physical TX/gateway forwarding not verified. WIRE ISO-TP ONLY: normal addressing candidate, maximum Classical CAN DLC 8; actual DLC may be shorter. Data includes padding. No reassembly, text, DID or application-layer decoding. Original application layouts are preserved in source JSON; do not decode them at wire offsets. ";
CM_ SG_ 1881 FlowPadding5 "TRANSPORT_CANDIDATE: normal-addressing ISO-TP. PSA-RE bits 8.7-8.0. ";
CM_ SG_ 1881 FirstData6 "TRANSPORT_CANDIDATE: normal-addressing ISO-TP. PSA-RE bits 8.7-8.0. ";
CM_ SG_ 1881 UnknownData7 "TRANSPORT_CANDIDATE: normal-addressing ISO-TP. PSA-RE bits 8.7-8.0. ";
CM_ SG_ 1881 ConsecutiveData7 "TRANSPORT_CANDIDATE: normal-addressing ISO-TP. PSA-RE bits 8.7-8.0. ";
CM_ SG_ 1881 SingleData7 "TRANSPORT_CANDIDATE: normal-addressing ISO-TP. PSA-RE bits 8.7-8.0. ";
CM_ SG_ 1881 FlowPadding4 "TRANSPORT_CANDIDATE: normal-addressing ISO-TP. PSA-RE bits 7.7-7.0. ";
CM_ SG_ 1881 FirstData5 "TRANSPORT_CANDIDATE: normal-addressing ISO-TP. PSA-RE bits 7.7-7.0. ";
CM_ SG_ 1881 UnknownData6 "TRANSPORT_CANDIDATE: normal-addressing ISO-TP. PSA-RE bits 7.7-7.0. ";
CM_ SG_ 1881 ConsecutiveData6 "TRANSPORT_CANDIDATE: normal-addressing ISO-TP. PSA-RE bits 7.7-7.0. ";
CM_ SG_ 1881 SingleData6 "TRANSPORT_CANDIDATE: normal-addressing ISO-TP. PSA-RE bits 7.7-7.0. ";
CM_ SG_ 1881 FlowPadding3 "TRANSPORT_CANDIDATE: normal-addressing ISO-TP. PSA-RE bits 6.7-6.0. ";
CM_ SG_ 1881 FirstData4 "TRANSPORT_CANDIDATE: normal-addressing ISO-TP. PSA-RE bits 6.7-6.0. ";
CM_ SG_ 1881 UnknownData5 "TRANSPORT_CANDIDATE: normal-addressing ISO-TP. PSA-RE bits 6.7-6.0. ";
CM_ SG_ 1881 ConsecutiveData5 "TRANSPORT_CANDIDATE: normal-addressing ISO-TP. PSA-RE bits 6.7-6.0. ";
CM_ SG_ 1881 SingleData5 "TRANSPORT_CANDIDATE: normal-addressing ISO-TP. PSA-RE bits 6.7-6.0. ";
CM_ SG_ 1881 FlowPadding2 "TRANSPORT_CANDIDATE: normal-addressing ISO-TP. PSA-RE bits 5.7-5.0. ";
CM_ SG_ 1881 FirstData3 "TRANSPORT_CANDIDATE: normal-addressing ISO-TP. PSA-RE bits 5.7-5.0. ";
CM_ SG_ 1881 UnknownData4 "TRANSPORT_CANDIDATE: normal-addressing ISO-TP. PSA-RE bits 5.7-5.0. ";
CM_ SG_ 1881 ConsecutiveData4 "TRANSPORT_CANDIDATE: normal-addressing ISO-TP. PSA-RE bits 5.7-5.0. ";
CM_ SG_ 1881 SingleData4 "TRANSPORT_CANDIDATE: normal-addressing ISO-TP. PSA-RE bits 5.7-5.0. ";
CM_ SG_ 1881 FlowPadding1 "TRANSPORT_CANDIDATE: normal-addressing ISO-TP. PSA-RE bits 4.7-4.0. ";
CM_ SG_ 1881 FirstData2 "TRANSPORT_CANDIDATE: normal-addressing ISO-TP. PSA-RE bits 4.7-4.0. ";
CM_ SG_ 1881 UnknownData3 "TRANSPORT_CANDIDATE: normal-addressing ISO-TP. PSA-RE bits 4.7-4.0. ";
CM_ SG_ 1881 ConsecutiveData3 "TRANSPORT_CANDIDATE: normal-addressing ISO-TP. PSA-RE bits 4.7-4.0. ";
CM_ SG_ 1881 SingleData3 "TRANSPORT_CANDIDATE: normal-addressing ISO-TP. PSA-RE bits 4.7-4.0. ";
CM_ SG_ 1881 FirstData1 "TRANSPORT_CANDIDATE: normal-addressing ISO-TP. PSA-RE bits 3.7-3.0. ";
CM_ SG_ 1881 UnknownData2 "TRANSPORT_CANDIDATE: normal-addressing ISO-TP. PSA-RE bits 3.7-3.0. ";
CM_ SG_ 1881 ConsecutiveData2 "TRANSPORT_CANDIDATE: normal-addressing ISO-TP. PSA-RE bits 3.7-3.0. ";
CM_ SG_ 1881 SingleData2 "TRANSPORT_CANDIDATE: normal-addressing ISO-TP. PSA-RE bits 3.7-3.0. ";
CM_ SG_ 1881 SeparationTimeRaw "TRANSPORT_CANDIDATE: normal-addressing ISO-TP. PSA-RE bits 3.7-3.0. Raw STmin code; 0xF1..0xF9 are not milliseconds.";
CM_ SG_ 1881 UnknownData1 "TRANSPORT_CANDIDATE: normal-addressing ISO-TP. PSA-RE bits 2.7-2.0. ";
CM_ SG_ 1881 ConsecutiveData1 "TRANSPORT_CANDIDATE: normal-addressing ISO-TP. PSA-RE bits 2.7-2.0. ";
CM_ SG_ 1881 SingleData1 "TRANSPORT_CANDIDATE: normal-addressing ISO-TP. PSA-RE bits 2.7-2.0. ";
CM_ SG_ 1881 BlockSize "TRANSPORT_CANDIDATE: normal-addressing ISO-TP. PSA-RE bits 2.7-2.0. ";
CM_ SG_ 1881 UnknownPciLow "TRANSPORT_CANDIDATE: normal-addressing ISO-TP. PSA-RE bits 1.3-1.0. ";
CM_ SG_ 1881 FlowStatus "TRANSPORT_CANDIDATE: normal-addressing ISO-TP. PSA-RE bits 1.3-1.0. ";
CM_ SG_ 1881 ConsecutiveSequence "TRANSPORT_CANDIDATE: normal-addressing ISO-TP. PSA-RE bits 1.3-1.0. ";
CM_ SG_ 1881 FirstFrameLength "TRANSPORT_CANDIDATE: normal-addressing ISO-TP. PSA-RE bits 1.3-2.0. 12-bit declared PDU length; not a reassembled value.";
CM_ SG_ 1881 SingleFrameLength "TRANSPORT_CANDIDATE: normal-addressing ISO-TP. PSA-RE bits 1.3-1.0. Declared data length; not a validity check.";
CM_ SG_ 1881 IsoTpFrameType "TRANSPORT_CANDIDATE: normal-addressing ISO-TP. PSA-RE bits 1.7-1.4. PCI high nibble; normal addressing candidate.";
CM_ BO_ 1883 "DATABASE_CANDIDATE: physical interpretation unverified; capture/layout evidence reported separately. INFO-DIV CAN, 125000 bit/s; CAN ID 0x75B. PSA-RE title: SAM_DIAG_REQUEST. Diagnostic session request frame addressed to this module Source: https://github.com/prototux/PSA-RE/blob/67f7581e7622410efdbb29c7eda3b86982b9b450/buses/AEE2010.full/LS.INFO-DIV/75B.yml. Source sender alternatives: MDS; physical TX/gateway forwarding not verified. WIRE ISO-TP ONLY: normal addressing candidate, maximum Classical CAN DLC 8; actual DLC may be shorter. Data includes padding. No reassembly, text, DID or application-layer decoding. Original application layouts are preserved in source JSON; do not decode them at wire offsets. ";
CM_ SG_ 1883 FlowPadding5 "TRANSPORT_CANDIDATE: normal-addressing ISO-TP. PSA-RE bits 8.7-8.0. ";
CM_ SG_ 1883 FirstData6 "TRANSPORT_CANDIDATE: normal-addressing ISO-TP. PSA-RE bits 8.7-8.0. ";
CM_ SG_ 1883 UnknownData7 "TRANSPORT_CANDIDATE: normal-addressing ISO-TP. PSA-RE bits 8.7-8.0. ";
CM_ SG_ 1883 ConsecutiveData7 "TRANSPORT_CANDIDATE: normal-addressing ISO-TP. PSA-RE bits 8.7-8.0. ";
CM_ SG_ 1883 SingleData7 "TRANSPORT_CANDIDATE: normal-addressing ISO-TP. PSA-RE bits 8.7-8.0. ";
CM_ SG_ 1883 FlowPadding4 "TRANSPORT_CANDIDATE: normal-addressing ISO-TP. PSA-RE bits 7.7-7.0. ";
CM_ SG_ 1883 FirstData5 "TRANSPORT_CANDIDATE: normal-addressing ISO-TP. PSA-RE bits 7.7-7.0. ";
CM_ SG_ 1883 UnknownData6 "TRANSPORT_CANDIDATE: normal-addressing ISO-TP. PSA-RE bits 7.7-7.0. ";
CM_ SG_ 1883 ConsecutiveData6 "TRANSPORT_CANDIDATE: normal-addressing ISO-TP. PSA-RE bits 7.7-7.0. ";
CM_ SG_ 1883 SingleData6 "TRANSPORT_CANDIDATE: normal-addressing ISO-TP. PSA-RE bits 7.7-7.0. ";
CM_ SG_ 1883 FlowPadding3 "TRANSPORT_CANDIDATE: normal-addressing ISO-TP. PSA-RE bits 6.7-6.0. ";
CM_ SG_ 1883 FirstData4 "TRANSPORT_CANDIDATE: normal-addressing ISO-TP. PSA-RE bits 6.7-6.0. ";
CM_ SG_ 1883 UnknownData5 "TRANSPORT_CANDIDATE: normal-addressing ISO-TP. PSA-RE bits 6.7-6.0. ";
CM_ SG_ 1883 ConsecutiveData5 "TRANSPORT_CANDIDATE: normal-addressing ISO-TP. PSA-RE bits 6.7-6.0. ";
CM_ SG_ 1883 SingleData5 "TRANSPORT_CANDIDATE: normal-addressing ISO-TP. PSA-RE bits 6.7-6.0. ";
CM_ SG_ 1883 FlowPadding2 "TRANSPORT_CANDIDATE: normal-addressing ISO-TP. PSA-RE bits 5.7-5.0. ";
CM_ SG_ 1883 FirstData3 "TRANSPORT_CANDIDATE: normal-addressing ISO-TP. PSA-RE bits 5.7-5.0. ";
CM_ SG_ 1883 UnknownData4 "TRANSPORT_CANDIDATE: normal-addressing ISO-TP. PSA-RE bits 5.7-5.0. ";
CM_ SG_ 1883 ConsecutiveData4 "TRANSPORT_CANDIDATE: normal-addressing ISO-TP. PSA-RE bits 5.7-5.0. ";
CM_ SG_ 1883 SingleData4 "TRANSPORT_CANDIDATE: normal-addressing ISO-TP. PSA-RE bits 5.7-5.0. ";
CM_ SG_ 1883 FlowPadding1 "TRANSPORT_CANDIDATE: normal-addressing ISO-TP. PSA-RE bits 4.7-4.0. ";
CM_ SG_ 1883 FirstData2 "TRANSPORT_CANDIDATE: normal-addressing ISO-TP. PSA-RE bits 4.7-4.0. ";
CM_ SG_ 1883 UnknownData3 "TRANSPORT_CANDIDATE: normal-addressing ISO-TP. PSA-RE bits 4.7-4.0. ";
CM_ SG_ 1883 ConsecutiveData3 "TRANSPORT_CANDIDATE: normal-addressing ISO-TP. PSA-RE bits 4.7-4.0. ";
CM_ SG_ 1883 SingleData3 "TRANSPORT_CANDIDATE: normal-addressing ISO-TP. PSA-RE bits 4.7-4.0. ";
CM_ SG_ 1883 FirstData1 "TRANSPORT_CANDIDATE: normal-addressing ISO-TP. PSA-RE bits 3.7-3.0. ";
CM_ SG_ 1883 UnknownData2 "TRANSPORT_CANDIDATE: normal-addressing ISO-TP. PSA-RE bits 3.7-3.0. ";
CM_ SG_ 1883 ConsecutiveData2 "TRANSPORT_CANDIDATE: normal-addressing ISO-TP. PSA-RE bits 3.7-3.0. ";
CM_ SG_ 1883 SingleData2 "TRANSPORT_CANDIDATE: normal-addressing ISO-TP. PSA-RE bits 3.7-3.0. ";
CM_ SG_ 1883 SeparationTimeRaw "TRANSPORT_CANDIDATE: normal-addressing ISO-TP. PSA-RE bits 3.7-3.0. Raw STmin code; 0xF1..0xF9 are not milliseconds.";
CM_ SG_ 1883 UnknownData1 "TRANSPORT_CANDIDATE: normal-addressing ISO-TP. PSA-RE bits 2.7-2.0. ";
CM_ SG_ 1883 ConsecutiveData1 "TRANSPORT_CANDIDATE: normal-addressing ISO-TP. PSA-RE bits 2.7-2.0. ";
CM_ SG_ 1883 SingleData1 "TRANSPORT_CANDIDATE: normal-addressing ISO-TP. PSA-RE bits 2.7-2.0. ";
CM_ SG_ 1883 BlockSize "TRANSPORT_CANDIDATE: normal-addressing ISO-TP. PSA-RE bits 2.7-2.0. ";
CM_ SG_ 1883 UnknownPciLow "TRANSPORT_CANDIDATE: normal-addressing ISO-TP. PSA-RE bits 1.3-1.0. ";
CM_ SG_ 1883 FlowStatus "TRANSPORT_CANDIDATE: normal-addressing ISO-TP. PSA-RE bits 1.3-1.0. ";
CM_ SG_ 1883 ConsecutiveSequence "TRANSPORT_CANDIDATE: normal-addressing ISO-TP. PSA-RE bits 1.3-1.0. ";
CM_ SG_ 1883 FirstFrameLength "TRANSPORT_CANDIDATE: normal-addressing ISO-TP. PSA-RE bits 1.3-2.0. 12-bit declared PDU length; not a reassembled value.";
CM_ SG_ 1883 SingleFrameLength "TRANSPORT_CANDIDATE: normal-addressing ISO-TP. PSA-RE bits 1.3-1.0. Declared data length; not a validity check.";
CM_ SG_ 1883 IsoTpFrameType "TRANSPORT_CANDIDATE: normal-addressing ISO-TP. PSA-RE bits 1.7-1.4. PCI high nibble; normal addressing candidate.";
CM_ BO_ 1884 "DATABASE_CANDIDATE: physical interpretation unverified; capture/layout evidence reported separately. INFO-DIV CAN, 125000 bit/s; CAN ID 0x75C. PSA-RE title: AUS_DIAG_REQUEST. Diagnostic request addressed to the AUS ECU. Source: https://github.com/prototux/PSA-RE/blob/67f7581e7622410efdbb29c7eda3b86982b9b450/buses/AEE2010.full/LS.INFO-DIV/75C.yml. Source sender alternatives: MDS; physical TX/gateway forwarding not verified. WIRE ISO-TP ONLY: normal addressing candidate, maximum Classical CAN DLC 8; actual DLC may be shorter. Data includes padding. No reassembly, text, DID or application-layer decoding. Original application layouts are preserved in source JSON; do not decode them at wire offsets. ";
CM_ SG_ 1884 FlowPadding5 "TRANSPORT_CANDIDATE: normal-addressing ISO-TP. PSA-RE bits 8.7-8.0. ";
CM_ SG_ 1884 FirstData6 "TRANSPORT_CANDIDATE: normal-addressing ISO-TP. PSA-RE bits 8.7-8.0. ";
CM_ SG_ 1884 UnknownData7 "TRANSPORT_CANDIDATE: normal-addressing ISO-TP. PSA-RE bits 8.7-8.0. ";
CM_ SG_ 1884 ConsecutiveData7 "TRANSPORT_CANDIDATE: normal-addressing ISO-TP. PSA-RE bits 8.7-8.0. ";
CM_ SG_ 1884 SingleData7 "TRANSPORT_CANDIDATE: normal-addressing ISO-TP. PSA-RE bits 8.7-8.0. ";
CM_ SG_ 1884 FlowPadding4 "TRANSPORT_CANDIDATE: normal-addressing ISO-TP. PSA-RE bits 7.7-7.0. ";
CM_ SG_ 1884 FirstData5 "TRANSPORT_CANDIDATE: normal-addressing ISO-TP. PSA-RE bits 7.7-7.0. ";
CM_ SG_ 1884 UnknownData6 "TRANSPORT_CANDIDATE: normal-addressing ISO-TP. PSA-RE bits 7.7-7.0. ";
CM_ SG_ 1884 ConsecutiveData6 "TRANSPORT_CANDIDATE: normal-addressing ISO-TP. PSA-RE bits 7.7-7.0. ";
CM_ SG_ 1884 SingleData6 "TRANSPORT_CANDIDATE: normal-addressing ISO-TP. PSA-RE bits 7.7-7.0. ";
CM_ SG_ 1884 FlowPadding3 "TRANSPORT_CANDIDATE: normal-addressing ISO-TP. PSA-RE bits 6.7-6.0. ";
CM_ SG_ 1884 FirstData4 "TRANSPORT_CANDIDATE: normal-addressing ISO-TP. PSA-RE bits 6.7-6.0. ";
CM_ SG_ 1884 UnknownData5 "TRANSPORT_CANDIDATE: normal-addressing ISO-TP. PSA-RE bits 6.7-6.0. ";
CM_ SG_ 1884 ConsecutiveData5 "TRANSPORT_CANDIDATE: normal-addressing ISO-TP. PSA-RE bits 6.7-6.0. ";
CM_ SG_ 1884 SingleData5 "TRANSPORT_CANDIDATE: normal-addressing ISO-TP. PSA-RE bits 6.7-6.0. ";
CM_ SG_ 1884 FlowPadding2 "TRANSPORT_CANDIDATE: normal-addressing ISO-TP. PSA-RE bits 5.7-5.0. ";
CM_ SG_ 1884 FirstData3 "TRANSPORT_CANDIDATE: normal-addressing ISO-TP. PSA-RE bits 5.7-5.0. ";
CM_ SG_ 1884 UnknownData4 "TRANSPORT_CANDIDATE: normal-addressing ISO-TP. PSA-RE bits 5.7-5.0. ";
CM_ SG_ 1884 ConsecutiveData4 "TRANSPORT_CANDIDATE: normal-addressing ISO-TP. PSA-RE bits 5.7-5.0. ";
CM_ SG_ 1884 SingleData4 "TRANSPORT_CANDIDATE: normal-addressing ISO-TP. PSA-RE bits 5.7-5.0. ";
CM_ SG_ 1884 FlowPadding1 "TRANSPORT_CANDIDATE: normal-addressing ISO-TP. PSA-RE bits 4.7-4.0. ";
CM_ SG_ 1884 FirstData2 "TRANSPORT_CANDIDATE: normal-addressing ISO-TP. PSA-RE bits 4.7-4.0. ";
CM_ SG_ 1884 UnknownData3 "TRANSPORT_CANDIDATE: normal-addressing ISO-TP. PSA-RE bits 4.7-4.0. ";
CM_ SG_ 1884 ConsecutiveData3 "TRANSPORT_CANDIDATE: normal-addressing ISO-TP. PSA-RE bits 4.7-4.0. ";
CM_ SG_ 1884 SingleData3 "TRANSPORT_CANDIDATE: normal-addressing ISO-TP. PSA-RE bits 4.7-4.0. ";
CM_ SG_ 1884 FirstData1 "TRANSPORT_CANDIDATE: normal-addressing ISO-TP. PSA-RE bits 3.7-3.0. ";
CM_ SG_ 1884 UnknownData2 "TRANSPORT_CANDIDATE: normal-addressing ISO-TP. PSA-RE bits 3.7-3.0. ";
CM_ SG_ 1884 ConsecutiveData2 "TRANSPORT_CANDIDATE: normal-addressing ISO-TP. PSA-RE bits 3.7-3.0. ";
CM_ SG_ 1884 SingleData2 "TRANSPORT_CANDIDATE: normal-addressing ISO-TP. PSA-RE bits 3.7-3.0. ";
CM_ SG_ 1884 SeparationTimeRaw "TRANSPORT_CANDIDATE: normal-addressing ISO-TP. PSA-RE bits 3.7-3.0. Raw STmin code; 0xF1..0xF9 are not milliseconds.";
CM_ SG_ 1884 UnknownData1 "TRANSPORT_CANDIDATE: normal-addressing ISO-TP. PSA-RE bits 2.7-2.0. ";
CM_ SG_ 1884 ConsecutiveData1 "TRANSPORT_CANDIDATE: normal-addressing ISO-TP. PSA-RE bits 2.7-2.0. ";
CM_ SG_ 1884 SingleData1 "TRANSPORT_CANDIDATE: normal-addressing ISO-TP. PSA-RE bits 2.7-2.0. ";
CM_ SG_ 1884 BlockSize "TRANSPORT_CANDIDATE: normal-addressing ISO-TP. PSA-RE bits 2.7-2.0. ";
CM_ SG_ 1884 UnknownPciLow "TRANSPORT_CANDIDATE: normal-addressing ISO-TP. PSA-RE bits 1.3-1.0. ";
CM_ SG_ 1884 FlowStatus "TRANSPORT_CANDIDATE: normal-addressing ISO-TP. PSA-RE bits 1.3-1.0. ";
CM_ SG_ 1884 ConsecutiveSequence "TRANSPORT_CANDIDATE: normal-addressing ISO-TP. PSA-RE bits 1.3-1.0. ";
CM_ SG_ 1884 FirstFrameLength "TRANSPORT_CANDIDATE: normal-addressing ISO-TP. PSA-RE bits 1.3-2.0. 12-bit declared PDU length; not a reassembled value.";
CM_ SG_ 1884 SingleFrameLength "TRANSPORT_CANDIDATE: normal-addressing ISO-TP. PSA-RE bits 1.3-1.0. Declared data length; not a validity check.";
CM_ SG_ 1884 IsoTpFrameType "TRANSPORT_CANDIDATE: normal-addressing ISO-TP. PSA-RE bits 1.7-1.4. PCI high nibble; normal addressing candidate.";
CM_ BO_ 1885 "DATABASE_CANDIDATE: physical interpretation unverified; capture/layout evidence reported separately. INFO-DIV CAN, 125000 bit/s; CAN ID 0x75D. PSA-RE title: AAS_DIAG_REQUEST. Diagnostic request addressed to the AAS ECU. Source: https://github.com/prototux/PSA-RE/blob/67f7581e7622410efdbb29c7eda3b86982b9b450/buses/AEE2010.full/LS.INFO-DIV/75D.yml. Source sender alternatives: BSI,MDS; physical TX/gateway forwarding not verified. WIRE ISO-TP ONLY: normal addressing candidate, maximum Classical CAN DLC 8; actual DLC may be shorter. Data includes padding. No reassembly, text, DID or application-layer decoding. Original application layouts are preserved in source JSON; do not decode them at wire offsets. ";
CM_ SG_ 1885 FlowPadding5 "TRANSPORT_CANDIDATE: normal-addressing ISO-TP. PSA-RE bits 8.7-8.0. ";
CM_ SG_ 1885 FirstData6 "TRANSPORT_CANDIDATE: normal-addressing ISO-TP. PSA-RE bits 8.7-8.0. ";
CM_ SG_ 1885 UnknownData7 "TRANSPORT_CANDIDATE: normal-addressing ISO-TP. PSA-RE bits 8.7-8.0. ";
CM_ SG_ 1885 ConsecutiveData7 "TRANSPORT_CANDIDATE: normal-addressing ISO-TP. PSA-RE bits 8.7-8.0. ";
CM_ SG_ 1885 SingleData7 "TRANSPORT_CANDIDATE: normal-addressing ISO-TP. PSA-RE bits 8.7-8.0. ";
CM_ SG_ 1885 FlowPadding4 "TRANSPORT_CANDIDATE: normal-addressing ISO-TP. PSA-RE bits 7.7-7.0. ";
CM_ SG_ 1885 FirstData5 "TRANSPORT_CANDIDATE: normal-addressing ISO-TP. PSA-RE bits 7.7-7.0. ";
CM_ SG_ 1885 UnknownData6 "TRANSPORT_CANDIDATE: normal-addressing ISO-TP. PSA-RE bits 7.7-7.0. ";
CM_ SG_ 1885 ConsecutiveData6 "TRANSPORT_CANDIDATE: normal-addressing ISO-TP. PSA-RE bits 7.7-7.0. ";
CM_ SG_ 1885 SingleData6 "TRANSPORT_CANDIDATE: normal-addressing ISO-TP. PSA-RE bits 7.7-7.0. ";
CM_ SG_ 1885 FlowPadding3 "TRANSPORT_CANDIDATE: normal-addressing ISO-TP. PSA-RE bits 6.7-6.0. ";
CM_ SG_ 1885 FirstData4 "TRANSPORT_CANDIDATE: normal-addressing ISO-TP. PSA-RE bits 6.7-6.0. ";
CM_ SG_ 1885 UnknownData5 "TRANSPORT_CANDIDATE: normal-addressing ISO-TP. PSA-RE bits 6.7-6.0. ";
CM_ SG_ 1885 ConsecutiveData5 "TRANSPORT_CANDIDATE: normal-addressing ISO-TP. PSA-RE bits 6.7-6.0. ";
CM_ SG_ 1885 SingleData5 "TRANSPORT_CANDIDATE: normal-addressing ISO-TP. PSA-RE bits 6.7-6.0. ";
CM_ SG_ 1885 FlowPadding2 "TRANSPORT_CANDIDATE: normal-addressing ISO-TP. PSA-RE bits 5.7-5.0. ";
CM_ SG_ 1885 FirstData3 "TRANSPORT_CANDIDATE: normal-addressing ISO-TP. PSA-RE bits 5.7-5.0. ";
CM_ SG_ 1885 UnknownData4 "TRANSPORT_CANDIDATE: normal-addressing ISO-TP. PSA-RE bits 5.7-5.0. ";
CM_ SG_ 1885 ConsecutiveData4 "TRANSPORT_CANDIDATE: normal-addressing ISO-TP. PSA-RE bits 5.7-5.0. ";
CM_ SG_ 1885 SingleData4 "TRANSPORT_CANDIDATE: normal-addressing ISO-TP. PSA-RE bits 5.7-5.0. ";
CM_ SG_ 1885 FlowPadding1 "TRANSPORT_CANDIDATE: normal-addressing ISO-TP. PSA-RE bits 4.7-4.0. ";
CM_ SG_ 1885 FirstData2 "TRANSPORT_CANDIDATE: normal-addressing ISO-TP. PSA-RE bits 4.7-4.0. ";
CM_ SG_ 1885 UnknownData3 "TRANSPORT_CANDIDATE: normal-addressing ISO-TP. PSA-RE bits 4.7-4.0. ";
CM_ SG_ 1885 ConsecutiveData3 "TRANSPORT_CANDIDATE: normal-addressing ISO-TP. PSA-RE bits 4.7-4.0. ";
CM_ SG_ 1885 SingleData3 "TRANSPORT_CANDIDATE: normal-addressing ISO-TP. PSA-RE bits 4.7-4.0. ";
CM_ SG_ 1885 FirstData1 "TRANSPORT_CANDIDATE: normal-addressing ISO-TP. PSA-RE bits 3.7-3.0. ";
CM_ SG_ 1885 UnknownData2 "TRANSPORT_CANDIDATE: normal-addressing ISO-TP. PSA-RE bits 3.7-3.0. ";
CM_ SG_ 1885 ConsecutiveData2 "TRANSPORT_CANDIDATE: normal-addressing ISO-TP. PSA-RE bits 3.7-3.0. ";
CM_ SG_ 1885 SingleData2 "TRANSPORT_CANDIDATE: normal-addressing ISO-TP. PSA-RE bits 3.7-3.0. ";
CM_ SG_ 1885 SeparationTimeRaw "TRANSPORT_CANDIDATE: normal-addressing ISO-TP. PSA-RE bits 3.7-3.0. Raw STmin code; 0xF1..0xF9 are not milliseconds.";
CM_ SG_ 1885 UnknownData1 "TRANSPORT_CANDIDATE: normal-addressing ISO-TP. PSA-RE bits 2.7-2.0. ";
CM_ SG_ 1885 ConsecutiveData1 "TRANSPORT_CANDIDATE: normal-addressing ISO-TP. PSA-RE bits 2.7-2.0. ";
CM_ SG_ 1885 SingleData1 "TRANSPORT_CANDIDATE: normal-addressing ISO-TP. PSA-RE bits 2.7-2.0. ";
CM_ SG_ 1885 BlockSize "TRANSPORT_CANDIDATE: normal-addressing ISO-TP. PSA-RE bits 2.7-2.0. ";
CM_ SG_ 1885 UnknownPciLow "TRANSPORT_CANDIDATE: normal-addressing ISO-TP. PSA-RE bits 1.3-1.0. ";
CM_ SG_ 1885 FlowStatus "TRANSPORT_CANDIDATE: normal-addressing ISO-TP. PSA-RE bits 1.3-1.0. ";
CM_ SG_ 1885 ConsecutiveSequence "TRANSPORT_CANDIDATE: normal-addressing ISO-TP. PSA-RE bits 1.3-1.0. ";
CM_ SG_ 1885 FirstFrameLength "TRANSPORT_CANDIDATE: normal-addressing ISO-TP. PSA-RE bits 1.3-2.0. 12-bit declared PDU length; not a reassembled value.";
CM_ SG_ 1885 SingleFrameLength "TRANSPORT_CANDIDATE: normal-addressing ISO-TP. PSA-RE bits 1.3-1.0. Declared data length; not a validity check.";
CM_ SG_ 1885 IsoTpFrameType "TRANSPORT_CANDIDATE: normal-addressing ISO-TP. PSA-RE bits 1.7-1.4. PCI high nibble; normal addressing candidate.";
CM_ BO_ 1886 "DATABASE_CANDIDATE: physical interpretation unverified; capture/layout evidence reported separately. INFO-DIV CAN, 125000 bit/s; CAN ID 0x75E. PSA-RE title: MAE_DIAG_REQUEST. Diagnostic request addressed to the MAE ECU. Source: https://github.com/prototux/PSA-RE/blob/67f7581e7622410efdbb29c7eda3b86982b9b450/buses/AEE2010.full/LS.INFO-DIV/75E.yml. Source sender alternatives: MDS; physical TX/gateway forwarding not verified. WIRE ISO-TP ONLY: normal addressing candidate, maximum Classical CAN DLC 8; actual DLC may be shorter. Data includes padding. No reassembly, text, DID or application-layer decoding. Original application layouts are preserved in source JSON; do not decode them at wire offsets. ";
CM_ SG_ 1886 FlowPadding5 "TRANSPORT_CANDIDATE: normal-addressing ISO-TP. PSA-RE bits 8.7-8.0. ";
CM_ SG_ 1886 FirstData6 "TRANSPORT_CANDIDATE: normal-addressing ISO-TP. PSA-RE bits 8.7-8.0. ";
CM_ SG_ 1886 UnknownData7 "TRANSPORT_CANDIDATE: normal-addressing ISO-TP. PSA-RE bits 8.7-8.0. ";
CM_ SG_ 1886 ConsecutiveData7 "TRANSPORT_CANDIDATE: normal-addressing ISO-TP. PSA-RE bits 8.7-8.0. ";
CM_ SG_ 1886 SingleData7 "TRANSPORT_CANDIDATE: normal-addressing ISO-TP. PSA-RE bits 8.7-8.0. ";
CM_ SG_ 1886 FlowPadding4 "TRANSPORT_CANDIDATE: normal-addressing ISO-TP. PSA-RE bits 7.7-7.0. ";
CM_ SG_ 1886 FirstData5 "TRANSPORT_CANDIDATE: normal-addressing ISO-TP. PSA-RE bits 7.7-7.0. ";
CM_ SG_ 1886 UnknownData6 "TRANSPORT_CANDIDATE: normal-addressing ISO-TP. PSA-RE bits 7.7-7.0. ";
CM_ SG_ 1886 ConsecutiveData6 "TRANSPORT_CANDIDATE: normal-addressing ISO-TP. PSA-RE bits 7.7-7.0. ";
CM_ SG_ 1886 SingleData6 "TRANSPORT_CANDIDATE: normal-addressing ISO-TP. PSA-RE bits 7.7-7.0. ";
CM_ SG_ 1886 FlowPadding3 "TRANSPORT_CANDIDATE: normal-addressing ISO-TP. PSA-RE bits 6.7-6.0. ";
CM_ SG_ 1886 FirstData4 "TRANSPORT_CANDIDATE: normal-addressing ISO-TP. PSA-RE bits 6.7-6.0. ";
CM_ SG_ 1886 UnknownData5 "TRANSPORT_CANDIDATE: normal-addressing ISO-TP. PSA-RE bits 6.7-6.0. ";
CM_ SG_ 1886 ConsecutiveData5 "TRANSPORT_CANDIDATE: normal-addressing ISO-TP. PSA-RE bits 6.7-6.0. ";
CM_ SG_ 1886 SingleData5 "TRANSPORT_CANDIDATE: normal-addressing ISO-TP. PSA-RE bits 6.7-6.0. ";
CM_ SG_ 1886 FlowPadding2 "TRANSPORT_CANDIDATE: normal-addressing ISO-TP. PSA-RE bits 5.7-5.0. ";
CM_ SG_ 1886 FirstData3 "TRANSPORT_CANDIDATE: normal-addressing ISO-TP. PSA-RE bits 5.7-5.0. ";
CM_ SG_ 1886 UnknownData4 "TRANSPORT_CANDIDATE: normal-addressing ISO-TP. PSA-RE bits 5.7-5.0. ";
CM_ SG_ 1886 ConsecutiveData4 "TRANSPORT_CANDIDATE: normal-addressing ISO-TP. PSA-RE bits 5.7-5.0. ";
CM_ SG_ 1886 SingleData4 "TRANSPORT_CANDIDATE: normal-addressing ISO-TP. PSA-RE bits 5.7-5.0. ";
CM_ SG_ 1886 FlowPadding1 "TRANSPORT_CANDIDATE: normal-addressing ISO-TP. PSA-RE bits 4.7-4.0. ";
CM_ SG_ 1886 FirstData2 "TRANSPORT_CANDIDATE: normal-addressing ISO-TP. PSA-RE bits 4.7-4.0. ";
CM_ SG_ 1886 UnknownData3 "TRANSPORT_CANDIDATE: normal-addressing ISO-TP. PSA-RE bits 4.7-4.0. ";
CM_ SG_ 1886 ConsecutiveData3 "TRANSPORT_CANDIDATE: normal-addressing ISO-TP. PSA-RE bits 4.7-4.0. ";
CM_ SG_ 1886 SingleData3 "TRANSPORT_CANDIDATE: normal-addressing ISO-TP. PSA-RE bits 4.7-4.0. ";
CM_ SG_ 1886 FirstData1 "TRANSPORT_CANDIDATE: normal-addressing ISO-TP. PSA-RE bits 3.7-3.0. ";
CM_ SG_ 1886 UnknownData2 "TRANSPORT_CANDIDATE: normal-addressing ISO-TP. PSA-RE bits 3.7-3.0. ";
CM_ SG_ 1886 ConsecutiveData2 "TRANSPORT_CANDIDATE: normal-addressing ISO-TP. PSA-RE bits 3.7-3.0. ";
CM_ SG_ 1886 SingleData2 "TRANSPORT_CANDIDATE: normal-addressing ISO-TP. PSA-RE bits 3.7-3.0. ";
CM_ SG_ 1886 SeparationTimeRaw "TRANSPORT_CANDIDATE: normal-addressing ISO-TP. PSA-RE bits 3.7-3.0. Raw STmin code; 0xF1..0xF9 are not milliseconds.";
CM_ SG_ 1886 UnknownData1 "TRANSPORT_CANDIDATE: normal-addressing ISO-TP. PSA-RE bits 2.7-2.0. ";
CM_ SG_ 1886 ConsecutiveData1 "TRANSPORT_CANDIDATE: normal-addressing ISO-TP. PSA-RE bits 2.7-2.0. ";
CM_ SG_ 1886 SingleData1 "TRANSPORT_CANDIDATE: normal-addressing ISO-TP. PSA-RE bits 2.7-2.0. ";
CM_ SG_ 1886 BlockSize "TRANSPORT_CANDIDATE: normal-addressing ISO-TP. PSA-RE bits 2.7-2.0. ";
CM_ SG_ 1886 UnknownPciLow "TRANSPORT_CANDIDATE: normal-addressing ISO-TP. PSA-RE bits 1.3-1.0. ";
CM_ SG_ 1886 FlowStatus "TRANSPORT_CANDIDATE: normal-addressing ISO-TP. PSA-RE bits 1.3-1.0. ";
CM_ SG_ 1886 ConsecutiveSequence "TRANSPORT_CANDIDATE: normal-addressing ISO-TP. PSA-RE bits 1.3-1.0. ";
CM_ SG_ 1886 FirstFrameLength "TRANSPORT_CANDIDATE: normal-addressing ISO-TP. PSA-RE bits 1.3-2.0. 12-bit declared PDU length; not a reassembled value.";
CM_ SG_ 1886 SingleFrameLength "TRANSPORT_CANDIDATE: normal-addressing ISO-TP. PSA-RE bits 1.3-1.0. Declared data length; not a validity check.";
CM_ SG_ 1886 IsoTpFrameType "TRANSPORT_CANDIDATE: normal-addressing ISO-TP. PSA-RE bits 1.7-1.4. PCI high nibble; normal addressing candidate.";
CM_ BO_ 1887 "DATABASE_CANDIDATE: physical interpretation unverified; capture/layout evidence reported separately. INFO-DIV CAN, 125000 bit/s; CAN ID 0x75F. PSA-RE title: CMB_DIAG_REQUEST. Diagnostic request addressed to the CMB ECU. Source: https://github.com/prototux/PSA-RE/blob/67f7581e7622410efdbb29c7eda3b86982b9b450/buses/AEE2010.full/LS.INFO-DIV/75F.yml. Source sender alternatives: BSI,MDS; physical TX/gateway forwarding not verified. WIRE ISO-TP ONLY: normal addressing candidate, maximum Classical CAN DLC 8; actual DLC may be shorter. Data includes padding. No reassembly, text, DID or application-layer decoding. Original application layouts are preserved in source JSON; do not decode them at wire offsets. ";
CM_ SG_ 1887 FlowPadding5 "TRANSPORT_CANDIDATE: normal-addressing ISO-TP. PSA-RE bits 8.7-8.0. ";
CM_ SG_ 1887 FirstData6 "TRANSPORT_CANDIDATE: normal-addressing ISO-TP. PSA-RE bits 8.7-8.0. ";
CM_ SG_ 1887 UnknownData7 "TRANSPORT_CANDIDATE: normal-addressing ISO-TP. PSA-RE bits 8.7-8.0. ";
CM_ SG_ 1887 ConsecutiveData7 "TRANSPORT_CANDIDATE: normal-addressing ISO-TP. PSA-RE bits 8.7-8.0. ";
CM_ SG_ 1887 SingleData7 "TRANSPORT_CANDIDATE: normal-addressing ISO-TP. PSA-RE bits 8.7-8.0. ";
CM_ SG_ 1887 FlowPadding4 "TRANSPORT_CANDIDATE: normal-addressing ISO-TP. PSA-RE bits 7.7-7.0. ";
CM_ SG_ 1887 FirstData5 "TRANSPORT_CANDIDATE: normal-addressing ISO-TP. PSA-RE bits 7.7-7.0. ";
CM_ SG_ 1887 UnknownData6 "TRANSPORT_CANDIDATE: normal-addressing ISO-TP. PSA-RE bits 7.7-7.0. ";
CM_ SG_ 1887 ConsecutiveData6 "TRANSPORT_CANDIDATE: normal-addressing ISO-TP. PSA-RE bits 7.7-7.0. ";
CM_ SG_ 1887 SingleData6 "TRANSPORT_CANDIDATE: normal-addressing ISO-TP. PSA-RE bits 7.7-7.0. ";
CM_ SG_ 1887 FlowPadding3 "TRANSPORT_CANDIDATE: normal-addressing ISO-TP. PSA-RE bits 6.7-6.0. ";
CM_ SG_ 1887 FirstData4 "TRANSPORT_CANDIDATE: normal-addressing ISO-TP. PSA-RE bits 6.7-6.0. ";
CM_ SG_ 1887 UnknownData5 "TRANSPORT_CANDIDATE: normal-addressing ISO-TP. PSA-RE bits 6.7-6.0. ";
CM_ SG_ 1887 ConsecutiveData5 "TRANSPORT_CANDIDATE: normal-addressing ISO-TP. PSA-RE bits 6.7-6.0. ";
CM_ SG_ 1887 SingleData5 "TRANSPORT_CANDIDATE: normal-addressing ISO-TP. PSA-RE bits 6.7-6.0. ";
CM_ SG_ 1887 FlowPadding2 "TRANSPORT_CANDIDATE: normal-addressing ISO-TP. PSA-RE bits 5.7-5.0. ";
CM_ SG_ 1887 FirstData3 "TRANSPORT_CANDIDATE: normal-addressing ISO-TP. PSA-RE bits 5.7-5.0. ";
CM_ SG_ 1887 UnknownData4 "TRANSPORT_CANDIDATE: normal-addressing ISO-TP. PSA-RE bits 5.7-5.0. ";
CM_ SG_ 1887 ConsecutiveData4 "TRANSPORT_CANDIDATE: normal-addressing ISO-TP. PSA-RE bits 5.7-5.0. ";
CM_ SG_ 1887 SingleData4 "TRANSPORT_CANDIDATE: normal-addressing ISO-TP. PSA-RE bits 5.7-5.0. ";
CM_ SG_ 1887 FlowPadding1 "TRANSPORT_CANDIDATE: normal-addressing ISO-TP. PSA-RE bits 4.7-4.0. ";
CM_ SG_ 1887 FirstData2 "TRANSPORT_CANDIDATE: normal-addressing ISO-TP. PSA-RE bits 4.7-4.0. ";
CM_ SG_ 1887 UnknownData3 "TRANSPORT_CANDIDATE: normal-addressing ISO-TP. PSA-RE bits 4.7-4.0. ";
CM_ SG_ 1887 ConsecutiveData3 "TRANSPORT_CANDIDATE: normal-addressing ISO-TP. PSA-RE bits 4.7-4.0. ";
CM_ SG_ 1887 SingleData3 "TRANSPORT_CANDIDATE: normal-addressing ISO-TP. PSA-RE bits 4.7-4.0. ";
CM_ SG_ 1887 FirstData1 "TRANSPORT_CANDIDATE: normal-addressing ISO-TP. PSA-RE bits 3.7-3.0. ";
CM_ SG_ 1887 UnknownData2 "TRANSPORT_CANDIDATE: normal-addressing ISO-TP. PSA-RE bits 3.7-3.0. ";
CM_ SG_ 1887 ConsecutiveData2 "TRANSPORT_CANDIDATE: normal-addressing ISO-TP. PSA-RE bits 3.7-3.0. ";
CM_ SG_ 1887 SingleData2 "TRANSPORT_CANDIDATE: normal-addressing ISO-TP. PSA-RE bits 3.7-3.0. ";
CM_ SG_ 1887 SeparationTimeRaw "TRANSPORT_CANDIDATE: normal-addressing ISO-TP. PSA-RE bits 3.7-3.0. Raw STmin code; 0xF1..0xF9 are not milliseconds.";
CM_ SG_ 1887 UnknownData1 "TRANSPORT_CANDIDATE: normal-addressing ISO-TP. PSA-RE bits 2.7-2.0. ";
CM_ SG_ 1887 ConsecutiveData1 "TRANSPORT_CANDIDATE: normal-addressing ISO-TP. PSA-RE bits 2.7-2.0. ";
CM_ SG_ 1887 SingleData1 "TRANSPORT_CANDIDATE: normal-addressing ISO-TP. PSA-RE bits 2.7-2.0. ";
CM_ SG_ 1887 BlockSize "TRANSPORT_CANDIDATE: normal-addressing ISO-TP. PSA-RE bits 2.7-2.0. ";
CM_ SG_ 1887 UnknownPciLow "TRANSPORT_CANDIDATE: normal-addressing ISO-TP. PSA-RE bits 1.3-1.0. ";
CM_ SG_ 1887 FlowStatus "TRANSPORT_CANDIDATE: normal-addressing ISO-TP. PSA-RE bits 1.3-1.0. ";
CM_ SG_ 1887 ConsecutiveSequence "TRANSPORT_CANDIDATE: normal-addressing ISO-TP. PSA-RE bits 1.3-1.0. ";
CM_ SG_ 1887 FirstFrameLength "TRANSPORT_CANDIDATE: normal-addressing ISO-TP. PSA-RE bits 1.3-2.0. 12-bit declared PDU length; not a reassembled value.";
CM_ SG_ 1887 SingleFrameLength "TRANSPORT_CANDIDATE: normal-addressing ISO-TP. PSA-RE bits 1.3-1.0. Declared data length; not a validity check.";
CM_ SG_ 1887 IsoTpFrameType "TRANSPORT_CANDIDATE: normal-addressing ISO-TP. PSA-RE bits 1.7-1.4. PCI high nibble; normal addressing candidate.";
CM_ BO_ 1888 "DATABASE_CANDIDATE: physical interpretation unverified; capture/layout evidence reported separately. INFO-DIV CAN, 125000 bit/s; CAN ID 0x760. PSA-RE title: RAD_DIAG_REQUEST. Diagnostic request addressed to the RAD ECU. Source: https://github.com/prototux/PSA-RE/blob/67f7581e7622410efdbb29c7eda3b86982b9b450/buses/AEE2010.full/LS.INFO-DIV/760.yml. Source sender alternatives: BSI,MDS,ICSV; physical TX/gateway forwarding not verified. WIRE ISO-TP ONLY: normal addressing candidate, maximum Classical CAN DLC 8; actual DLC may be shorter. Data includes padding. No reassembly, text, DID or application-layer decoding. Original application layouts are preserved in source JSON; do not decode them at wire offsets. ";
CM_ SG_ 1888 FlowPadding5 "TRANSPORT_CANDIDATE: normal-addressing ISO-TP. PSA-RE bits 8.7-8.0. ";
CM_ SG_ 1888 FirstData6 "TRANSPORT_CANDIDATE: normal-addressing ISO-TP. PSA-RE bits 8.7-8.0. ";
CM_ SG_ 1888 UnknownData7 "TRANSPORT_CANDIDATE: normal-addressing ISO-TP. PSA-RE bits 8.7-8.0. ";
CM_ SG_ 1888 ConsecutiveData7 "TRANSPORT_CANDIDATE: normal-addressing ISO-TP. PSA-RE bits 8.7-8.0. ";
CM_ SG_ 1888 SingleData7 "TRANSPORT_CANDIDATE: normal-addressing ISO-TP. PSA-RE bits 8.7-8.0. ";
CM_ SG_ 1888 FlowPadding4 "TRANSPORT_CANDIDATE: normal-addressing ISO-TP. PSA-RE bits 7.7-7.0. ";
CM_ SG_ 1888 FirstData5 "TRANSPORT_CANDIDATE: normal-addressing ISO-TP. PSA-RE bits 7.7-7.0. ";
CM_ SG_ 1888 UnknownData6 "TRANSPORT_CANDIDATE: normal-addressing ISO-TP. PSA-RE bits 7.7-7.0. ";
CM_ SG_ 1888 ConsecutiveData6 "TRANSPORT_CANDIDATE: normal-addressing ISO-TP. PSA-RE bits 7.7-7.0. ";
CM_ SG_ 1888 SingleData6 "TRANSPORT_CANDIDATE: normal-addressing ISO-TP. PSA-RE bits 7.7-7.0. ";
CM_ SG_ 1888 FlowPadding3 "TRANSPORT_CANDIDATE: normal-addressing ISO-TP. PSA-RE bits 6.7-6.0. ";
CM_ SG_ 1888 FirstData4 "TRANSPORT_CANDIDATE: normal-addressing ISO-TP. PSA-RE bits 6.7-6.0. ";
CM_ SG_ 1888 UnknownData5 "TRANSPORT_CANDIDATE: normal-addressing ISO-TP. PSA-RE bits 6.7-6.0. ";
CM_ SG_ 1888 ConsecutiveData5 "TRANSPORT_CANDIDATE: normal-addressing ISO-TP. PSA-RE bits 6.7-6.0. ";
CM_ SG_ 1888 SingleData5 "TRANSPORT_CANDIDATE: normal-addressing ISO-TP. PSA-RE bits 6.7-6.0. ";
CM_ SG_ 1888 FlowPadding2 "TRANSPORT_CANDIDATE: normal-addressing ISO-TP. PSA-RE bits 5.7-5.0. ";
CM_ SG_ 1888 FirstData3 "TRANSPORT_CANDIDATE: normal-addressing ISO-TP. PSA-RE bits 5.7-5.0. ";
CM_ SG_ 1888 UnknownData4 "TRANSPORT_CANDIDATE: normal-addressing ISO-TP. PSA-RE bits 5.7-5.0. ";
CM_ SG_ 1888 ConsecutiveData4 "TRANSPORT_CANDIDATE: normal-addressing ISO-TP. PSA-RE bits 5.7-5.0. ";
CM_ SG_ 1888 SingleData4 "TRANSPORT_CANDIDATE: normal-addressing ISO-TP. PSA-RE bits 5.7-5.0. ";
CM_ SG_ 1888 FlowPadding1 "TRANSPORT_CANDIDATE: normal-addressing ISO-TP. PSA-RE bits 4.7-4.0. ";
CM_ SG_ 1888 FirstData2 "TRANSPORT_CANDIDATE: normal-addressing ISO-TP. PSA-RE bits 4.7-4.0. ";
CM_ SG_ 1888 UnknownData3 "TRANSPORT_CANDIDATE: normal-addressing ISO-TP. PSA-RE bits 4.7-4.0. ";
CM_ SG_ 1888 ConsecutiveData3 "TRANSPORT_CANDIDATE: normal-addressing ISO-TP. PSA-RE bits 4.7-4.0. ";
CM_ SG_ 1888 SingleData3 "TRANSPORT_CANDIDATE: normal-addressing ISO-TP. PSA-RE bits 4.7-4.0. ";
CM_ SG_ 1888 FirstData1 "TRANSPORT_CANDIDATE: normal-addressing ISO-TP. PSA-RE bits 3.7-3.0. ";
CM_ SG_ 1888 UnknownData2 "TRANSPORT_CANDIDATE: normal-addressing ISO-TP. PSA-RE bits 3.7-3.0. ";
CM_ SG_ 1888 ConsecutiveData2 "TRANSPORT_CANDIDATE: normal-addressing ISO-TP. PSA-RE bits 3.7-3.0. ";
CM_ SG_ 1888 SingleData2 "TRANSPORT_CANDIDATE: normal-addressing ISO-TP. PSA-RE bits 3.7-3.0. ";
CM_ SG_ 1888 SeparationTimeRaw "TRANSPORT_CANDIDATE: normal-addressing ISO-TP. PSA-RE bits 3.7-3.0. Raw STmin code; 0xF1..0xF9 are not milliseconds.";
CM_ SG_ 1888 UnknownData1 "TRANSPORT_CANDIDATE: normal-addressing ISO-TP. PSA-RE bits 2.7-2.0. ";
CM_ SG_ 1888 ConsecutiveData1 "TRANSPORT_CANDIDATE: normal-addressing ISO-TP. PSA-RE bits 2.7-2.0. ";
CM_ SG_ 1888 SingleData1 "TRANSPORT_CANDIDATE: normal-addressing ISO-TP. PSA-RE bits 2.7-2.0. ";
CM_ SG_ 1888 BlockSize "TRANSPORT_CANDIDATE: normal-addressing ISO-TP. PSA-RE bits 2.7-2.0. ";
CM_ SG_ 1888 UnknownPciLow "TRANSPORT_CANDIDATE: normal-addressing ISO-TP. PSA-RE bits 1.3-1.0. ";
CM_ SG_ 1888 FlowStatus "TRANSPORT_CANDIDATE: normal-addressing ISO-TP. PSA-RE bits 1.3-1.0. ";
CM_ SG_ 1888 ConsecutiveSequence "TRANSPORT_CANDIDATE: normal-addressing ISO-TP. PSA-RE bits 1.3-1.0. ";
CM_ SG_ 1888 FirstFrameLength "TRANSPORT_CANDIDATE: normal-addressing ISO-TP. PSA-RE bits 1.3-2.0. 12-bit declared PDU length; not a reassembled value.";
CM_ SG_ 1888 SingleFrameLength "TRANSPORT_CANDIDATE: normal-addressing ISO-TP. PSA-RE bits 1.3-1.0. Declared data length; not a validity check.";
CM_ SG_ 1888 IsoTpFrameType "TRANSPORT_CANDIDATE: normal-addressing ISO-TP. PSA-RE bits 1.7-1.4. PCI high nibble; normal addressing candidate.";
CM_ BO_ 1889 "DATABASE_CANDIDATE: physical interpretation unverified; capture/layout evidence reported separately. INFO-DIV CAN, 125000 bit/s; CAN ID 0x761. PSA-RE title: IVC_D_DIAG_REQUEST. Diagnostic request addressed to the IVC_D ECU. Source: https://github.com/prototux/PSA-RE/blob/67f7581e7622410efdbb29c7eda3b86982b9b450/buses/AEE2010.full/LS.INFO-DIV/761.yml. Source sender alternatives: MDS; physical TX/gateway forwarding not verified. WIRE ISO-TP ONLY: normal addressing candidate, maximum Classical CAN DLC 8; actual DLC may be shorter. Data includes padding. No reassembly, text, DID or application-layer decoding. Original application layouts are preserved in source JSON; do not decode them at wire offsets. ";
CM_ SG_ 1889 FlowPadding5 "TRANSPORT_CANDIDATE: normal-addressing ISO-TP. PSA-RE bits 8.7-8.0. ";
CM_ SG_ 1889 FirstData6 "TRANSPORT_CANDIDATE: normal-addressing ISO-TP. PSA-RE bits 8.7-8.0. ";
CM_ SG_ 1889 UnknownData7 "TRANSPORT_CANDIDATE: normal-addressing ISO-TP. PSA-RE bits 8.7-8.0. ";
CM_ SG_ 1889 ConsecutiveData7 "TRANSPORT_CANDIDATE: normal-addressing ISO-TP. PSA-RE bits 8.7-8.0. ";
CM_ SG_ 1889 SingleData7 "TRANSPORT_CANDIDATE: normal-addressing ISO-TP. PSA-RE bits 8.7-8.0. ";
CM_ SG_ 1889 FlowPadding4 "TRANSPORT_CANDIDATE: normal-addressing ISO-TP. PSA-RE bits 7.7-7.0. ";
CM_ SG_ 1889 FirstData5 "TRANSPORT_CANDIDATE: normal-addressing ISO-TP. PSA-RE bits 7.7-7.0. ";
CM_ SG_ 1889 UnknownData6 "TRANSPORT_CANDIDATE: normal-addressing ISO-TP. PSA-RE bits 7.7-7.0. ";
CM_ SG_ 1889 ConsecutiveData6 "TRANSPORT_CANDIDATE: normal-addressing ISO-TP. PSA-RE bits 7.7-7.0. ";
CM_ SG_ 1889 SingleData6 "TRANSPORT_CANDIDATE: normal-addressing ISO-TP. PSA-RE bits 7.7-7.0. ";
CM_ SG_ 1889 FlowPadding3 "TRANSPORT_CANDIDATE: normal-addressing ISO-TP. PSA-RE bits 6.7-6.0. ";
CM_ SG_ 1889 FirstData4 "TRANSPORT_CANDIDATE: normal-addressing ISO-TP. PSA-RE bits 6.7-6.0. ";
CM_ SG_ 1889 UnknownData5 "TRANSPORT_CANDIDATE: normal-addressing ISO-TP. PSA-RE bits 6.7-6.0. ";
CM_ SG_ 1889 ConsecutiveData5 "TRANSPORT_CANDIDATE: normal-addressing ISO-TP. PSA-RE bits 6.7-6.0. ";
CM_ SG_ 1889 SingleData5 "TRANSPORT_CANDIDATE: normal-addressing ISO-TP. PSA-RE bits 6.7-6.0. ";
CM_ SG_ 1889 FlowPadding2 "TRANSPORT_CANDIDATE: normal-addressing ISO-TP. PSA-RE bits 5.7-5.0. ";
CM_ SG_ 1889 FirstData3 "TRANSPORT_CANDIDATE: normal-addressing ISO-TP. PSA-RE bits 5.7-5.0. ";
CM_ SG_ 1889 UnknownData4 "TRANSPORT_CANDIDATE: normal-addressing ISO-TP. PSA-RE bits 5.7-5.0. ";
CM_ SG_ 1889 ConsecutiveData4 "TRANSPORT_CANDIDATE: normal-addressing ISO-TP. PSA-RE bits 5.7-5.0. ";
CM_ SG_ 1889 SingleData4 "TRANSPORT_CANDIDATE: normal-addressing ISO-TP. PSA-RE bits 5.7-5.0. ";
CM_ SG_ 1889 FlowPadding1 "TRANSPORT_CANDIDATE: normal-addressing ISO-TP. PSA-RE bits 4.7-4.0. ";
CM_ SG_ 1889 FirstData2 "TRANSPORT_CANDIDATE: normal-addressing ISO-TP. PSA-RE bits 4.7-4.0. ";
CM_ SG_ 1889 UnknownData3 "TRANSPORT_CANDIDATE: normal-addressing ISO-TP. PSA-RE bits 4.7-4.0. ";
CM_ SG_ 1889 ConsecutiveData3 "TRANSPORT_CANDIDATE: normal-addressing ISO-TP. PSA-RE bits 4.7-4.0. ";
CM_ SG_ 1889 SingleData3 "TRANSPORT_CANDIDATE: normal-addressing ISO-TP. PSA-RE bits 4.7-4.0. ";
CM_ SG_ 1889 FirstData1 "TRANSPORT_CANDIDATE: normal-addressing ISO-TP. PSA-RE bits 3.7-3.0. ";
CM_ SG_ 1889 UnknownData2 "TRANSPORT_CANDIDATE: normal-addressing ISO-TP. PSA-RE bits 3.7-3.0. ";
CM_ SG_ 1889 ConsecutiveData2 "TRANSPORT_CANDIDATE: normal-addressing ISO-TP. PSA-RE bits 3.7-3.0. ";
CM_ SG_ 1889 SingleData2 "TRANSPORT_CANDIDATE: normal-addressing ISO-TP. PSA-RE bits 3.7-3.0. ";
CM_ SG_ 1889 SeparationTimeRaw "TRANSPORT_CANDIDATE: normal-addressing ISO-TP. PSA-RE bits 3.7-3.0. Raw STmin code; 0xF1..0xF9 are not milliseconds.";
CM_ SG_ 1889 UnknownData1 "TRANSPORT_CANDIDATE: normal-addressing ISO-TP. PSA-RE bits 2.7-2.0. ";
CM_ SG_ 1889 ConsecutiveData1 "TRANSPORT_CANDIDATE: normal-addressing ISO-TP. PSA-RE bits 2.7-2.0. ";
CM_ SG_ 1889 SingleData1 "TRANSPORT_CANDIDATE: normal-addressing ISO-TP. PSA-RE bits 2.7-2.0. ";
CM_ SG_ 1889 BlockSize "TRANSPORT_CANDIDATE: normal-addressing ISO-TP. PSA-RE bits 2.7-2.0. ";
CM_ SG_ 1889 UnknownPciLow "TRANSPORT_CANDIDATE: normal-addressing ISO-TP. PSA-RE bits 1.3-1.0. ";
CM_ SG_ 1889 FlowStatus "TRANSPORT_CANDIDATE: normal-addressing ISO-TP. PSA-RE bits 1.3-1.0. ";
CM_ SG_ 1889 ConsecutiveSequence "TRANSPORT_CANDIDATE: normal-addressing ISO-TP. PSA-RE bits 1.3-1.0. ";
CM_ SG_ 1889 FirstFrameLength "TRANSPORT_CANDIDATE: normal-addressing ISO-TP. PSA-RE bits 1.3-2.0. 12-bit declared PDU length; not a reassembled value.";
CM_ SG_ 1889 SingleFrameLength "TRANSPORT_CANDIDATE: normal-addressing ISO-TP. PSA-RE bits 1.3-1.0. Declared data length; not a validity check.";
CM_ SG_ 1889 IsoTpFrameType "TRANSPORT_CANDIDATE: normal-addressing ISO-TP. PSA-RE bits 1.7-1.4. PCI high nibble; normal addressing candidate.";
CM_ BO_ 1890 "DATABASE_CANDIDATE: physical interpretation unverified; capture/layout evidence reported separately. INFO-DIV CAN, 125000 bit/s; CAN ID 0x762. PSA-RE title: FAULT_LOG_SCDT. Diagnostic session request frame addressed to this module Source: https://github.com/prototux/PSA-RE/blob/67f7581e7622410efdbb29c7eda3b86982b9b450/buses/AEE2010.full/LS.INFO-DIV/762.yml. Source sender alternatives: MDS; physical TX/gateway forwarding not verified. WIRE ISO-TP ONLY: normal addressing candidate, maximum Classical CAN DLC 8; actual DLC may be shorter. Data includes padding. No reassembly, text, DID or application-layer decoding. Original application layouts are preserved in source JSON; do not decode them at wire offsets. ";
CM_ SG_ 1890 FlowPadding5 "TRANSPORT_CANDIDATE: normal-addressing ISO-TP. PSA-RE bits 8.7-8.0. ";
CM_ SG_ 1890 FirstData6 "TRANSPORT_CANDIDATE: normal-addressing ISO-TP. PSA-RE bits 8.7-8.0. ";
CM_ SG_ 1890 UnknownData7 "TRANSPORT_CANDIDATE: normal-addressing ISO-TP. PSA-RE bits 8.7-8.0. ";
CM_ SG_ 1890 ConsecutiveData7 "TRANSPORT_CANDIDATE: normal-addressing ISO-TP. PSA-RE bits 8.7-8.0. ";
CM_ SG_ 1890 SingleData7 "TRANSPORT_CANDIDATE: normal-addressing ISO-TP. PSA-RE bits 8.7-8.0. ";
CM_ SG_ 1890 FlowPadding4 "TRANSPORT_CANDIDATE: normal-addressing ISO-TP. PSA-RE bits 7.7-7.0. ";
CM_ SG_ 1890 FirstData5 "TRANSPORT_CANDIDATE: normal-addressing ISO-TP. PSA-RE bits 7.7-7.0. ";
CM_ SG_ 1890 UnknownData6 "TRANSPORT_CANDIDATE: normal-addressing ISO-TP. PSA-RE bits 7.7-7.0. ";
CM_ SG_ 1890 ConsecutiveData6 "TRANSPORT_CANDIDATE: normal-addressing ISO-TP. PSA-RE bits 7.7-7.0. ";
CM_ SG_ 1890 SingleData6 "TRANSPORT_CANDIDATE: normal-addressing ISO-TP. PSA-RE bits 7.7-7.0. ";
CM_ SG_ 1890 FlowPadding3 "TRANSPORT_CANDIDATE: normal-addressing ISO-TP. PSA-RE bits 6.7-6.0. ";
CM_ SG_ 1890 FirstData4 "TRANSPORT_CANDIDATE: normal-addressing ISO-TP. PSA-RE bits 6.7-6.0. ";
CM_ SG_ 1890 UnknownData5 "TRANSPORT_CANDIDATE: normal-addressing ISO-TP. PSA-RE bits 6.7-6.0. ";
CM_ SG_ 1890 ConsecutiveData5 "TRANSPORT_CANDIDATE: normal-addressing ISO-TP. PSA-RE bits 6.7-6.0. ";
CM_ SG_ 1890 SingleData5 "TRANSPORT_CANDIDATE: normal-addressing ISO-TP. PSA-RE bits 6.7-6.0. ";
CM_ SG_ 1890 FlowPadding2 "TRANSPORT_CANDIDATE: normal-addressing ISO-TP. PSA-RE bits 5.7-5.0. ";
CM_ SG_ 1890 FirstData3 "TRANSPORT_CANDIDATE: normal-addressing ISO-TP. PSA-RE bits 5.7-5.0. ";
CM_ SG_ 1890 UnknownData4 "TRANSPORT_CANDIDATE: normal-addressing ISO-TP. PSA-RE bits 5.7-5.0. ";
CM_ SG_ 1890 ConsecutiveData4 "TRANSPORT_CANDIDATE: normal-addressing ISO-TP. PSA-RE bits 5.7-5.0. ";
CM_ SG_ 1890 SingleData4 "TRANSPORT_CANDIDATE: normal-addressing ISO-TP. PSA-RE bits 5.7-5.0. ";
CM_ SG_ 1890 FlowPadding1 "TRANSPORT_CANDIDATE: normal-addressing ISO-TP. PSA-RE bits 4.7-4.0. ";
CM_ SG_ 1890 FirstData2 "TRANSPORT_CANDIDATE: normal-addressing ISO-TP. PSA-RE bits 4.7-4.0. ";
CM_ SG_ 1890 UnknownData3 "TRANSPORT_CANDIDATE: normal-addressing ISO-TP. PSA-RE bits 4.7-4.0. ";
CM_ SG_ 1890 ConsecutiveData3 "TRANSPORT_CANDIDATE: normal-addressing ISO-TP. PSA-RE bits 4.7-4.0. ";
CM_ SG_ 1890 SingleData3 "TRANSPORT_CANDIDATE: normal-addressing ISO-TP. PSA-RE bits 4.7-4.0. ";
CM_ SG_ 1890 FirstData1 "TRANSPORT_CANDIDATE: normal-addressing ISO-TP. PSA-RE bits 3.7-3.0. ";
CM_ SG_ 1890 UnknownData2 "TRANSPORT_CANDIDATE: normal-addressing ISO-TP. PSA-RE bits 3.7-3.0. ";
CM_ SG_ 1890 ConsecutiveData2 "TRANSPORT_CANDIDATE: normal-addressing ISO-TP. PSA-RE bits 3.7-3.0. ";
CM_ SG_ 1890 SingleData2 "TRANSPORT_CANDIDATE: normal-addressing ISO-TP. PSA-RE bits 3.7-3.0. ";
CM_ SG_ 1890 SeparationTimeRaw "TRANSPORT_CANDIDATE: normal-addressing ISO-TP. PSA-RE bits 3.7-3.0. Raw STmin code; 0xF1..0xF9 are not milliseconds.";
CM_ SG_ 1890 UnknownData1 "TRANSPORT_CANDIDATE: normal-addressing ISO-TP. PSA-RE bits 2.7-2.0. ";
CM_ SG_ 1890 ConsecutiveData1 "TRANSPORT_CANDIDATE: normal-addressing ISO-TP. PSA-RE bits 2.7-2.0. ";
CM_ SG_ 1890 SingleData1 "TRANSPORT_CANDIDATE: normal-addressing ISO-TP. PSA-RE bits 2.7-2.0. ";
CM_ SG_ 1890 BlockSize "TRANSPORT_CANDIDATE: normal-addressing ISO-TP. PSA-RE bits 2.7-2.0. ";
CM_ SG_ 1890 UnknownPciLow "TRANSPORT_CANDIDATE: normal-addressing ISO-TP. PSA-RE bits 1.3-1.0. ";
CM_ SG_ 1890 FlowStatus "TRANSPORT_CANDIDATE: normal-addressing ISO-TP. PSA-RE bits 1.3-1.0. ";
CM_ SG_ 1890 ConsecutiveSequence "TRANSPORT_CANDIDATE: normal-addressing ISO-TP. PSA-RE bits 1.3-1.0. ";
CM_ SG_ 1890 FirstFrameLength "TRANSPORT_CANDIDATE: normal-addressing ISO-TP. PSA-RE bits 1.3-2.0. 12-bit declared PDU length; not a reassembled value.";
CM_ SG_ 1890 SingleFrameLength "TRANSPORT_CANDIDATE: normal-addressing ISO-TP. PSA-RE bits 1.3-1.0. Declared data length; not a validity check.";
CM_ SG_ 1890 IsoTpFrameType "TRANSPORT_CANDIDATE: normal-addressing ISO-TP. PSA-RE bits 1.7-1.4. PCI high nibble; normal addressing candidate.";
CM_ BO_ 1892 "DATABASE_CANDIDATE: physical interpretation unverified; capture/layout evidence reported separately. INFO-DIV CAN, 125000 bit/s; CAN ID 0x764. PSA-RE title: BTEL_DIAG_REQUEST. Diagnostic request addressed to the BTEL ECU. Source: https://github.com/prototux/PSA-RE/blob/67f7581e7622410efdbb29c7eda3b86982b9b450/buses/AEE2010.full/LS.INFO-DIV/764.yml. Source sender alternatives: ICSV,BSI,MDS; physical TX/gateway forwarding not verified. WIRE ISO-TP ONLY: normal addressing candidate, maximum Classical CAN DLC 8; actual DLC may be shorter. Data includes padding. No reassembly, text, DID or application-layer decoding. Original application layouts are preserved in source JSON; do not decode them at wire offsets. ";
CM_ SG_ 1892 FlowPadding5 "TRANSPORT_CANDIDATE: normal-addressing ISO-TP. PSA-RE bits 8.7-8.0. ";
CM_ SG_ 1892 FirstData6 "TRANSPORT_CANDIDATE: normal-addressing ISO-TP. PSA-RE bits 8.7-8.0. ";
CM_ SG_ 1892 UnknownData7 "TRANSPORT_CANDIDATE: normal-addressing ISO-TP. PSA-RE bits 8.7-8.0. ";
CM_ SG_ 1892 ConsecutiveData7 "TRANSPORT_CANDIDATE: normal-addressing ISO-TP. PSA-RE bits 8.7-8.0. ";
CM_ SG_ 1892 SingleData7 "TRANSPORT_CANDIDATE: normal-addressing ISO-TP. PSA-RE bits 8.7-8.0. ";
CM_ SG_ 1892 FlowPadding4 "TRANSPORT_CANDIDATE: normal-addressing ISO-TP. PSA-RE bits 7.7-7.0. ";
CM_ SG_ 1892 FirstData5 "TRANSPORT_CANDIDATE: normal-addressing ISO-TP. PSA-RE bits 7.7-7.0. ";
CM_ SG_ 1892 UnknownData6 "TRANSPORT_CANDIDATE: normal-addressing ISO-TP. PSA-RE bits 7.7-7.0. ";
CM_ SG_ 1892 ConsecutiveData6 "TRANSPORT_CANDIDATE: normal-addressing ISO-TP. PSA-RE bits 7.7-7.0. ";
CM_ SG_ 1892 SingleData6 "TRANSPORT_CANDIDATE: normal-addressing ISO-TP. PSA-RE bits 7.7-7.0. ";
CM_ SG_ 1892 FlowPadding3 "TRANSPORT_CANDIDATE: normal-addressing ISO-TP. PSA-RE bits 6.7-6.0. ";
CM_ SG_ 1892 FirstData4 "TRANSPORT_CANDIDATE: normal-addressing ISO-TP. PSA-RE bits 6.7-6.0. ";
CM_ SG_ 1892 UnknownData5 "TRANSPORT_CANDIDATE: normal-addressing ISO-TP. PSA-RE bits 6.7-6.0. ";
CM_ SG_ 1892 ConsecutiveData5 "TRANSPORT_CANDIDATE: normal-addressing ISO-TP. PSA-RE bits 6.7-6.0. ";
CM_ SG_ 1892 SingleData5 "TRANSPORT_CANDIDATE: normal-addressing ISO-TP. PSA-RE bits 6.7-6.0. ";
CM_ SG_ 1892 FlowPadding2 "TRANSPORT_CANDIDATE: normal-addressing ISO-TP. PSA-RE bits 5.7-5.0. ";
CM_ SG_ 1892 FirstData3 "TRANSPORT_CANDIDATE: normal-addressing ISO-TP. PSA-RE bits 5.7-5.0. ";
CM_ SG_ 1892 UnknownData4 "TRANSPORT_CANDIDATE: normal-addressing ISO-TP. PSA-RE bits 5.7-5.0. ";
CM_ SG_ 1892 ConsecutiveData4 "TRANSPORT_CANDIDATE: normal-addressing ISO-TP. PSA-RE bits 5.7-5.0. ";
CM_ SG_ 1892 SingleData4 "TRANSPORT_CANDIDATE: normal-addressing ISO-TP. PSA-RE bits 5.7-5.0. ";
CM_ SG_ 1892 FlowPadding1 "TRANSPORT_CANDIDATE: normal-addressing ISO-TP. PSA-RE bits 4.7-4.0. ";
CM_ SG_ 1892 FirstData2 "TRANSPORT_CANDIDATE: normal-addressing ISO-TP. PSA-RE bits 4.7-4.0. ";
CM_ SG_ 1892 UnknownData3 "TRANSPORT_CANDIDATE: normal-addressing ISO-TP. PSA-RE bits 4.7-4.0. ";
CM_ SG_ 1892 ConsecutiveData3 "TRANSPORT_CANDIDATE: normal-addressing ISO-TP. PSA-RE bits 4.7-4.0. ";
CM_ SG_ 1892 SingleData3 "TRANSPORT_CANDIDATE: normal-addressing ISO-TP. PSA-RE bits 4.7-4.0. ";
CM_ SG_ 1892 FirstData1 "TRANSPORT_CANDIDATE: normal-addressing ISO-TP. PSA-RE bits 3.7-3.0. ";
CM_ SG_ 1892 UnknownData2 "TRANSPORT_CANDIDATE: normal-addressing ISO-TP. PSA-RE bits 3.7-3.0. ";
CM_ SG_ 1892 ConsecutiveData2 "TRANSPORT_CANDIDATE: normal-addressing ISO-TP. PSA-RE bits 3.7-3.0. ";
CM_ SG_ 1892 SingleData2 "TRANSPORT_CANDIDATE: normal-addressing ISO-TP. PSA-RE bits 3.7-3.0. ";
CM_ SG_ 1892 SeparationTimeRaw "TRANSPORT_CANDIDATE: normal-addressing ISO-TP. PSA-RE bits 3.7-3.0. Raw STmin code; 0xF1..0xF9 are not milliseconds.";
CM_ SG_ 1892 UnknownData1 "TRANSPORT_CANDIDATE: normal-addressing ISO-TP. PSA-RE bits 2.7-2.0. ";
CM_ SG_ 1892 ConsecutiveData1 "TRANSPORT_CANDIDATE: normal-addressing ISO-TP. PSA-RE bits 2.7-2.0. ";
CM_ SG_ 1892 SingleData1 "TRANSPORT_CANDIDATE: normal-addressing ISO-TP. PSA-RE bits 2.7-2.0. ";
CM_ SG_ 1892 BlockSize "TRANSPORT_CANDIDATE: normal-addressing ISO-TP. PSA-RE bits 2.7-2.0. ";
CM_ SG_ 1892 UnknownPciLow "TRANSPORT_CANDIDATE: normal-addressing ISO-TP. PSA-RE bits 1.3-1.0. ";
CM_ SG_ 1892 FlowStatus "TRANSPORT_CANDIDATE: normal-addressing ISO-TP. PSA-RE bits 1.3-1.0. ";
CM_ SG_ 1892 ConsecutiveSequence "TRANSPORT_CANDIDATE: normal-addressing ISO-TP. PSA-RE bits 1.3-1.0. ";
CM_ SG_ 1892 FirstFrameLength "TRANSPORT_CANDIDATE: normal-addressing ISO-TP. PSA-RE bits 1.3-2.0. 12-bit declared PDU length; not a reassembled value.";
CM_ SG_ 1892 SingleFrameLength "TRANSPORT_CANDIDATE: normal-addressing ISO-TP. PSA-RE bits 1.3-1.0. Declared data length; not a validity check.";
CM_ SG_ 1892 IsoTpFrameType "TRANSPORT_CANDIDATE: normal-addressing ISO-TP. PSA-RE bits 1.7-1.4. PCI high nibble; normal addressing candidate.";
CM_ BO_ 1893 "DATABASE_CANDIDATE: physical interpretation unverified; capture/layout evidence reported separately. INFO-DIV CAN, 125000 bit/s; CAN ID 0x765. PSA-RE title: EMF_DIAG_REQUEST. Diagnostic request addressed to the EMF ECU. Source: https://github.com/prototux/PSA-RE/blob/67f7581e7622410efdbb29c7eda3b86982b9b450/buses/AEE2010.full/LS.INFO-DIV/765.yml. Source sender alternatives: BSI,MDS; physical TX/gateway forwarding not verified. WIRE ISO-TP ONLY: normal addressing candidate, maximum Classical CAN DLC 8; actual DLC may be shorter. Data includes padding. No reassembly, text, DID or application-layer decoding. Original application layouts are preserved in source JSON; do not decode them at wire offsets. ";
CM_ SG_ 1893 FlowPadding5 "TRANSPORT_CANDIDATE: normal-addressing ISO-TP. PSA-RE bits 8.7-8.0. ";
CM_ SG_ 1893 FirstData6 "TRANSPORT_CANDIDATE: normal-addressing ISO-TP. PSA-RE bits 8.7-8.0. ";
CM_ SG_ 1893 UnknownData7 "TRANSPORT_CANDIDATE: normal-addressing ISO-TP. PSA-RE bits 8.7-8.0. ";
CM_ SG_ 1893 ConsecutiveData7 "TRANSPORT_CANDIDATE: normal-addressing ISO-TP. PSA-RE bits 8.7-8.0. ";
CM_ SG_ 1893 SingleData7 "TRANSPORT_CANDIDATE: normal-addressing ISO-TP. PSA-RE bits 8.7-8.0. ";
CM_ SG_ 1893 FlowPadding4 "TRANSPORT_CANDIDATE: normal-addressing ISO-TP. PSA-RE bits 7.7-7.0. ";
CM_ SG_ 1893 FirstData5 "TRANSPORT_CANDIDATE: normal-addressing ISO-TP. PSA-RE bits 7.7-7.0. ";
CM_ SG_ 1893 UnknownData6 "TRANSPORT_CANDIDATE: normal-addressing ISO-TP. PSA-RE bits 7.7-7.0. ";
CM_ SG_ 1893 ConsecutiveData6 "TRANSPORT_CANDIDATE: normal-addressing ISO-TP. PSA-RE bits 7.7-7.0. ";
CM_ SG_ 1893 SingleData6 "TRANSPORT_CANDIDATE: normal-addressing ISO-TP. PSA-RE bits 7.7-7.0. ";
CM_ SG_ 1893 FlowPadding3 "TRANSPORT_CANDIDATE: normal-addressing ISO-TP. PSA-RE bits 6.7-6.0. ";
CM_ SG_ 1893 FirstData4 "TRANSPORT_CANDIDATE: normal-addressing ISO-TP. PSA-RE bits 6.7-6.0. ";
CM_ SG_ 1893 UnknownData5 "TRANSPORT_CANDIDATE: normal-addressing ISO-TP. PSA-RE bits 6.7-6.0. ";
CM_ SG_ 1893 ConsecutiveData5 "TRANSPORT_CANDIDATE: normal-addressing ISO-TP. PSA-RE bits 6.7-6.0. ";
CM_ SG_ 1893 SingleData5 "TRANSPORT_CANDIDATE: normal-addressing ISO-TP. PSA-RE bits 6.7-6.0. ";
CM_ SG_ 1893 FlowPadding2 "TRANSPORT_CANDIDATE: normal-addressing ISO-TP. PSA-RE bits 5.7-5.0. ";
CM_ SG_ 1893 FirstData3 "TRANSPORT_CANDIDATE: normal-addressing ISO-TP. PSA-RE bits 5.7-5.0. ";
CM_ SG_ 1893 UnknownData4 "TRANSPORT_CANDIDATE: normal-addressing ISO-TP. PSA-RE bits 5.7-5.0. ";
CM_ SG_ 1893 ConsecutiveData4 "TRANSPORT_CANDIDATE: normal-addressing ISO-TP. PSA-RE bits 5.7-5.0. ";
CM_ SG_ 1893 SingleData4 "TRANSPORT_CANDIDATE: normal-addressing ISO-TP. PSA-RE bits 5.7-5.0. ";
CM_ SG_ 1893 FlowPadding1 "TRANSPORT_CANDIDATE: normal-addressing ISO-TP. PSA-RE bits 4.7-4.0. ";
CM_ SG_ 1893 FirstData2 "TRANSPORT_CANDIDATE: normal-addressing ISO-TP. PSA-RE bits 4.7-4.0. ";
CM_ SG_ 1893 UnknownData3 "TRANSPORT_CANDIDATE: normal-addressing ISO-TP. PSA-RE bits 4.7-4.0. ";
CM_ SG_ 1893 ConsecutiveData3 "TRANSPORT_CANDIDATE: normal-addressing ISO-TP. PSA-RE bits 4.7-4.0. ";
CM_ SG_ 1893 SingleData3 "TRANSPORT_CANDIDATE: normal-addressing ISO-TP. PSA-RE bits 4.7-4.0. ";
CM_ SG_ 1893 FirstData1 "TRANSPORT_CANDIDATE: normal-addressing ISO-TP. PSA-RE bits 3.7-3.0. ";
CM_ SG_ 1893 UnknownData2 "TRANSPORT_CANDIDATE: normal-addressing ISO-TP. PSA-RE bits 3.7-3.0. ";
CM_ SG_ 1893 ConsecutiveData2 "TRANSPORT_CANDIDATE: normal-addressing ISO-TP. PSA-RE bits 3.7-3.0. ";
CM_ SG_ 1893 SingleData2 "TRANSPORT_CANDIDATE: normal-addressing ISO-TP. PSA-RE bits 3.7-3.0. ";
CM_ SG_ 1893 SeparationTimeRaw "TRANSPORT_CANDIDATE: normal-addressing ISO-TP. PSA-RE bits 3.7-3.0. Raw STmin code; 0xF1..0xF9 are not milliseconds.";
CM_ SG_ 1893 UnknownData1 "TRANSPORT_CANDIDATE: normal-addressing ISO-TP. PSA-RE bits 2.7-2.0. ";
CM_ SG_ 1893 ConsecutiveData1 "TRANSPORT_CANDIDATE: normal-addressing ISO-TP. PSA-RE bits 2.7-2.0. ";
CM_ SG_ 1893 SingleData1 "TRANSPORT_CANDIDATE: normal-addressing ISO-TP. PSA-RE bits 2.7-2.0. ";
CM_ SG_ 1893 BlockSize "TRANSPORT_CANDIDATE: normal-addressing ISO-TP. PSA-RE bits 2.7-2.0. ";
CM_ SG_ 1893 UnknownPciLow "TRANSPORT_CANDIDATE: normal-addressing ISO-TP. PSA-RE bits 1.3-1.0. ";
CM_ SG_ 1893 FlowStatus "TRANSPORT_CANDIDATE: normal-addressing ISO-TP. PSA-RE bits 1.3-1.0. ";
CM_ SG_ 1893 ConsecutiveSequence "TRANSPORT_CANDIDATE: normal-addressing ISO-TP. PSA-RE bits 1.3-1.0. ";
CM_ SG_ 1893 FirstFrameLength "TRANSPORT_CANDIDATE: normal-addressing ISO-TP. PSA-RE bits 1.3-2.0. 12-bit declared PDU length; not a reassembled value.";
CM_ SG_ 1893 SingleFrameLength "TRANSPORT_CANDIDATE: normal-addressing ISO-TP. PSA-RE bits 1.3-1.0. Declared data length; not a validity check.";
CM_ SG_ 1893 IsoTpFrameType "TRANSPORT_CANDIDATE: normal-addressing ISO-TP. PSA-RE bits 1.7-1.4. PCI high nibble; normal addressing candidate.";
VAL_ 1862 FlowStatus 0 "ContinueToSend" 1 "Wait" 2 "Overflow" ;
VAL_ 1862 IsoTpFrameType 0 "SingleFrame" 1 "FirstFrame" 2 "ConsecutiveFrame" 3 "FlowControl" ;
VAL_ 1863 FlowStatus 0 "ContinueToSend" 1 "Wait" 2 "Overflow" ;
VAL_ 1863 IsoTpFrameType 0 "SingleFrame" 1 "FirstFrame" 2 "ConsecutiveFrame" 3 "FlowControl" ;
VAL_ 1864 FlowStatus 0 "ContinueToSend" 1 "Wait" 2 "Overflow" ;
VAL_ 1864 IsoTpFrameType 0 "SingleFrame" 1 "FirstFrame" 2 "ConsecutiveFrame" 3 "FlowControl" ;
VAL_ 1865 FlowStatus 0 "ContinueToSend" 1 "Wait" 2 "Overflow" ;
VAL_ 1865 IsoTpFrameType 0 "SingleFrame" 1 "FirstFrame" 2 "ConsecutiveFrame" 3 "FlowControl" ;
VAL_ 1866 FlowStatus 0 "ContinueToSend" 1 "Wait" 2 "Overflow" ;
VAL_ 1866 IsoTpFrameType 0 "SingleFrame" 1 "FirstFrame" 2 "ConsecutiveFrame" 3 "FlowControl" ;
VAL_ 1867 FlowStatus 0 "ContinueToSend" 1 "Wait" 2 "Overflow" ;
VAL_ 1867 IsoTpFrameType 0 "SingleFrame" 1 "FirstFrame" 2 "ConsecutiveFrame" 3 "FlowControl" ;
VAL_ 1868 FlowStatus 0 "ContinueToSend" 1 "Wait" 2 "Overflow" ;
VAL_ 1868 IsoTpFrameType 0 "SingleFrame" 1 "FirstFrame" 2 "ConsecutiveFrame" 3 "FlowControl" ;
VAL_ 1871 FlowStatus 0 "ContinueToSend" 1 "Wait" 2 "Overflow" ;
VAL_ 1871 IsoTpFrameType 0 "SingleFrame" 1 "FirstFrame" 2 "ConsecutiveFrame" 3 "FlowControl" ;
VAL_ 1875 FlowStatus 0 "ContinueToSend" 1 "Wait" 2 "Overflow" ;
VAL_ 1875 IsoTpFrameType 0 "SingleFrame" 1 "FirstFrame" 2 "ConsecutiveFrame" 3 "FlowControl" ;
VAL_ 1881 FlowStatus 0 "ContinueToSend" 1 "Wait" 2 "Overflow" ;
VAL_ 1881 IsoTpFrameType 0 "SingleFrame" 1 "FirstFrame" 2 "ConsecutiveFrame" 3 "FlowControl" ;
VAL_ 1883 FlowStatus 0 "ContinueToSend" 1 "Wait" 2 "Overflow" ;
VAL_ 1883 IsoTpFrameType 0 "SingleFrame" 1 "FirstFrame" 2 "ConsecutiveFrame" 3 "FlowControl" ;
VAL_ 1884 FlowStatus 0 "ContinueToSend" 1 "Wait" 2 "Overflow" ;
VAL_ 1884 IsoTpFrameType 0 "SingleFrame" 1 "FirstFrame" 2 "ConsecutiveFrame" 3 "FlowControl" ;
VAL_ 1885 FlowStatus 0 "ContinueToSend" 1 "Wait" 2 "Overflow" ;
VAL_ 1885 IsoTpFrameType 0 "SingleFrame" 1 "FirstFrame" 2 "ConsecutiveFrame" 3 "FlowControl" ;
VAL_ 1886 FlowStatus 0 "ContinueToSend" 1 "Wait" 2 "Overflow" ;
VAL_ 1886 IsoTpFrameType 0 "SingleFrame" 1 "FirstFrame" 2 "ConsecutiveFrame" 3 "FlowControl" ;
VAL_ 1887 FlowStatus 0 "ContinueToSend" 1 "Wait" 2 "Overflow" ;
VAL_ 1887 IsoTpFrameType 0 "SingleFrame" 1 "FirstFrame" 2 "ConsecutiveFrame" 3 "FlowControl" ;
VAL_ 1888 FlowStatus 0 "ContinueToSend" 1 "Wait" 2 "Overflow" ;
VAL_ 1888 IsoTpFrameType 0 "SingleFrame" 1 "FirstFrame" 2 "ConsecutiveFrame" 3 "FlowControl" ;
VAL_ 1889 FlowStatus 0 "ContinueToSend" 1 "Wait" 2 "Overflow" ;
VAL_ 1889 IsoTpFrameType 0 "SingleFrame" 1 "FirstFrame" 2 "ConsecutiveFrame" 3 "FlowControl" ;
VAL_ 1890 FlowStatus 0 "ContinueToSend" 1 "Wait" 2 "Overflow" ;
VAL_ 1890 IsoTpFrameType 0 "SingleFrame" 1 "FirstFrame" 2 "ConsecutiveFrame" 3 "FlowControl" ;
VAL_ 1892 FlowStatus 0 "ContinueToSend" 1 "Wait" 2 "Overflow" ;
VAL_ 1892 IsoTpFrameType 0 "SingleFrame" 1 "FirstFrame" 2 "ConsecutiveFrame" 3 "FlowControl" ;
VAL_ 1893 FlowStatus 0 "ContinueToSend" 1 "Wait" 2 "Overflow" ;
VAL_ 1893 IsoTpFrameType 0 "SingleFrame" 1 "FirstFrame" 2 "ConsecutiveFrame" 3 "FlowControl" ;
SG_MUL_VAL_ 1862 SingleFrameLength IsoTpFrameType 0-0;
SG_MUL_VAL_ 1862 FirstFrameLength IsoTpFrameType 1-1;
SG_MUL_VAL_ 1862 ConsecutiveSequence IsoTpFrameType 2-2;
SG_MUL_VAL_ 1862 FlowStatus IsoTpFrameType 3-3;
SG_MUL_VAL_ 1862 UnknownPciLow IsoTpFrameType 4-15;
SG_MUL_VAL_ 1862 BlockSize IsoTpFrameType 3-3;
SG_MUL_VAL_ 1862 SingleData1 IsoTpFrameType 0-0;
SG_MUL_VAL_ 1862 ConsecutiveData1 IsoTpFrameType 2-2;
SG_MUL_VAL_ 1862 UnknownData1 IsoTpFrameType 4-15;
SG_MUL_VAL_ 1862 SeparationTimeRaw IsoTpFrameType 3-3;
SG_MUL_VAL_ 1862 SingleData2 IsoTpFrameType 0-0;
SG_MUL_VAL_ 1862 ConsecutiveData2 IsoTpFrameType 2-2;
SG_MUL_VAL_ 1862 UnknownData2 IsoTpFrameType 4-15;
SG_MUL_VAL_ 1862 FirstData1 IsoTpFrameType 1-1;
SG_MUL_VAL_ 1862 SingleData3 IsoTpFrameType 0-0;
SG_MUL_VAL_ 1862 ConsecutiveData3 IsoTpFrameType 2-2;
SG_MUL_VAL_ 1862 UnknownData3 IsoTpFrameType 4-15;
SG_MUL_VAL_ 1862 FirstData2 IsoTpFrameType 1-1;
SG_MUL_VAL_ 1862 FlowPadding1 IsoTpFrameType 3-3;
SG_MUL_VAL_ 1862 SingleData4 IsoTpFrameType 0-0;
SG_MUL_VAL_ 1862 ConsecutiveData4 IsoTpFrameType 2-2;
SG_MUL_VAL_ 1862 UnknownData4 IsoTpFrameType 4-15;
SG_MUL_VAL_ 1862 FirstData3 IsoTpFrameType 1-1;
SG_MUL_VAL_ 1862 FlowPadding2 IsoTpFrameType 3-3;
SG_MUL_VAL_ 1862 SingleData5 IsoTpFrameType 0-0;
SG_MUL_VAL_ 1862 ConsecutiveData5 IsoTpFrameType 2-2;
SG_MUL_VAL_ 1862 UnknownData5 IsoTpFrameType 4-15;
SG_MUL_VAL_ 1862 FirstData4 IsoTpFrameType 1-1;
SG_MUL_VAL_ 1862 FlowPadding3 IsoTpFrameType 3-3;
SG_MUL_VAL_ 1862 SingleData6 IsoTpFrameType 0-0;
SG_MUL_VAL_ 1862 ConsecutiveData6 IsoTpFrameType 2-2;
SG_MUL_VAL_ 1862 UnknownData6 IsoTpFrameType 4-15;
SG_MUL_VAL_ 1862 FirstData5 IsoTpFrameType 1-1;
SG_MUL_VAL_ 1862 FlowPadding4 IsoTpFrameType 3-3;
SG_MUL_VAL_ 1862 SingleData7 IsoTpFrameType 0-0;
SG_MUL_VAL_ 1862 ConsecutiveData7 IsoTpFrameType 2-2;
SG_MUL_VAL_ 1862 UnknownData7 IsoTpFrameType 4-15;
SG_MUL_VAL_ 1862 FirstData6 IsoTpFrameType 1-1;
SG_MUL_VAL_ 1862 FlowPadding5 IsoTpFrameType 3-3;
SG_MUL_VAL_ 1863 SingleFrameLength IsoTpFrameType 0-0;
SG_MUL_VAL_ 1863 FirstFrameLength IsoTpFrameType 1-1;
SG_MUL_VAL_ 1863 ConsecutiveSequence IsoTpFrameType 2-2;
SG_MUL_VAL_ 1863 FlowStatus IsoTpFrameType 3-3;
SG_MUL_VAL_ 1863 UnknownPciLow IsoTpFrameType 4-15;
SG_MUL_VAL_ 1863 BlockSize IsoTpFrameType 3-3;
SG_MUL_VAL_ 1863 SingleData1 IsoTpFrameType 0-0;
SG_MUL_VAL_ 1863 ConsecutiveData1 IsoTpFrameType 2-2;
SG_MUL_VAL_ 1863 UnknownData1 IsoTpFrameType 4-15;
SG_MUL_VAL_ 1863 SeparationTimeRaw IsoTpFrameType 3-3;
SG_MUL_VAL_ 1863 SingleData2 IsoTpFrameType 0-0;
SG_MUL_VAL_ 1863 ConsecutiveData2 IsoTpFrameType 2-2;
SG_MUL_VAL_ 1863 UnknownData2 IsoTpFrameType 4-15;
SG_MUL_VAL_ 1863 FirstData1 IsoTpFrameType 1-1;
SG_MUL_VAL_ 1863 SingleData3 IsoTpFrameType 0-0;
SG_MUL_VAL_ 1863 ConsecutiveData3 IsoTpFrameType 2-2;
SG_MUL_VAL_ 1863 UnknownData3 IsoTpFrameType 4-15;
SG_MUL_VAL_ 1863 FirstData2 IsoTpFrameType 1-1;
SG_MUL_VAL_ 1863 FlowPadding1 IsoTpFrameType 3-3;
SG_MUL_VAL_ 1863 SingleData4 IsoTpFrameType 0-0;
SG_MUL_VAL_ 1863 ConsecutiveData4 IsoTpFrameType 2-2;
SG_MUL_VAL_ 1863 UnknownData4 IsoTpFrameType 4-15;
SG_MUL_VAL_ 1863 FirstData3 IsoTpFrameType 1-1;
SG_MUL_VAL_ 1863 FlowPadding2 IsoTpFrameType 3-3;
SG_MUL_VAL_ 1863 SingleData5 IsoTpFrameType 0-0;
SG_MUL_VAL_ 1863 ConsecutiveData5 IsoTpFrameType 2-2;
SG_MUL_VAL_ 1863 UnknownData5 IsoTpFrameType 4-15;
SG_MUL_VAL_ 1863 FirstData4 IsoTpFrameType 1-1;
SG_MUL_VAL_ 1863 FlowPadding3 IsoTpFrameType 3-3;
SG_MUL_VAL_ 1863 SingleData6 IsoTpFrameType 0-0;
SG_MUL_VAL_ 1863 ConsecutiveData6 IsoTpFrameType 2-2;
SG_MUL_VAL_ 1863 UnknownData6 IsoTpFrameType 4-15;
SG_MUL_VAL_ 1863 FirstData5 IsoTpFrameType 1-1;
SG_MUL_VAL_ 1863 FlowPadding4 IsoTpFrameType 3-3;
SG_MUL_VAL_ 1863 SingleData7 IsoTpFrameType 0-0;
SG_MUL_VAL_ 1863 ConsecutiveData7 IsoTpFrameType 2-2;
SG_MUL_VAL_ 1863 UnknownData7 IsoTpFrameType 4-15;
SG_MUL_VAL_ 1863 FirstData6 IsoTpFrameType 1-1;
SG_MUL_VAL_ 1863 FlowPadding5 IsoTpFrameType 3-3;
SG_MUL_VAL_ 1864 SingleFrameLength IsoTpFrameType 0-0;
SG_MUL_VAL_ 1864 FirstFrameLength IsoTpFrameType 1-1;
SG_MUL_VAL_ 1864 ConsecutiveSequence IsoTpFrameType 2-2;
SG_MUL_VAL_ 1864 FlowStatus IsoTpFrameType 3-3;
SG_MUL_VAL_ 1864 UnknownPciLow IsoTpFrameType 4-15;
SG_MUL_VAL_ 1864 BlockSize IsoTpFrameType 3-3;
SG_MUL_VAL_ 1864 SingleData1 IsoTpFrameType 0-0;
SG_MUL_VAL_ 1864 ConsecutiveData1 IsoTpFrameType 2-2;
SG_MUL_VAL_ 1864 UnknownData1 IsoTpFrameType 4-15;
SG_MUL_VAL_ 1864 SeparationTimeRaw IsoTpFrameType 3-3;
SG_MUL_VAL_ 1864 SingleData2 IsoTpFrameType 0-0;
SG_MUL_VAL_ 1864 ConsecutiveData2 IsoTpFrameType 2-2;
SG_MUL_VAL_ 1864 UnknownData2 IsoTpFrameType 4-15;
SG_MUL_VAL_ 1864 FirstData1 IsoTpFrameType 1-1;
SG_MUL_VAL_ 1864 SingleData3 IsoTpFrameType 0-0;
SG_MUL_VAL_ 1864 ConsecutiveData3 IsoTpFrameType 2-2;
SG_MUL_VAL_ 1864 UnknownData3 IsoTpFrameType 4-15;
SG_MUL_VAL_ 1864 FirstData2 IsoTpFrameType 1-1;
SG_MUL_VAL_ 1864 FlowPadding1 IsoTpFrameType 3-3;
SG_MUL_VAL_ 1864 SingleData4 IsoTpFrameType 0-0;
SG_MUL_VAL_ 1864 ConsecutiveData4 IsoTpFrameType 2-2;
SG_MUL_VAL_ 1864 UnknownData4 IsoTpFrameType 4-15;
SG_MUL_VAL_ 1864 FirstData3 IsoTpFrameType 1-1;
SG_MUL_VAL_ 1864 FlowPadding2 IsoTpFrameType 3-3;
SG_MUL_VAL_ 1864 SingleData5 IsoTpFrameType 0-0;
SG_MUL_VAL_ 1864 ConsecutiveData5 IsoTpFrameType 2-2;
SG_MUL_VAL_ 1864 UnknownData5 IsoTpFrameType 4-15;
SG_MUL_VAL_ 1864 FirstData4 IsoTpFrameType 1-1;
SG_MUL_VAL_ 1864 FlowPadding3 IsoTpFrameType 3-3;
SG_MUL_VAL_ 1864 SingleData6 IsoTpFrameType 0-0;
SG_MUL_VAL_ 1864 ConsecutiveData6 IsoTpFrameType 2-2;
SG_MUL_VAL_ 1864 UnknownData6 IsoTpFrameType 4-15;
SG_MUL_VAL_ 1864 FirstData5 IsoTpFrameType 1-1;
SG_MUL_VAL_ 1864 FlowPadding4 IsoTpFrameType 3-3;
SG_MUL_VAL_ 1864 SingleData7 IsoTpFrameType 0-0;
SG_MUL_VAL_ 1864 ConsecutiveData7 IsoTpFrameType 2-2;
SG_MUL_VAL_ 1864 UnknownData7 IsoTpFrameType 4-15;
SG_MUL_VAL_ 1864 FirstData6 IsoTpFrameType 1-1;
SG_MUL_VAL_ 1864 FlowPadding5 IsoTpFrameType 3-3;
SG_MUL_VAL_ 1865 SingleFrameLength IsoTpFrameType 0-0;
SG_MUL_VAL_ 1865 FirstFrameLength IsoTpFrameType 1-1;
SG_MUL_VAL_ 1865 ConsecutiveSequence IsoTpFrameType 2-2;
SG_MUL_VAL_ 1865 FlowStatus IsoTpFrameType 3-3;
SG_MUL_VAL_ 1865 UnknownPciLow IsoTpFrameType 4-15;
SG_MUL_VAL_ 1865 BlockSize IsoTpFrameType 3-3;
SG_MUL_VAL_ 1865 SingleData1 IsoTpFrameType 0-0;
SG_MUL_VAL_ 1865 ConsecutiveData1 IsoTpFrameType 2-2;
SG_MUL_VAL_ 1865 UnknownData1 IsoTpFrameType 4-15;
SG_MUL_VAL_ 1865 SeparationTimeRaw IsoTpFrameType 3-3;
SG_MUL_VAL_ 1865 SingleData2 IsoTpFrameType 0-0;
SG_MUL_VAL_ 1865 ConsecutiveData2 IsoTpFrameType 2-2;
SG_MUL_VAL_ 1865 UnknownData2 IsoTpFrameType 4-15;
SG_MUL_VAL_ 1865 FirstData1 IsoTpFrameType 1-1;
SG_MUL_VAL_ 1865 SingleData3 IsoTpFrameType 0-0;
SG_MUL_VAL_ 1865 ConsecutiveData3 IsoTpFrameType 2-2;
SG_MUL_VAL_ 1865 UnknownData3 IsoTpFrameType 4-15;
SG_MUL_VAL_ 1865 FirstData2 IsoTpFrameType 1-1;
SG_MUL_VAL_ 1865 FlowPadding1 IsoTpFrameType 3-3;
SG_MUL_VAL_ 1865 SingleData4 IsoTpFrameType 0-0;
SG_MUL_VAL_ 1865 ConsecutiveData4 IsoTpFrameType 2-2;
SG_MUL_VAL_ 1865 UnknownData4 IsoTpFrameType 4-15;
SG_MUL_VAL_ 1865 FirstData3 IsoTpFrameType 1-1;
SG_MUL_VAL_ 1865 FlowPadding2 IsoTpFrameType 3-3;
SG_MUL_VAL_ 1865 SingleData5 IsoTpFrameType 0-0;
SG_MUL_VAL_ 1865 ConsecutiveData5 IsoTpFrameType 2-2;
SG_MUL_VAL_ 1865 UnknownData5 IsoTpFrameType 4-15;
SG_MUL_VAL_ 1865 FirstData4 IsoTpFrameType 1-1;
SG_MUL_VAL_ 1865 FlowPadding3 IsoTpFrameType 3-3;
SG_MUL_VAL_ 1865 SingleData6 IsoTpFrameType 0-0;
SG_MUL_VAL_ 1865 ConsecutiveData6 IsoTpFrameType 2-2;
SG_MUL_VAL_ 1865 UnknownData6 IsoTpFrameType 4-15;
SG_MUL_VAL_ 1865 FirstData5 IsoTpFrameType 1-1;
SG_MUL_VAL_ 1865 FlowPadding4 IsoTpFrameType 3-3;
SG_MUL_VAL_ 1865 SingleData7 IsoTpFrameType 0-0;
SG_MUL_VAL_ 1865 ConsecutiveData7 IsoTpFrameType 2-2;
SG_MUL_VAL_ 1865 UnknownData7 IsoTpFrameType 4-15;
SG_MUL_VAL_ 1865 FirstData6 IsoTpFrameType 1-1;
SG_MUL_VAL_ 1865 FlowPadding5 IsoTpFrameType 3-3;
SG_MUL_VAL_ 1866 SingleFrameLength IsoTpFrameType 0-0;
SG_MUL_VAL_ 1866 FirstFrameLength IsoTpFrameType 1-1;
SG_MUL_VAL_ 1866 ConsecutiveSequence IsoTpFrameType 2-2;
SG_MUL_VAL_ 1866 FlowStatus IsoTpFrameType 3-3;
SG_MUL_VAL_ 1866 UnknownPciLow IsoTpFrameType 4-15;
SG_MUL_VAL_ 1866 BlockSize IsoTpFrameType 3-3;
SG_MUL_VAL_ 1866 SingleData1 IsoTpFrameType 0-0;
SG_MUL_VAL_ 1866 ConsecutiveData1 IsoTpFrameType 2-2;
SG_MUL_VAL_ 1866 UnknownData1 IsoTpFrameType 4-15;
SG_MUL_VAL_ 1866 SeparationTimeRaw IsoTpFrameType 3-3;
SG_MUL_VAL_ 1866 SingleData2 IsoTpFrameType 0-0;
SG_MUL_VAL_ 1866 ConsecutiveData2 IsoTpFrameType 2-2;
SG_MUL_VAL_ 1866 UnknownData2 IsoTpFrameType 4-15;
SG_MUL_VAL_ 1866 FirstData1 IsoTpFrameType 1-1;
SG_MUL_VAL_ 1866 SingleData3 IsoTpFrameType 0-0;
SG_MUL_VAL_ 1866 ConsecutiveData3 IsoTpFrameType 2-2;
SG_MUL_VAL_ 1866 UnknownData3 IsoTpFrameType 4-15;
SG_MUL_VAL_ 1866 FirstData2 IsoTpFrameType 1-1;
SG_MUL_VAL_ 1866 FlowPadding1 IsoTpFrameType 3-3;
SG_MUL_VAL_ 1866 SingleData4 IsoTpFrameType 0-0;
SG_MUL_VAL_ 1866 ConsecutiveData4 IsoTpFrameType 2-2;
SG_MUL_VAL_ 1866 UnknownData4 IsoTpFrameType 4-15;
SG_MUL_VAL_ 1866 FirstData3 IsoTpFrameType 1-1;
SG_MUL_VAL_ 1866 FlowPadding2 IsoTpFrameType 3-3;
SG_MUL_VAL_ 1866 SingleData5 IsoTpFrameType 0-0;
SG_MUL_VAL_ 1866 ConsecutiveData5 IsoTpFrameType 2-2;
SG_MUL_VAL_ 1866 UnknownData5 IsoTpFrameType 4-15;
SG_MUL_VAL_ 1866 FirstData4 IsoTpFrameType 1-1;
SG_MUL_VAL_ 1866 FlowPadding3 IsoTpFrameType 3-3;
SG_MUL_VAL_ 1866 SingleData6 IsoTpFrameType 0-0;
SG_MUL_VAL_ 1866 ConsecutiveData6 IsoTpFrameType 2-2;
SG_MUL_VAL_ 1866 UnknownData6 IsoTpFrameType 4-15;
SG_MUL_VAL_ 1866 FirstData5 IsoTpFrameType 1-1;
SG_MUL_VAL_ 1866 FlowPadding4 IsoTpFrameType 3-3;
SG_MUL_VAL_ 1866 SingleData7 IsoTpFrameType 0-0;
SG_MUL_VAL_ 1866 ConsecutiveData7 IsoTpFrameType 2-2;
SG_MUL_VAL_ 1866 UnknownData7 IsoTpFrameType 4-15;
SG_MUL_VAL_ 1866 FirstData6 IsoTpFrameType 1-1;
SG_MUL_VAL_ 1866 FlowPadding5 IsoTpFrameType 3-3;
SG_MUL_VAL_ 1867 SingleFrameLength IsoTpFrameType 0-0;
SG_MUL_VAL_ 1867 FirstFrameLength IsoTpFrameType 1-1;
SG_MUL_VAL_ 1867 ConsecutiveSequence IsoTpFrameType 2-2;
SG_MUL_VAL_ 1867 FlowStatus IsoTpFrameType 3-3;
SG_MUL_VAL_ 1867 UnknownPciLow IsoTpFrameType 4-15;
SG_MUL_VAL_ 1867 BlockSize IsoTpFrameType 3-3;
SG_MUL_VAL_ 1867 SingleData1 IsoTpFrameType 0-0;
SG_MUL_VAL_ 1867 ConsecutiveData1 IsoTpFrameType 2-2;
SG_MUL_VAL_ 1867 UnknownData1 IsoTpFrameType 4-15;
SG_MUL_VAL_ 1867 SeparationTimeRaw IsoTpFrameType 3-3;
SG_MUL_VAL_ 1867 SingleData2 IsoTpFrameType 0-0;
SG_MUL_VAL_ 1867 ConsecutiveData2 IsoTpFrameType 2-2;
SG_MUL_VAL_ 1867 UnknownData2 IsoTpFrameType 4-15;
SG_MUL_VAL_ 1867 FirstData1 IsoTpFrameType 1-1;
SG_MUL_VAL_ 1867 SingleData3 IsoTpFrameType 0-0;
SG_MUL_VAL_ 1867 ConsecutiveData3 IsoTpFrameType 2-2;
SG_MUL_VAL_ 1867 UnknownData3 IsoTpFrameType 4-15;
SG_MUL_VAL_ 1867 FirstData2 IsoTpFrameType 1-1;
SG_MUL_VAL_ 1867 FlowPadding1 IsoTpFrameType 3-3;
SG_MUL_VAL_ 1867 SingleData4 IsoTpFrameType 0-0;
SG_MUL_VAL_ 1867 ConsecutiveData4 IsoTpFrameType 2-2;
SG_MUL_VAL_ 1867 UnknownData4 IsoTpFrameType 4-15;
SG_MUL_VAL_ 1867 FirstData3 IsoTpFrameType 1-1;
SG_MUL_VAL_ 1867 FlowPadding2 IsoTpFrameType 3-3;
SG_MUL_VAL_ 1867 SingleData5 IsoTpFrameType 0-0;
SG_MUL_VAL_ 1867 ConsecutiveData5 IsoTpFrameType 2-2;
SG_MUL_VAL_ 1867 UnknownData5 IsoTpFrameType 4-15;
SG_MUL_VAL_ 1867 FirstData4 IsoTpFrameType 1-1;
SG_MUL_VAL_ 1867 FlowPadding3 IsoTpFrameType 3-3;
SG_MUL_VAL_ 1867 SingleData6 IsoTpFrameType 0-0;
SG_MUL_VAL_ 1867 ConsecutiveData6 IsoTpFrameType 2-2;
SG_MUL_VAL_ 1867 UnknownData6 IsoTpFrameType 4-15;
SG_MUL_VAL_ 1867 FirstData5 IsoTpFrameType 1-1;
SG_MUL_VAL_ 1867 FlowPadding4 IsoTpFrameType 3-3;
SG_MUL_VAL_ 1867 SingleData7 IsoTpFrameType 0-0;
SG_MUL_VAL_ 1867 ConsecutiveData7 IsoTpFrameType 2-2;
SG_MUL_VAL_ 1867 UnknownData7 IsoTpFrameType 4-15;
SG_MUL_VAL_ 1867 FirstData6 IsoTpFrameType 1-1;
SG_MUL_VAL_ 1867 FlowPadding5 IsoTpFrameType 3-3;
SG_MUL_VAL_ 1868 SingleFrameLength IsoTpFrameType 0-0;
SG_MUL_VAL_ 1868 FirstFrameLength IsoTpFrameType 1-1;
SG_MUL_VAL_ 1868 ConsecutiveSequence IsoTpFrameType 2-2;
SG_MUL_VAL_ 1868 FlowStatus IsoTpFrameType 3-3;
SG_MUL_VAL_ 1868 UnknownPciLow IsoTpFrameType 4-15;
SG_MUL_VAL_ 1868 BlockSize IsoTpFrameType 3-3;
SG_MUL_VAL_ 1868 SingleData1 IsoTpFrameType 0-0;
SG_MUL_VAL_ 1868 ConsecutiveData1 IsoTpFrameType 2-2;
SG_MUL_VAL_ 1868 UnknownData1 IsoTpFrameType 4-15;
SG_MUL_VAL_ 1868 SeparationTimeRaw IsoTpFrameType 3-3;
SG_MUL_VAL_ 1868 SingleData2 IsoTpFrameType 0-0;
SG_MUL_VAL_ 1868 ConsecutiveData2 IsoTpFrameType 2-2;
SG_MUL_VAL_ 1868 UnknownData2 IsoTpFrameType 4-15;
SG_MUL_VAL_ 1868 FirstData1 IsoTpFrameType 1-1;
SG_MUL_VAL_ 1868 SingleData3 IsoTpFrameType 0-0;
SG_MUL_VAL_ 1868 ConsecutiveData3 IsoTpFrameType 2-2;
SG_MUL_VAL_ 1868 UnknownData3 IsoTpFrameType 4-15;
SG_MUL_VAL_ 1868 FirstData2 IsoTpFrameType 1-1;
SG_MUL_VAL_ 1868 FlowPadding1 IsoTpFrameType 3-3;
SG_MUL_VAL_ 1868 SingleData4 IsoTpFrameType 0-0;
SG_MUL_VAL_ 1868 ConsecutiveData4 IsoTpFrameType 2-2;
SG_MUL_VAL_ 1868 UnknownData4 IsoTpFrameType 4-15;
SG_MUL_VAL_ 1868 FirstData3 IsoTpFrameType 1-1;
SG_MUL_VAL_ 1868 FlowPadding2 IsoTpFrameType 3-3;
SG_MUL_VAL_ 1868 SingleData5 IsoTpFrameType 0-0;
SG_MUL_VAL_ 1868 ConsecutiveData5 IsoTpFrameType 2-2;
SG_MUL_VAL_ 1868 UnknownData5 IsoTpFrameType 4-15;
SG_MUL_VAL_ 1868 FirstData4 IsoTpFrameType 1-1;
SG_MUL_VAL_ 1868 FlowPadding3 IsoTpFrameType 3-3;
SG_MUL_VAL_ 1868 SingleData6 IsoTpFrameType 0-0;
SG_MUL_VAL_ 1868 ConsecutiveData6 IsoTpFrameType 2-2;
SG_MUL_VAL_ 1868 UnknownData6 IsoTpFrameType 4-15;
SG_MUL_VAL_ 1868 FirstData5 IsoTpFrameType 1-1;
SG_MUL_VAL_ 1868 FlowPadding4 IsoTpFrameType 3-3;
SG_MUL_VAL_ 1868 SingleData7 IsoTpFrameType 0-0;
SG_MUL_VAL_ 1868 ConsecutiveData7 IsoTpFrameType 2-2;
SG_MUL_VAL_ 1868 UnknownData7 IsoTpFrameType 4-15;
SG_MUL_VAL_ 1868 FirstData6 IsoTpFrameType 1-1;
SG_MUL_VAL_ 1868 FlowPadding5 IsoTpFrameType 3-3;
SG_MUL_VAL_ 1871 SingleFrameLength IsoTpFrameType 0-0;
SG_MUL_VAL_ 1871 FirstFrameLength IsoTpFrameType 1-1;
SG_MUL_VAL_ 1871 ConsecutiveSequence IsoTpFrameType 2-2;
SG_MUL_VAL_ 1871 FlowStatus IsoTpFrameType 3-3;
SG_MUL_VAL_ 1871 UnknownPciLow IsoTpFrameType 4-15;
SG_MUL_VAL_ 1871 BlockSize IsoTpFrameType 3-3;
SG_MUL_VAL_ 1871 SingleData1 IsoTpFrameType 0-0;
SG_MUL_VAL_ 1871 ConsecutiveData1 IsoTpFrameType 2-2;
SG_MUL_VAL_ 1871 UnknownData1 IsoTpFrameType 4-15;
SG_MUL_VAL_ 1871 SeparationTimeRaw IsoTpFrameType 3-3;
SG_MUL_VAL_ 1871 SingleData2 IsoTpFrameType 0-0;
SG_MUL_VAL_ 1871 ConsecutiveData2 IsoTpFrameType 2-2;
SG_MUL_VAL_ 1871 UnknownData2 IsoTpFrameType 4-15;
SG_MUL_VAL_ 1871 FirstData1 IsoTpFrameType 1-1;
SG_MUL_VAL_ 1871 SingleData3 IsoTpFrameType 0-0;
SG_MUL_VAL_ 1871 ConsecutiveData3 IsoTpFrameType 2-2;
SG_MUL_VAL_ 1871 UnknownData3 IsoTpFrameType 4-15;
SG_MUL_VAL_ 1871 FirstData2 IsoTpFrameType 1-1;
SG_MUL_VAL_ 1871 FlowPadding1 IsoTpFrameType 3-3;
SG_MUL_VAL_ 1871 SingleData4 IsoTpFrameType 0-0;
SG_MUL_VAL_ 1871 ConsecutiveData4 IsoTpFrameType 2-2;
SG_MUL_VAL_ 1871 UnknownData4 IsoTpFrameType 4-15;
SG_MUL_VAL_ 1871 FirstData3 IsoTpFrameType 1-1;
SG_MUL_VAL_ 1871 FlowPadding2 IsoTpFrameType 3-3;
SG_MUL_VAL_ 1871 SingleData5 IsoTpFrameType 0-0;
SG_MUL_VAL_ 1871 ConsecutiveData5 IsoTpFrameType 2-2;
SG_MUL_VAL_ 1871 UnknownData5 IsoTpFrameType 4-15;
SG_MUL_VAL_ 1871 FirstData4 IsoTpFrameType 1-1;
SG_MUL_VAL_ 1871 FlowPadding3 IsoTpFrameType 3-3;
SG_MUL_VAL_ 1871 SingleData6 IsoTpFrameType 0-0;
SG_MUL_VAL_ 1871 ConsecutiveData6 IsoTpFrameType 2-2;
SG_MUL_VAL_ 1871 UnknownData6 IsoTpFrameType 4-15;
SG_MUL_VAL_ 1871 FirstData5 IsoTpFrameType 1-1;
SG_MUL_VAL_ 1871 FlowPadding4 IsoTpFrameType 3-3;
SG_MUL_VAL_ 1871 SingleData7 IsoTpFrameType 0-0;
SG_MUL_VAL_ 1871 ConsecutiveData7 IsoTpFrameType 2-2;
SG_MUL_VAL_ 1871 UnknownData7 IsoTpFrameType 4-15;
SG_MUL_VAL_ 1871 FirstData6 IsoTpFrameType 1-1;
SG_MUL_VAL_ 1871 FlowPadding5 IsoTpFrameType 3-3;
SG_MUL_VAL_ 1875 SingleFrameLength IsoTpFrameType 0-0;
SG_MUL_VAL_ 1875 FirstFrameLength IsoTpFrameType 1-1;
SG_MUL_VAL_ 1875 ConsecutiveSequence IsoTpFrameType 2-2;
SG_MUL_VAL_ 1875 FlowStatus IsoTpFrameType 3-3;
SG_MUL_VAL_ 1875 UnknownPciLow IsoTpFrameType 4-15;
SG_MUL_VAL_ 1875 BlockSize IsoTpFrameType 3-3;
SG_MUL_VAL_ 1875 SingleData1 IsoTpFrameType 0-0;
SG_MUL_VAL_ 1875 ConsecutiveData1 IsoTpFrameType 2-2;
SG_MUL_VAL_ 1875 UnknownData1 IsoTpFrameType 4-15;
SG_MUL_VAL_ 1875 SeparationTimeRaw IsoTpFrameType 3-3;
SG_MUL_VAL_ 1875 SingleData2 IsoTpFrameType 0-0;
SG_MUL_VAL_ 1875 ConsecutiveData2 IsoTpFrameType 2-2;
SG_MUL_VAL_ 1875 UnknownData2 IsoTpFrameType 4-15;
SG_MUL_VAL_ 1875 FirstData1 IsoTpFrameType 1-1;
SG_MUL_VAL_ 1875 SingleData3 IsoTpFrameType 0-0;
SG_MUL_VAL_ 1875 ConsecutiveData3 IsoTpFrameType 2-2;
SG_MUL_VAL_ 1875 UnknownData3 IsoTpFrameType 4-15;
SG_MUL_VAL_ 1875 FirstData2 IsoTpFrameType 1-1;
SG_MUL_VAL_ 1875 FlowPadding1 IsoTpFrameType 3-3;
SG_MUL_VAL_ 1875 SingleData4 IsoTpFrameType 0-0;
SG_MUL_VAL_ 1875 ConsecutiveData4 IsoTpFrameType 2-2;
SG_MUL_VAL_ 1875 UnknownData4 IsoTpFrameType 4-15;
SG_MUL_VAL_ 1875 FirstData3 IsoTpFrameType 1-1;
SG_MUL_VAL_ 1875 FlowPadding2 IsoTpFrameType 3-3;
SG_MUL_VAL_ 1875 SingleData5 IsoTpFrameType 0-0;
SG_MUL_VAL_ 1875 ConsecutiveData5 IsoTpFrameType 2-2;
SG_MUL_VAL_ 1875 UnknownData5 IsoTpFrameType 4-15;
SG_MUL_VAL_ 1875 FirstData4 IsoTpFrameType 1-1;
SG_MUL_VAL_ 1875 FlowPadding3 IsoTpFrameType 3-3;
SG_MUL_VAL_ 1875 SingleData6 IsoTpFrameType 0-0;
SG_MUL_VAL_ 1875 ConsecutiveData6 IsoTpFrameType 2-2;
SG_MUL_VAL_ 1875 UnknownData6 IsoTpFrameType 4-15;
SG_MUL_VAL_ 1875 FirstData5 IsoTpFrameType 1-1;
SG_MUL_VAL_ 1875 FlowPadding4 IsoTpFrameType 3-3;
SG_MUL_VAL_ 1875 SingleData7 IsoTpFrameType 0-0;
SG_MUL_VAL_ 1875 ConsecutiveData7 IsoTpFrameType 2-2;
SG_MUL_VAL_ 1875 UnknownData7 IsoTpFrameType 4-15;
SG_MUL_VAL_ 1875 FirstData6 IsoTpFrameType 1-1;
SG_MUL_VAL_ 1875 FlowPadding5 IsoTpFrameType 3-3;
SG_MUL_VAL_ 1881 SingleFrameLength IsoTpFrameType 0-0;
SG_MUL_VAL_ 1881 FirstFrameLength IsoTpFrameType 1-1;
SG_MUL_VAL_ 1881 ConsecutiveSequence IsoTpFrameType 2-2;
SG_MUL_VAL_ 1881 FlowStatus IsoTpFrameType 3-3;
SG_MUL_VAL_ 1881 UnknownPciLow IsoTpFrameType 4-15;
SG_MUL_VAL_ 1881 BlockSize IsoTpFrameType 3-3;
SG_MUL_VAL_ 1881 SingleData1 IsoTpFrameType 0-0;
SG_MUL_VAL_ 1881 ConsecutiveData1 IsoTpFrameType 2-2;
SG_MUL_VAL_ 1881 UnknownData1 IsoTpFrameType 4-15;
SG_MUL_VAL_ 1881 SeparationTimeRaw IsoTpFrameType 3-3;
SG_MUL_VAL_ 1881 SingleData2 IsoTpFrameType 0-0;
SG_MUL_VAL_ 1881 ConsecutiveData2 IsoTpFrameType 2-2;
SG_MUL_VAL_ 1881 UnknownData2 IsoTpFrameType 4-15;
SG_MUL_VAL_ 1881 FirstData1 IsoTpFrameType 1-1;
SG_MUL_VAL_ 1881 SingleData3 IsoTpFrameType 0-0;
SG_MUL_VAL_ 1881 ConsecutiveData3 IsoTpFrameType 2-2;
SG_MUL_VAL_ 1881 UnknownData3 IsoTpFrameType 4-15;
SG_MUL_VAL_ 1881 FirstData2 IsoTpFrameType 1-1;
SG_MUL_VAL_ 1881 FlowPadding1 IsoTpFrameType 3-3;
SG_MUL_VAL_ 1881 SingleData4 IsoTpFrameType 0-0;
SG_MUL_VAL_ 1881 ConsecutiveData4 IsoTpFrameType 2-2;
SG_MUL_VAL_ 1881 UnknownData4 IsoTpFrameType 4-15;
SG_MUL_VAL_ 1881 FirstData3 IsoTpFrameType 1-1;
SG_MUL_VAL_ 1881 FlowPadding2 IsoTpFrameType 3-3;
SG_MUL_VAL_ 1881 SingleData5 IsoTpFrameType 0-0;
SG_MUL_VAL_ 1881 ConsecutiveData5 IsoTpFrameType 2-2;
SG_MUL_VAL_ 1881 UnknownData5 IsoTpFrameType 4-15;
SG_MUL_VAL_ 1881 FirstData4 IsoTpFrameType 1-1;
SG_MUL_VAL_ 1881 FlowPadding3 IsoTpFrameType 3-3;
SG_MUL_VAL_ 1881 SingleData6 IsoTpFrameType 0-0;
SG_MUL_VAL_ 1881 ConsecutiveData6 IsoTpFrameType 2-2;
SG_MUL_VAL_ 1881 UnknownData6 IsoTpFrameType 4-15;
SG_MUL_VAL_ 1881 FirstData5 IsoTpFrameType 1-1;
SG_MUL_VAL_ 1881 FlowPadding4 IsoTpFrameType 3-3;
SG_MUL_VAL_ 1881 SingleData7 IsoTpFrameType 0-0;
SG_MUL_VAL_ 1881 ConsecutiveData7 IsoTpFrameType 2-2;
SG_MUL_VAL_ 1881 UnknownData7 IsoTpFrameType 4-15;
SG_MUL_VAL_ 1881 FirstData6 IsoTpFrameType 1-1;
SG_MUL_VAL_ 1881 FlowPadding5 IsoTpFrameType 3-3;
SG_MUL_VAL_ 1883 SingleFrameLength IsoTpFrameType 0-0;
SG_MUL_VAL_ 1883 FirstFrameLength IsoTpFrameType 1-1;
SG_MUL_VAL_ 1883 ConsecutiveSequence IsoTpFrameType 2-2;
SG_MUL_VAL_ 1883 FlowStatus IsoTpFrameType 3-3;
SG_MUL_VAL_ 1883 UnknownPciLow IsoTpFrameType 4-15;
SG_MUL_VAL_ 1883 BlockSize IsoTpFrameType 3-3;
SG_MUL_VAL_ 1883 SingleData1 IsoTpFrameType 0-0;
SG_MUL_VAL_ 1883 ConsecutiveData1 IsoTpFrameType 2-2;
SG_MUL_VAL_ 1883 UnknownData1 IsoTpFrameType 4-15;
SG_MUL_VAL_ 1883 SeparationTimeRaw IsoTpFrameType 3-3;
SG_MUL_VAL_ 1883 SingleData2 IsoTpFrameType 0-0;
SG_MUL_VAL_ 1883 ConsecutiveData2 IsoTpFrameType 2-2;
SG_MUL_VAL_ 1883 UnknownData2 IsoTpFrameType 4-15;
SG_MUL_VAL_ 1883 FirstData1 IsoTpFrameType 1-1;
SG_MUL_VAL_ 1883 SingleData3 IsoTpFrameType 0-0;
SG_MUL_VAL_ 1883 ConsecutiveData3 IsoTpFrameType 2-2;
SG_MUL_VAL_ 1883 UnknownData3 IsoTpFrameType 4-15;
SG_MUL_VAL_ 1883 FirstData2 IsoTpFrameType 1-1;
SG_MUL_VAL_ 1883 FlowPadding1 IsoTpFrameType 3-3;
SG_MUL_VAL_ 1883 SingleData4 IsoTpFrameType 0-0;
SG_MUL_VAL_ 1883 ConsecutiveData4 IsoTpFrameType 2-2;
SG_MUL_VAL_ 1883 UnknownData4 IsoTpFrameType 4-15;
SG_MUL_VAL_ 1883 FirstData3 IsoTpFrameType 1-1;
SG_MUL_VAL_ 1883 FlowPadding2 IsoTpFrameType 3-3;
SG_MUL_VAL_ 1883 SingleData5 IsoTpFrameType 0-0;
SG_MUL_VAL_ 1883 ConsecutiveData5 IsoTpFrameType 2-2;
SG_MUL_VAL_ 1883 UnknownData5 IsoTpFrameType 4-15;
SG_MUL_VAL_ 1883 FirstData4 IsoTpFrameType 1-1;
SG_MUL_VAL_ 1883 FlowPadding3 IsoTpFrameType 3-3;
SG_MUL_VAL_ 1883 SingleData6 IsoTpFrameType 0-0;
SG_MUL_VAL_ 1883 ConsecutiveData6 IsoTpFrameType 2-2;
SG_MUL_VAL_ 1883 UnknownData6 IsoTpFrameType 4-15;
SG_MUL_VAL_ 1883 FirstData5 IsoTpFrameType 1-1;
SG_MUL_VAL_ 1883 FlowPadding4 IsoTpFrameType 3-3;
SG_MUL_VAL_ 1883 SingleData7 IsoTpFrameType 0-0;
SG_MUL_VAL_ 1883 ConsecutiveData7 IsoTpFrameType 2-2;
SG_MUL_VAL_ 1883 UnknownData7 IsoTpFrameType 4-15;
SG_MUL_VAL_ 1883 FirstData6 IsoTpFrameType 1-1;
SG_MUL_VAL_ 1883 FlowPadding5 IsoTpFrameType 3-3;
SG_MUL_VAL_ 1884 SingleFrameLength IsoTpFrameType 0-0;
SG_MUL_VAL_ 1884 FirstFrameLength IsoTpFrameType 1-1;
SG_MUL_VAL_ 1884 ConsecutiveSequence IsoTpFrameType 2-2;
SG_MUL_VAL_ 1884 FlowStatus IsoTpFrameType 3-3;
SG_MUL_VAL_ 1884 UnknownPciLow IsoTpFrameType 4-15;
SG_MUL_VAL_ 1884 BlockSize IsoTpFrameType 3-3;
SG_MUL_VAL_ 1884 SingleData1 IsoTpFrameType 0-0;
SG_MUL_VAL_ 1884 ConsecutiveData1 IsoTpFrameType 2-2;
SG_MUL_VAL_ 1884 UnknownData1 IsoTpFrameType 4-15;
SG_MUL_VAL_ 1884 SeparationTimeRaw IsoTpFrameType 3-3;
SG_MUL_VAL_ 1884 SingleData2 IsoTpFrameType 0-0;
SG_MUL_VAL_ 1884 ConsecutiveData2 IsoTpFrameType 2-2;
SG_MUL_VAL_ 1884 UnknownData2 IsoTpFrameType 4-15;
SG_MUL_VAL_ 1884 FirstData1 IsoTpFrameType 1-1;
SG_MUL_VAL_ 1884 SingleData3 IsoTpFrameType 0-0;
SG_MUL_VAL_ 1884 ConsecutiveData3 IsoTpFrameType 2-2;
SG_MUL_VAL_ 1884 UnknownData3 IsoTpFrameType 4-15;
SG_MUL_VAL_ 1884 FirstData2 IsoTpFrameType 1-1;
SG_MUL_VAL_ 1884 FlowPadding1 IsoTpFrameType 3-3;
SG_MUL_VAL_ 1884 SingleData4 IsoTpFrameType 0-0;
SG_MUL_VAL_ 1884 ConsecutiveData4 IsoTpFrameType 2-2;
SG_MUL_VAL_ 1884 UnknownData4 IsoTpFrameType 4-15;
SG_MUL_VAL_ 1884 FirstData3 IsoTpFrameType 1-1;
SG_MUL_VAL_ 1884 FlowPadding2 IsoTpFrameType 3-3;
SG_MUL_VAL_ 1884 SingleData5 IsoTpFrameType 0-0;
SG_MUL_VAL_ 1884 ConsecutiveData5 IsoTpFrameType 2-2;
SG_MUL_VAL_ 1884 UnknownData5 IsoTpFrameType 4-15;
SG_MUL_VAL_ 1884 FirstData4 IsoTpFrameType 1-1;
SG_MUL_VAL_ 1884 FlowPadding3 IsoTpFrameType 3-3;
SG_MUL_VAL_ 1884 SingleData6 IsoTpFrameType 0-0;
SG_MUL_VAL_ 1884 ConsecutiveData6 IsoTpFrameType 2-2;
SG_MUL_VAL_ 1884 UnknownData6 IsoTpFrameType 4-15;
SG_MUL_VAL_ 1884 FirstData5 IsoTpFrameType 1-1;
SG_MUL_VAL_ 1884 FlowPadding4 IsoTpFrameType 3-3;
SG_MUL_VAL_ 1884 SingleData7 IsoTpFrameType 0-0;
SG_MUL_VAL_ 1884 ConsecutiveData7 IsoTpFrameType 2-2;
SG_MUL_VAL_ 1884 UnknownData7 IsoTpFrameType 4-15;
SG_MUL_VAL_ 1884 FirstData6 IsoTpFrameType 1-1;
SG_MUL_VAL_ 1884 FlowPadding5 IsoTpFrameType 3-3;
SG_MUL_VAL_ 1885 SingleFrameLength IsoTpFrameType 0-0;
SG_MUL_VAL_ 1885 FirstFrameLength IsoTpFrameType 1-1;
SG_MUL_VAL_ 1885 ConsecutiveSequence IsoTpFrameType 2-2;
SG_MUL_VAL_ 1885 FlowStatus IsoTpFrameType 3-3;
SG_MUL_VAL_ 1885 UnknownPciLow IsoTpFrameType 4-15;
SG_MUL_VAL_ 1885 BlockSize IsoTpFrameType 3-3;
SG_MUL_VAL_ 1885 SingleData1 IsoTpFrameType 0-0;
SG_MUL_VAL_ 1885 ConsecutiveData1 IsoTpFrameType 2-2;
SG_MUL_VAL_ 1885 UnknownData1 IsoTpFrameType 4-15;
SG_MUL_VAL_ 1885 SeparationTimeRaw IsoTpFrameType 3-3;
SG_MUL_VAL_ 1885 SingleData2 IsoTpFrameType 0-0;
SG_MUL_VAL_ 1885 ConsecutiveData2 IsoTpFrameType 2-2;
SG_MUL_VAL_ 1885 UnknownData2 IsoTpFrameType 4-15;
SG_MUL_VAL_ 1885 FirstData1 IsoTpFrameType 1-1;
SG_MUL_VAL_ 1885 SingleData3 IsoTpFrameType 0-0;
SG_MUL_VAL_ 1885 ConsecutiveData3 IsoTpFrameType 2-2;
SG_MUL_VAL_ 1885 UnknownData3 IsoTpFrameType 4-15;
SG_MUL_VAL_ 1885 FirstData2 IsoTpFrameType 1-1;
SG_MUL_VAL_ 1885 FlowPadding1 IsoTpFrameType 3-3;
SG_MUL_VAL_ 1885 SingleData4 IsoTpFrameType 0-0;
SG_MUL_VAL_ 1885 ConsecutiveData4 IsoTpFrameType 2-2;
SG_MUL_VAL_ 1885 UnknownData4 IsoTpFrameType 4-15;
SG_MUL_VAL_ 1885 FirstData3 IsoTpFrameType 1-1;
SG_MUL_VAL_ 1885 FlowPadding2 IsoTpFrameType 3-3;
SG_MUL_VAL_ 1885 SingleData5 IsoTpFrameType 0-0;
SG_MUL_VAL_ 1885 ConsecutiveData5 IsoTpFrameType 2-2;
SG_MUL_VAL_ 1885 UnknownData5 IsoTpFrameType 4-15;
SG_MUL_VAL_ 1885 FirstData4 IsoTpFrameType 1-1;
SG_MUL_VAL_ 1885 FlowPadding3 IsoTpFrameType 3-3;
SG_MUL_VAL_ 1885 SingleData6 IsoTpFrameType 0-0;
SG_MUL_VAL_ 1885 ConsecutiveData6 IsoTpFrameType 2-2;
SG_MUL_VAL_ 1885 UnknownData6 IsoTpFrameType 4-15;
SG_MUL_VAL_ 1885 FirstData5 IsoTpFrameType 1-1;
SG_MUL_VAL_ 1885 FlowPadding4 IsoTpFrameType 3-3;
SG_MUL_VAL_ 1885 SingleData7 IsoTpFrameType 0-0;
SG_MUL_VAL_ 1885 ConsecutiveData7 IsoTpFrameType 2-2;
SG_MUL_VAL_ 1885 UnknownData7 IsoTpFrameType 4-15;
SG_MUL_VAL_ 1885 FirstData6 IsoTpFrameType 1-1;
SG_MUL_VAL_ 1885 FlowPadding5 IsoTpFrameType 3-3;
SG_MUL_VAL_ 1886 SingleFrameLength IsoTpFrameType 0-0;
SG_MUL_VAL_ 1886 FirstFrameLength IsoTpFrameType 1-1;
SG_MUL_VAL_ 1886 ConsecutiveSequence IsoTpFrameType 2-2;
SG_MUL_VAL_ 1886 FlowStatus IsoTpFrameType 3-3;
SG_MUL_VAL_ 1886 UnknownPciLow IsoTpFrameType 4-15;
SG_MUL_VAL_ 1886 BlockSize IsoTpFrameType 3-3;
SG_MUL_VAL_ 1886 SingleData1 IsoTpFrameType 0-0;
SG_MUL_VAL_ 1886 ConsecutiveData1 IsoTpFrameType 2-2;
SG_MUL_VAL_ 1886 UnknownData1 IsoTpFrameType 4-15;
SG_MUL_VAL_ 1886 SeparationTimeRaw IsoTpFrameType 3-3;
SG_MUL_VAL_ 1886 SingleData2 IsoTpFrameType 0-0;
SG_MUL_VAL_ 1886 ConsecutiveData2 IsoTpFrameType 2-2;
SG_MUL_VAL_ 1886 UnknownData2 IsoTpFrameType 4-15;
SG_MUL_VAL_ 1886 FirstData1 IsoTpFrameType 1-1;
SG_MUL_VAL_ 1886 SingleData3 IsoTpFrameType 0-0;
SG_MUL_VAL_ 1886 ConsecutiveData3 IsoTpFrameType 2-2;
SG_MUL_VAL_ 1886 UnknownData3 IsoTpFrameType 4-15;
SG_MUL_VAL_ 1886 FirstData2 IsoTpFrameType 1-1;
SG_MUL_VAL_ 1886 FlowPadding1 IsoTpFrameType 3-3;
SG_MUL_VAL_ 1886 SingleData4 IsoTpFrameType 0-0;
SG_MUL_VAL_ 1886 ConsecutiveData4 IsoTpFrameType 2-2;
SG_MUL_VAL_ 1886 UnknownData4 IsoTpFrameType 4-15;
SG_MUL_VAL_ 1886 FirstData3 IsoTpFrameType 1-1;
SG_MUL_VAL_ 1886 FlowPadding2 IsoTpFrameType 3-3;
SG_MUL_VAL_ 1886 SingleData5 IsoTpFrameType 0-0;
SG_MUL_VAL_ 1886 ConsecutiveData5 IsoTpFrameType 2-2;
SG_MUL_VAL_ 1886 UnknownData5 IsoTpFrameType 4-15;
SG_MUL_VAL_ 1886 FirstData4 IsoTpFrameType 1-1;
SG_MUL_VAL_ 1886 FlowPadding3 IsoTpFrameType 3-3;
SG_MUL_VAL_ 1886 SingleData6 IsoTpFrameType 0-0;
SG_MUL_VAL_ 1886 ConsecutiveData6 IsoTpFrameType 2-2;
SG_MUL_VAL_ 1886 UnknownData6 IsoTpFrameType 4-15;
SG_MUL_VAL_ 1886 FirstData5 IsoTpFrameType 1-1;
SG_MUL_VAL_ 1886 FlowPadding4 IsoTpFrameType 3-3;
SG_MUL_VAL_ 1886 SingleData7 IsoTpFrameType 0-0;
SG_MUL_VAL_ 1886 ConsecutiveData7 IsoTpFrameType 2-2;
SG_MUL_VAL_ 1886 UnknownData7 IsoTpFrameType 4-15;
SG_MUL_VAL_ 1886 FirstData6 IsoTpFrameType 1-1;
SG_MUL_VAL_ 1886 FlowPadding5 IsoTpFrameType 3-3;
SG_MUL_VAL_ 1887 SingleFrameLength IsoTpFrameType 0-0;
SG_MUL_VAL_ 1887 FirstFrameLength IsoTpFrameType 1-1;
SG_MUL_VAL_ 1887 ConsecutiveSequence IsoTpFrameType 2-2;
SG_MUL_VAL_ 1887 FlowStatus IsoTpFrameType 3-3;
SG_MUL_VAL_ 1887 UnknownPciLow IsoTpFrameType 4-15;
SG_MUL_VAL_ 1887 BlockSize IsoTpFrameType 3-3;
SG_MUL_VAL_ 1887 SingleData1 IsoTpFrameType 0-0;
SG_MUL_VAL_ 1887 ConsecutiveData1 IsoTpFrameType 2-2;
SG_MUL_VAL_ 1887 UnknownData1 IsoTpFrameType 4-15;
SG_MUL_VAL_ 1887 SeparationTimeRaw IsoTpFrameType 3-3;
SG_MUL_VAL_ 1887 SingleData2 IsoTpFrameType 0-0;
SG_MUL_VAL_ 1887 ConsecutiveData2 IsoTpFrameType 2-2;
SG_MUL_VAL_ 1887 UnknownData2 IsoTpFrameType 4-15;
SG_MUL_VAL_ 1887 FirstData1 IsoTpFrameType 1-1;
SG_MUL_VAL_ 1887 SingleData3 IsoTpFrameType 0-0;
SG_MUL_VAL_ 1887 ConsecutiveData3 IsoTpFrameType 2-2;
SG_MUL_VAL_ 1887 UnknownData3 IsoTpFrameType 4-15;
SG_MUL_VAL_ 1887 FirstData2 IsoTpFrameType 1-1;
SG_MUL_VAL_ 1887 FlowPadding1 IsoTpFrameType 3-3;
SG_MUL_VAL_ 1887 SingleData4 IsoTpFrameType 0-0;
SG_MUL_VAL_ 1887 ConsecutiveData4 IsoTpFrameType 2-2;
SG_MUL_VAL_ 1887 UnknownData4 IsoTpFrameType 4-15;
SG_MUL_VAL_ 1887 FirstData3 IsoTpFrameType 1-1;
SG_MUL_VAL_ 1887 FlowPadding2 IsoTpFrameType 3-3;
SG_MUL_VAL_ 1887 SingleData5 IsoTpFrameType 0-0;
SG_MUL_VAL_ 1887 ConsecutiveData5 IsoTpFrameType 2-2;
SG_MUL_VAL_ 1887 UnknownData5 IsoTpFrameType 4-15;
SG_MUL_VAL_ 1887 FirstData4 IsoTpFrameType 1-1;
SG_MUL_VAL_ 1887 FlowPadding3 IsoTpFrameType 3-3;
SG_MUL_VAL_ 1887 SingleData6 IsoTpFrameType 0-0;
SG_MUL_VAL_ 1887 ConsecutiveData6 IsoTpFrameType 2-2;
SG_MUL_VAL_ 1887 UnknownData6 IsoTpFrameType 4-15;
SG_MUL_VAL_ 1887 FirstData5 IsoTpFrameType 1-1;
SG_MUL_VAL_ 1887 FlowPadding4 IsoTpFrameType 3-3;
SG_MUL_VAL_ 1887 SingleData7 IsoTpFrameType 0-0;
SG_MUL_VAL_ 1887 ConsecutiveData7 IsoTpFrameType 2-2;
SG_MUL_VAL_ 1887 UnknownData7 IsoTpFrameType 4-15;
SG_MUL_VAL_ 1887 FirstData6 IsoTpFrameType 1-1;
SG_MUL_VAL_ 1887 FlowPadding5 IsoTpFrameType 3-3;
SG_MUL_VAL_ 1888 SingleFrameLength IsoTpFrameType 0-0;
SG_MUL_VAL_ 1888 FirstFrameLength IsoTpFrameType 1-1;
SG_MUL_VAL_ 1888 ConsecutiveSequence IsoTpFrameType 2-2;
SG_MUL_VAL_ 1888 FlowStatus IsoTpFrameType 3-3;
SG_MUL_VAL_ 1888 UnknownPciLow IsoTpFrameType 4-15;
SG_MUL_VAL_ 1888 BlockSize IsoTpFrameType 3-3;
SG_MUL_VAL_ 1888 SingleData1 IsoTpFrameType 0-0;
SG_MUL_VAL_ 1888 ConsecutiveData1 IsoTpFrameType 2-2;
SG_MUL_VAL_ 1888 UnknownData1 IsoTpFrameType 4-15;
SG_MUL_VAL_ 1888 SeparationTimeRaw IsoTpFrameType 3-3;
SG_MUL_VAL_ 1888 SingleData2 IsoTpFrameType 0-0;
SG_MUL_VAL_ 1888 ConsecutiveData2 IsoTpFrameType 2-2;
SG_MUL_VAL_ 1888 UnknownData2 IsoTpFrameType 4-15;
SG_MUL_VAL_ 1888 FirstData1 IsoTpFrameType 1-1;
SG_MUL_VAL_ 1888 SingleData3 IsoTpFrameType 0-0;
SG_MUL_VAL_ 1888 ConsecutiveData3 IsoTpFrameType 2-2;
SG_MUL_VAL_ 1888 UnknownData3 IsoTpFrameType 4-15;
SG_MUL_VAL_ 1888 FirstData2 IsoTpFrameType 1-1;
SG_MUL_VAL_ 1888 FlowPadding1 IsoTpFrameType 3-3;
SG_MUL_VAL_ 1888 SingleData4 IsoTpFrameType 0-0;
SG_MUL_VAL_ 1888 ConsecutiveData4 IsoTpFrameType 2-2;
SG_MUL_VAL_ 1888 UnknownData4 IsoTpFrameType 4-15;
SG_MUL_VAL_ 1888 FirstData3 IsoTpFrameType 1-1;
SG_MUL_VAL_ 1888 FlowPadding2 IsoTpFrameType 3-3;
SG_MUL_VAL_ 1888 SingleData5 IsoTpFrameType 0-0;
SG_MUL_VAL_ 1888 ConsecutiveData5 IsoTpFrameType 2-2;
SG_MUL_VAL_ 1888 UnknownData5 IsoTpFrameType 4-15;
SG_MUL_VAL_ 1888 FirstData4 IsoTpFrameType 1-1;
SG_MUL_VAL_ 1888 FlowPadding3 IsoTpFrameType 3-3;
SG_MUL_VAL_ 1888 SingleData6 IsoTpFrameType 0-0;
SG_MUL_VAL_ 1888 ConsecutiveData6 IsoTpFrameType 2-2;
SG_MUL_VAL_ 1888 UnknownData6 IsoTpFrameType 4-15;
SG_MUL_VAL_ 1888 FirstData5 IsoTpFrameType 1-1;
SG_MUL_VAL_ 1888 FlowPadding4 IsoTpFrameType 3-3;
SG_MUL_VAL_ 1888 SingleData7 IsoTpFrameType 0-0;
SG_MUL_VAL_ 1888 ConsecutiveData7 IsoTpFrameType 2-2;
SG_MUL_VAL_ 1888 UnknownData7 IsoTpFrameType 4-15;
SG_MUL_VAL_ 1888 FirstData6 IsoTpFrameType 1-1;
SG_MUL_VAL_ 1888 FlowPadding5 IsoTpFrameType 3-3;
SG_MUL_VAL_ 1889 SingleFrameLength IsoTpFrameType 0-0;
SG_MUL_VAL_ 1889 FirstFrameLength IsoTpFrameType 1-1;
SG_MUL_VAL_ 1889 ConsecutiveSequence IsoTpFrameType 2-2;
SG_MUL_VAL_ 1889 FlowStatus IsoTpFrameType 3-3;
SG_MUL_VAL_ 1889 UnknownPciLow IsoTpFrameType 4-15;
SG_MUL_VAL_ 1889 BlockSize IsoTpFrameType 3-3;
SG_MUL_VAL_ 1889 SingleData1 IsoTpFrameType 0-0;
SG_MUL_VAL_ 1889 ConsecutiveData1 IsoTpFrameType 2-2;
SG_MUL_VAL_ 1889 UnknownData1 IsoTpFrameType 4-15;
SG_MUL_VAL_ 1889 SeparationTimeRaw IsoTpFrameType 3-3;
SG_MUL_VAL_ 1889 SingleData2 IsoTpFrameType 0-0;
SG_MUL_VAL_ 1889 ConsecutiveData2 IsoTpFrameType 2-2;
SG_MUL_VAL_ 1889 UnknownData2 IsoTpFrameType 4-15;
SG_MUL_VAL_ 1889 FirstData1 IsoTpFrameType 1-1;
SG_MUL_VAL_ 1889 SingleData3 IsoTpFrameType 0-0;
SG_MUL_VAL_ 1889 ConsecutiveData3 IsoTpFrameType 2-2;
SG_MUL_VAL_ 1889 UnknownData3 IsoTpFrameType 4-15;
SG_MUL_VAL_ 1889 FirstData2 IsoTpFrameType 1-1;
SG_MUL_VAL_ 1889 FlowPadding1 IsoTpFrameType 3-3;
SG_MUL_VAL_ 1889 SingleData4 IsoTpFrameType 0-0;
SG_MUL_VAL_ 1889 ConsecutiveData4 IsoTpFrameType 2-2;
SG_MUL_VAL_ 1889 UnknownData4 IsoTpFrameType 4-15;
SG_MUL_VAL_ 1889 FirstData3 IsoTpFrameType 1-1;
SG_MUL_VAL_ 1889 FlowPadding2 IsoTpFrameType 3-3;
SG_MUL_VAL_ 1889 SingleData5 IsoTpFrameType 0-0;
SG_MUL_VAL_ 1889 ConsecutiveData5 IsoTpFrameType 2-2;
SG_MUL_VAL_ 1889 UnknownData5 IsoTpFrameType 4-15;
SG_MUL_VAL_ 1889 FirstData4 IsoTpFrameType 1-1;
SG_MUL_VAL_ 1889 FlowPadding3 IsoTpFrameType 3-3;
SG_MUL_VAL_ 1889 SingleData6 IsoTpFrameType 0-0;
SG_MUL_VAL_ 1889 ConsecutiveData6 IsoTpFrameType 2-2;
SG_MUL_VAL_ 1889 UnknownData6 IsoTpFrameType 4-15;
SG_MUL_VAL_ 1889 FirstData5 IsoTpFrameType 1-1;
SG_MUL_VAL_ 1889 FlowPadding4 IsoTpFrameType 3-3;
SG_MUL_VAL_ 1889 SingleData7 IsoTpFrameType 0-0;
SG_MUL_VAL_ 1889 ConsecutiveData7 IsoTpFrameType 2-2;
SG_MUL_VAL_ 1889 UnknownData7 IsoTpFrameType 4-15;
SG_MUL_VAL_ 1889 FirstData6 IsoTpFrameType 1-1;
SG_MUL_VAL_ 1889 FlowPadding5 IsoTpFrameType 3-3;
SG_MUL_VAL_ 1890 SingleFrameLength IsoTpFrameType 0-0;
SG_MUL_VAL_ 1890 FirstFrameLength IsoTpFrameType 1-1;
SG_MUL_VAL_ 1890 ConsecutiveSequence IsoTpFrameType 2-2;
SG_MUL_VAL_ 1890 FlowStatus IsoTpFrameType 3-3;
SG_MUL_VAL_ 1890 UnknownPciLow IsoTpFrameType 4-15;
SG_MUL_VAL_ 1890 BlockSize IsoTpFrameType 3-3;
SG_MUL_VAL_ 1890 SingleData1 IsoTpFrameType 0-0;
SG_MUL_VAL_ 1890 ConsecutiveData1 IsoTpFrameType 2-2;
SG_MUL_VAL_ 1890 UnknownData1 IsoTpFrameType 4-15;
SG_MUL_VAL_ 1890 SeparationTimeRaw IsoTpFrameType 3-3;
SG_MUL_VAL_ 1890 SingleData2 IsoTpFrameType 0-0;
SG_MUL_VAL_ 1890 ConsecutiveData2 IsoTpFrameType 2-2;
SG_MUL_VAL_ 1890 UnknownData2 IsoTpFrameType 4-15;
SG_MUL_VAL_ 1890 FirstData1 IsoTpFrameType 1-1;
SG_MUL_VAL_ 1890 SingleData3 IsoTpFrameType 0-0;
SG_MUL_VAL_ 1890 ConsecutiveData3 IsoTpFrameType 2-2;
SG_MUL_VAL_ 1890 UnknownData3 IsoTpFrameType 4-15;
SG_MUL_VAL_ 1890 FirstData2 IsoTpFrameType 1-1;
SG_MUL_VAL_ 1890 FlowPadding1 IsoTpFrameType 3-3;
SG_MUL_VAL_ 1890 SingleData4 IsoTpFrameType 0-0;
SG_MUL_VAL_ 1890 ConsecutiveData4 IsoTpFrameType 2-2;
SG_MUL_VAL_ 1890 UnknownData4 IsoTpFrameType 4-15;
SG_MUL_VAL_ 1890 FirstData3 IsoTpFrameType 1-1;
SG_MUL_VAL_ 1890 FlowPadding2 IsoTpFrameType 3-3;
SG_MUL_VAL_ 1890 SingleData5 IsoTpFrameType 0-0;
SG_MUL_VAL_ 1890 ConsecutiveData5 IsoTpFrameType 2-2;
SG_MUL_VAL_ 1890 UnknownData5 IsoTpFrameType 4-15;
SG_MUL_VAL_ 1890 FirstData4 IsoTpFrameType 1-1;
SG_MUL_VAL_ 1890 FlowPadding3 IsoTpFrameType 3-3;
SG_MUL_VAL_ 1890 SingleData6 IsoTpFrameType 0-0;
SG_MUL_VAL_ 1890 ConsecutiveData6 IsoTpFrameType 2-2;
SG_MUL_VAL_ 1890 UnknownData6 IsoTpFrameType 4-15;
SG_MUL_VAL_ 1890 FirstData5 IsoTpFrameType 1-1;
SG_MUL_VAL_ 1890 FlowPadding4 IsoTpFrameType 3-3;
SG_MUL_VAL_ 1890 SingleData7 IsoTpFrameType 0-0;
SG_MUL_VAL_ 1890 ConsecutiveData7 IsoTpFrameType 2-2;
SG_MUL_VAL_ 1890 UnknownData7 IsoTpFrameType 4-15;
SG_MUL_VAL_ 1890 FirstData6 IsoTpFrameType 1-1;
SG_MUL_VAL_ 1890 FlowPadding5 IsoTpFrameType 3-3;
SG_MUL_VAL_ 1892 SingleFrameLength IsoTpFrameType 0-0;
SG_MUL_VAL_ 1892 FirstFrameLength IsoTpFrameType 1-1;
SG_MUL_VAL_ 1892 ConsecutiveSequence IsoTpFrameType 2-2;
SG_MUL_VAL_ 1892 FlowStatus IsoTpFrameType 3-3;
SG_MUL_VAL_ 1892 UnknownPciLow IsoTpFrameType 4-15;
SG_MUL_VAL_ 1892 BlockSize IsoTpFrameType 3-3;
SG_MUL_VAL_ 1892 SingleData1 IsoTpFrameType 0-0;
SG_MUL_VAL_ 1892 ConsecutiveData1 IsoTpFrameType 2-2;
SG_MUL_VAL_ 1892 UnknownData1 IsoTpFrameType 4-15;
SG_MUL_VAL_ 1892 SeparationTimeRaw IsoTpFrameType 3-3;
SG_MUL_VAL_ 1892 SingleData2 IsoTpFrameType 0-0;
SG_MUL_VAL_ 1892 ConsecutiveData2 IsoTpFrameType 2-2;
SG_MUL_VAL_ 1892 UnknownData2 IsoTpFrameType 4-15;
SG_MUL_VAL_ 1892 FirstData1 IsoTpFrameType 1-1;
SG_MUL_VAL_ 1892 SingleData3 IsoTpFrameType 0-0;
SG_MUL_VAL_ 1892 ConsecutiveData3 IsoTpFrameType 2-2;
SG_MUL_VAL_ 1892 UnknownData3 IsoTpFrameType 4-15;
SG_MUL_VAL_ 1892 FirstData2 IsoTpFrameType 1-1;
SG_MUL_VAL_ 1892 FlowPadding1 IsoTpFrameType 3-3;
SG_MUL_VAL_ 1892 SingleData4 IsoTpFrameType 0-0;
SG_MUL_VAL_ 1892 ConsecutiveData4 IsoTpFrameType 2-2;
SG_MUL_VAL_ 1892 UnknownData4 IsoTpFrameType 4-15;
SG_MUL_VAL_ 1892 FirstData3 IsoTpFrameType 1-1;
SG_MUL_VAL_ 1892 FlowPadding2 IsoTpFrameType 3-3;
SG_MUL_VAL_ 1892 SingleData5 IsoTpFrameType 0-0;
SG_MUL_VAL_ 1892 ConsecutiveData5 IsoTpFrameType 2-2;
SG_MUL_VAL_ 1892 UnknownData5 IsoTpFrameType 4-15;
SG_MUL_VAL_ 1892 FirstData4 IsoTpFrameType 1-1;
SG_MUL_VAL_ 1892 FlowPadding3 IsoTpFrameType 3-3;
SG_MUL_VAL_ 1892 SingleData6 IsoTpFrameType 0-0;
SG_MUL_VAL_ 1892 ConsecutiveData6 IsoTpFrameType 2-2;
SG_MUL_VAL_ 1892 UnknownData6 IsoTpFrameType 4-15;
SG_MUL_VAL_ 1892 FirstData5 IsoTpFrameType 1-1;
SG_MUL_VAL_ 1892 FlowPadding4 IsoTpFrameType 3-3;
SG_MUL_VAL_ 1892 SingleData7 IsoTpFrameType 0-0;
SG_MUL_VAL_ 1892 ConsecutiveData7 IsoTpFrameType 2-2;
SG_MUL_VAL_ 1892 UnknownData7 IsoTpFrameType 4-15;
SG_MUL_VAL_ 1892 FirstData6 IsoTpFrameType 1-1;
SG_MUL_VAL_ 1892 FlowPadding5 IsoTpFrameType 3-3;
SG_MUL_VAL_ 1893 SingleFrameLength IsoTpFrameType 0-0;
SG_MUL_VAL_ 1893 FirstFrameLength IsoTpFrameType 1-1;
SG_MUL_VAL_ 1893 ConsecutiveSequence IsoTpFrameType 2-2;
SG_MUL_VAL_ 1893 FlowStatus IsoTpFrameType 3-3;
SG_MUL_VAL_ 1893 UnknownPciLow IsoTpFrameType 4-15;
SG_MUL_VAL_ 1893 BlockSize IsoTpFrameType 3-3;
SG_MUL_VAL_ 1893 SingleData1 IsoTpFrameType 0-0;
SG_MUL_VAL_ 1893 ConsecutiveData1 IsoTpFrameType 2-2;
SG_MUL_VAL_ 1893 UnknownData1 IsoTpFrameType 4-15;
SG_MUL_VAL_ 1893 SeparationTimeRaw IsoTpFrameType 3-3;
SG_MUL_VAL_ 1893 SingleData2 IsoTpFrameType 0-0;
SG_MUL_VAL_ 1893 ConsecutiveData2 IsoTpFrameType 2-2;
SG_MUL_VAL_ 1893 UnknownData2 IsoTpFrameType 4-15;
SG_MUL_VAL_ 1893 FirstData1 IsoTpFrameType 1-1;
SG_MUL_VAL_ 1893 SingleData3 IsoTpFrameType 0-0;
SG_MUL_VAL_ 1893 ConsecutiveData3 IsoTpFrameType 2-2;
SG_MUL_VAL_ 1893 UnknownData3 IsoTpFrameType 4-15;
SG_MUL_VAL_ 1893 FirstData2 IsoTpFrameType 1-1;
SG_MUL_VAL_ 1893 FlowPadding1 IsoTpFrameType 3-3;
SG_MUL_VAL_ 1893 SingleData4 IsoTpFrameType 0-0;
SG_MUL_VAL_ 1893 ConsecutiveData4 IsoTpFrameType 2-2;
SG_MUL_VAL_ 1893 UnknownData4 IsoTpFrameType 4-15;
SG_MUL_VAL_ 1893 FirstData3 IsoTpFrameType 1-1;
SG_MUL_VAL_ 1893 FlowPadding2 IsoTpFrameType 3-3;
SG_MUL_VAL_ 1893 SingleData5 IsoTpFrameType 0-0;
SG_MUL_VAL_ 1893 ConsecutiveData5 IsoTpFrameType 2-2;
SG_MUL_VAL_ 1893 UnknownData5 IsoTpFrameType 4-15;
SG_MUL_VAL_ 1893 FirstData4 IsoTpFrameType 1-1;
SG_MUL_VAL_ 1893 FlowPadding3 IsoTpFrameType 3-3;
SG_MUL_VAL_ 1893 SingleData6 IsoTpFrameType 0-0;
SG_MUL_VAL_ 1893 ConsecutiveData6 IsoTpFrameType 2-2;
SG_MUL_VAL_ 1893 UnknownData6 IsoTpFrameType 4-15;
SG_MUL_VAL_ 1893 FirstData5 IsoTpFrameType 1-1;
SG_MUL_VAL_ 1893 FlowPadding4 IsoTpFrameType 3-3;
SG_MUL_VAL_ 1893 SingleData7 IsoTpFrameType 0-0;
SG_MUL_VAL_ 1893 ConsecutiveData7 IsoTpFrameType 2-2;
SG_MUL_VAL_ 1893 UnknownData7 IsoTpFrameType 4-15;
SG_MUL_VAL_ 1893 FirstData6 IsoTpFrameType 1-1;
SG_MUL_VAL_ 1893 FlowPadding5 IsoTpFrameType 3-3;
