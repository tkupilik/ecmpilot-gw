VERSION "eCMP INFO-DIV vehicle review 2026-11-03; 125000 bit/s; PSA-RE 67f7581e7622410efdbb29c7eda3b86982b9b450; Apache-2.0"

NS_ :

BS_:

BU_: AAS AMPLI AVP BCM BGP BSG BSI BTA BTEL BTT CDC CMB CRT DIAG_TOOL EDP_C EMF FMUX IC ICSV IDVR IVC_D MATT MDS OVIP PDS_C RAD RBG SDCM VTH WLC

BO_ 1611 BSI_DiagResponse_11: 8 BSI
 SG_ FlowPadding5 m3 : 63|8@0+ (1,0) [0|255] "raw"  MDS
 SG_ FirstData6 m1 : 63|8@0+ (1,0) [0|255] "raw"  MDS
 SG_ UnknownData7 m4 : 63|8@0+ (1,0) [0|255] "raw"  MDS
 SG_ ConsecutiveData7 m2 : 63|8@0+ (1,0) [0|255] "raw"  MDS
 SG_ SingleData7 m0 : 63|8@0+ (1,0) [0|255] "raw"  MDS
 SG_ FlowPadding4 m3 : 55|8@0+ (1,0) [0|255] "raw"  MDS
 SG_ FirstData5 m1 : 55|8@0+ (1,0) [0|255] "raw"  MDS
 SG_ UnknownData6 m4 : 55|8@0+ (1,0) [0|255] "raw"  MDS
 SG_ ConsecutiveData6 m2 : 55|8@0+ (1,0) [0|255] "raw"  MDS
 SG_ SingleData6 m0 : 55|8@0+ (1,0) [0|255] "raw"  MDS
 SG_ FlowPadding3 m3 : 47|8@0+ (1,0) [0|255] "raw"  MDS
 SG_ FirstData4 m1 : 47|8@0+ (1,0) [0|255] "raw"  MDS
 SG_ UnknownData5 m4 : 47|8@0+ (1,0) [0|255] "raw"  MDS
 SG_ ConsecutiveData5 m2 : 47|8@0+ (1,0) [0|255] "raw"  MDS
 SG_ SingleData5 m0 : 47|8@0+ (1,0) [0|255] "raw"  MDS
 SG_ FlowPadding2 m3 : 39|8@0+ (1,0) [0|255] "raw"  MDS
 SG_ FirstData3 m1 : 39|8@0+ (1,0) [0|255] "raw"  MDS
 SG_ UnknownData4 m4 : 39|8@0+ (1,0) [0|255] "raw"  MDS
 SG_ ConsecutiveData4 m2 : 39|8@0+ (1,0) [0|255] "raw"  MDS
 SG_ SingleData4 m0 : 39|8@0+ (1,0) [0|255] "raw"  MDS
 SG_ FlowPadding1 m3 : 31|8@0+ (1,0) [0|255] "raw"  MDS
 SG_ FirstData2 m1 : 31|8@0+ (1,0) [0|255] "raw"  MDS
 SG_ UnknownData3 m4 : 31|8@0+ (1,0) [0|255] "raw"  MDS
 SG_ ConsecutiveData3 m2 : 31|8@0+ (1,0) [0|255] "raw"  MDS
 SG_ SingleData3 m0 : 31|8@0+ (1,0) [0|255] "raw"  MDS
 SG_ FirstData1 m1 : 23|8@0+ (1,0) [0|255] "raw"  MDS
 SG_ UnknownData2 m4 : 23|8@0+ (1,0) [0|255] "raw"  MDS
 SG_ ConsecutiveData2 m2 : 23|8@0+ (1,0) [0|255] "raw"  MDS
 SG_ SingleData2 m0 : 23|8@0+ (1,0) [0|255] "raw"  MDS
 SG_ SeparationTimeRaw m3 : 23|8@0+ (1,0) [0|255] "raw"  MDS
 SG_ UnknownData1 m4 : 15|8@0+ (1,0) [0|255] "raw"  MDS
 SG_ ConsecutiveData1 m2 : 15|8@0+ (1,0) [0|255] "raw"  MDS
 SG_ SingleData1 m0 : 15|8@0+ (1,0) [0|255] "raw"  MDS
 SG_ BlockSize m3 : 15|8@0+ (1,0) [0|255] "raw"  MDS
 SG_ UnknownPciLow m4 : 3|4@0+ (1,0) [0|15] "raw"  MDS
 SG_ FlowStatus m3 : 3|4@0+ (1,0) [0|15] "raw"  MDS
 SG_ ConsecutiveSequence m2 : 3|4@0+ (1,0) [0|15] "raw"  MDS
 SG_ FirstFrameLength m1 : 3|12@0+ (1,0) [0|4095] "raw"  MDS
 SG_ SingleFrameLength m0 : 3|4@0+ (1,0) [0|15] "raw"  MDS
 SG_ IsoTpFrameType M : 7|4@0+ (1,0) [0|15] ""  MDS

BO_ 1612 CRT_DiagResponse: 8 CRT
 SG_ FlowPadding5 m3 : 63|8@0+ (1,0) [0|255] "raw"  MDS,BSI
 SG_ FirstData6 m1 : 63|8@0+ (1,0) [0|255] "raw"  MDS,BSI
 SG_ UnknownData7 m4 : 63|8@0+ (1,0) [0|255] "raw"  MDS,BSI
 SG_ ConsecutiveData7 m2 : 63|8@0+ (1,0) [0|255] "raw"  MDS,BSI
 SG_ SingleData7 m0 : 63|8@0+ (1,0) [0|255] "raw"  MDS,BSI
 SG_ FlowPadding4 m3 : 55|8@0+ (1,0) [0|255] "raw"  MDS,BSI
 SG_ FirstData5 m1 : 55|8@0+ (1,0) [0|255] "raw"  MDS,BSI
 SG_ UnknownData6 m4 : 55|8@0+ (1,0) [0|255] "raw"  MDS,BSI
 SG_ ConsecutiveData6 m2 : 55|8@0+ (1,0) [0|255] "raw"  MDS,BSI
 SG_ SingleData6 m0 : 55|8@0+ (1,0) [0|255] "raw"  MDS,BSI
 SG_ FlowPadding3 m3 : 47|8@0+ (1,0) [0|255] "raw"  MDS,BSI
 SG_ FirstData4 m1 : 47|8@0+ (1,0) [0|255] "raw"  MDS,BSI
 SG_ UnknownData5 m4 : 47|8@0+ (1,0) [0|255] "raw"  MDS,BSI
 SG_ ConsecutiveData5 m2 : 47|8@0+ (1,0) [0|255] "raw"  MDS,BSI
 SG_ SingleData5 m0 : 47|8@0+ (1,0) [0|255] "raw"  MDS,BSI
 SG_ FlowPadding2 m3 : 39|8@0+ (1,0) [0|255] "raw"  MDS,BSI
 SG_ FirstData3 m1 : 39|8@0+ (1,0) [0|255] "raw"  MDS,BSI
 SG_ UnknownData4 m4 : 39|8@0+ (1,0) [0|255] "raw"  MDS,BSI
 SG_ ConsecutiveData4 m2 : 39|8@0+ (1,0) [0|255] "raw"  MDS,BSI
 SG_ SingleData4 m0 : 39|8@0+ (1,0) [0|255] "raw"  MDS,BSI
 SG_ FlowPadding1 m3 : 31|8@0+ (1,0) [0|255] "raw"  MDS,BSI
 SG_ FirstData2 m1 : 31|8@0+ (1,0) [0|255] "raw"  MDS,BSI
 SG_ UnknownData3 m4 : 31|8@0+ (1,0) [0|255] "raw"  MDS,BSI
 SG_ ConsecutiveData3 m2 : 31|8@0+ (1,0) [0|255] "raw"  MDS,BSI
 SG_ SingleData3 m0 : 31|8@0+ (1,0) [0|255] "raw"  MDS,BSI
 SG_ FirstData1 m1 : 23|8@0+ (1,0) [0|255] "raw"  MDS,BSI
 SG_ UnknownData2 m4 : 23|8@0+ (1,0) [0|255] "raw"  MDS,BSI
 SG_ ConsecutiveData2 m2 : 23|8@0+ (1,0) [0|255] "raw"  MDS,BSI
 SG_ SingleData2 m0 : 23|8@0+ (1,0) [0|255] "raw"  MDS,BSI
 SG_ SeparationTimeRaw m3 : 23|8@0+ (1,0) [0|255] "raw"  MDS,BSI
 SG_ UnknownData1 m4 : 15|8@0+ (1,0) [0|255] "raw"  MDS,BSI
 SG_ ConsecutiveData1 m2 : 15|8@0+ (1,0) [0|255] "raw"  MDS,BSI
 SG_ SingleData1 m0 : 15|8@0+ (1,0) [0|255] "raw"  MDS,BSI
 SG_ BlockSize m3 : 15|8@0+ (1,0) [0|255] "raw"  MDS,BSI
 SG_ UnknownPciLow m4 : 3|4@0+ (1,0) [0|15] "raw"  MDS,BSI
 SG_ FlowStatus m3 : 3|4@0+ (1,0) [0|15] "raw"  MDS,BSI
 SG_ ConsecutiveSequence m2 : 3|4@0+ (1,0) [0|15] "raw"  MDS,BSI
 SG_ FirstFrameLength m1 : 3|12@0+ (1,0) [0|4095] "raw"  MDS,BSI
 SG_ SingleFrameLength m0 : 3|4@0+ (1,0) [0|15] "raw"  MDS,BSI
 SG_ IsoTpFrameType M : 7|4@0+ (1,0) [0|15] ""  MDS,BSI

BO_ 1615 BSI_DiagResponse_12: 8 BSI
 SG_ FlowPadding5 m3 : 63|8@0+ (1,0) [0|255] "raw"  MDS
 SG_ FirstData6 m1 : 63|8@0+ (1,0) [0|255] "raw"  MDS
 SG_ UnknownData7 m4 : 63|8@0+ (1,0) [0|255] "raw"  MDS
 SG_ ConsecutiveData7 m2 : 63|8@0+ (1,0) [0|255] "raw"  MDS
 SG_ SingleData7 m0 : 63|8@0+ (1,0) [0|255] "raw"  MDS
 SG_ FlowPadding4 m3 : 55|8@0+ (1,0) [0|255] "raw"  MDS
 SG_ FirstData5 m1 : 55|8@0+ (1,0) [0|255] "raw"  MDS
 SG_ UnknownData6 m4 : 55|8@0+ (1,0) [0|255] "raw"  MDS
 SG_ ConsecutiveData6 m2 : 55|8@0+ (1,0) [0|255] "raw"  MDS
 SG_ SingleData6 m0 : 55|8@0+ (1,0) [0|255] "raw"  MDS
 SG_ FlowPadding3 m3 : 47|8@0+ (1,0) [0|255] "raw"  MDS
 SG_ FirstData4 m1 : 47|8@0+ (1,0) [0|255] "raw"  MDS
 SG_ UnknownData5 m4 : 47|8@0+ (1,0) [0|255] "raw"  MDS
 SG_ ConsecutiveData5 m2 : 47|8@0+ (1,0) [0|255] "raw"  MDS
 SG_ SingleData5 m0 : 47|8@0+ (1,0) [0|255] "raw"  MDS
 SG_ FlowPadding2 m3 : 39|8@0+ (1,0) [0|255] "raw"  MDS
 SG_ FirstData3 m1 : 39|8@0+ (1,0) [0|255] "raw"  MDS
 SG_ UnknownData4 m4 : 39|8@0+ (1,0) [0|255] "raw"  MDS
 SG_ ConsecutiveData4 m2 : 39|8@0+ (1,0) [0|255] "raw"  MDS
 SG_ SingleData4 m0 : 39|8@0+ (1,0) [0|255] "raw"  MDS
 SG_ FlowPadding1 m3 : 31|8@0+ (1,0) [0|255] "raw"  MDS
 SG_ FirstData2 m1 : 31|8@0+ (1,0) [0|255] "raw"  MDS
 SG_ UnknownData3 m4 : 31|8@0+ (1,0) [0|255] "raw"  MDS
 SG_ ConsecutiveData3 m2 : 31|8@0+ (1,0) [0|255] "raw"  MDS
 SG_ SingleData3 m0 : 31|8@0+ (1,0) [0|255] "raw"  MDS
 SG_ FirstData1 m1 : 23|8@0+ (1,0) [0|255] "raw"  MDS
 SG_ UnknownData2 m4 : 23|8@0+ (1,0) [0|255] "raw"  MDS
 SG_ ConsecutiveData2 m2 : 23|8@0+ (1,0) [0|255] "raw"  MDS
 SG_ SingleData2 m0 : 23|8@0+ (1,0) [0|255] "raw"  MDS
 SG_ SeparationTimeRaw m3 : 23|8@0+ (1,0) [0|255] "raw"  MDS
 SG_ UnknownData1 m4 : 15|8@0+ (1,0) [0|255] "raw"  MDS
 SG_ ConsecutiveData1 m2 : 15|8@0+ (1,0) [0|255] "raw"  MDS
 SG_ SingleData1 m0 : 15|8@0+ (1,0) [0|255] "raw"  MDS
 SG_ BlockSize m3 : 15|8@0+ (1,0) [0|255] "raw"  MDS
 SG_ UnknownPciLow m4 : 3|4@0+ (1,0) [0|15] "raw"  MDS
 SG_ FlowStatus m3 : 3|4@0+ (1,0) [0|15] "raw"  MDS
 SG_ ConsecutiveSequence m2 : 3|4@0+ (1,0) [0|15] "raw"  MDS
 SG_ FirstFrameLength m1 : 3|12@0+ (1,0) [0|4095] "raw"  MDS
 SG_ SingleFrameLength m0 : 3|4@0+ (1,0) [0|15] "raw"  MDS
 SG_ IsoTpFrameType M : 7|4@0+ (1,0) [0|15] ""  MDS

BO_ 1619 BSI_DiagResponse_13: 8 BSI
 SG_ FlowPadding5 m3 : 63|8@0+ (1,0) [0|255] "raw"  MDS
 SG_ FirstData6 m1 : 63|8@0+ (1,0) [0|255] "raw"  MDS
 SG_ UnknownData7 m4 : 63|8@0+ (1,0) [0|255] "raw"  MDS
 SG_ ConsecutiveData7 m2 : 63|8@0+ (1,0) [0|255] "raw"  MDS
 SG_ SingleData7 m0 : 63|8@0+ (1,0) [0|255] "raw"  MDS
 SG_ FlowPadding4 m3 : 55|8@0+ (1,0) [0|255] "raw"  MDS
 SG_ FirstData5 m1 : 55|8@0+ (1,0) [0|255] "raw"  MDS
 SG_ UnknownData6 m4 : 55|8@0+ (1,0) [0|255] "raw"  MDS
 SG_ ConsecutiveData6 m2 : 55|8@0+ (1,0) [0|255] "raw"  MDS
 SG_ SingleData6 m0 : 55|8@0+ (1,0) [0|255] "raw"  MDS
 SG_ FlowPadding3 m3 : 47|8@0+ (1,0) [0|255] "raw"  MDS
 SG_ FirstData4 m1 : 47|8@0+ (1,0) [0|255] "raw"  MDS
 SG_ UnknownData5 m4 : 47|8@0+ (1,0) [0|255] "raw"  MDS
 SG_ ConsecutiveData5 m2 : 47|8@0+ (1,0) [0|255] "raw"  MDS
 SG_ SingleData5 m0 : 47|8@0+ (1,0) [0|255] "raw"  MDS
 SG_ FlowPadding2 m3 : 39|8@0+ (1,0) [0|255] "raw"  MDS
 SG_ FirstData3 m1 : 39|8@0+ (1,0) [0|255] "raw"  MDS
 SG_ UnknownData4 m4 : 39|8@0+ (1,0) [0|255] "raw"  MDS
 SG_ ConsecutiveData4 m2 : 39|8@0+ (1,0) [0|255] "raw"  MDS
 SG_ SingleData4 m0 : 39|8@0+ (1,0) [0|255] "raw"  MDS
 SG_ FlowPadding1 m3 : 31|8@0+ (1,0) [0|255] "raw"  MDS
 SG_ FirstData2 m1 : 31|8@0+ (1,0) [0|255] "raw"  MDS
 SG_ UnknownData3 m4 : 31|8@0+ (1,0) [0|255] "raw"  MDS
 SG_ ConsecutiveData3 m2 : 31|8@0+ (1,0) [0|255] "raw"  MDS
 SG_ SingleData3 m0 : 31|8@0+ (1,0) [0|255] "raw"  MDS
 SG_ FirstData1 m1 : 23|8@0+ (1,0) [0|255] "raw"  MDS
 SG_ UnknownData2 m4 : 23|8@0+ (1,0) [0|255] "raw"  MDS
 SG_ ConsecutiveData2 m2 : 23|8@0+ (1,0) [0|255] "raw"  MDS
 SG_ SingleData2 m0 : 23|8@0+ (1,0) [0|255] "raw"  MDS
 SG_ SeparationTimeRaw m3 : 23|8@0+ (1,0) [0|255] "raw"  MDS
 SG_ UnknownData1 m4 : 15|8@0+ (1,0) [0|255] "raw"  MDS
 SG_ ConsecutiveData1 m2 : 15|8@0+ (1,0) [0|255] "raw"  MDS
 SG_ SingleData1 m0 : 15|8@0+ (1,0) [0|255] "raw"  MDS
 SG_ BlockSize m3 : 15|8@0+ (1,0) [0|255] "raw"  MDS
 SG_ UnknownPciLow m4 : 3|4@0+ (1,0) [0|15] "raw"  MDS
 SG_ FlowStatus m3 : 3|4@0+ (1,0) [0|15] "raw"  MDS
 SG_ ConsecutiveSequence m2 : 3|4@0+ (1,0) [0|15] "raw"  MDS
 SG_ FirstFrameLength m1 : 3|12@0+ (1,0) [0|4095] "raw"  MDS
 SG_ SingleFrameLength m0 : 3|4@0+ (1,0) [0|15] "raw"  MDS
 SG_ IsoTpFrameType M : 7|4@0+ (1,0) [0|15] ""  MDS

BO_ 1624 BSI_BopDiagResponse: 8 BSI
 SG_ DiagnosticData : 7|64@0+ (1,0) [0|18446744073709551615] ""  MDS

BO_ 1625 BSI_DiagResponse_14: 8 BSI
 SG_ FlowPadding5 m3 : 63|8@0+ (1,0) [0|255] "raw"  MDS
 SG_ FirstData6 m1 : 63|8@0+ (1,0) [0|255] "raw"  MDS
 SG_ UnknownData7 m4 : 63|8@0+ (1,0) [0|255] "raw"  MDS
 SG_ ConsecutiveData7 m2 : 63|8@0+ (1,0) [0|255] "raw"  MDS
 SG_ SingleData7 m0 : 63|8@0+ (1,0) [0|255] "raw"  MDS
 SG_ FlowPadding4 m3 : 55|8@0+ (1,0) [0|255] "raw"  MDS
 SG_ FirstData5 m1 : 55|8@0+ (1,0) [0|255] "raw"  MDS
 SG_ UnknownData6 m4 : 55|8@0+ (1,0) [0|255] "raw"  MDS
 SG_ ConsecutiveData6 m2 : 55|8@0+ (1,0) [0|255] "raw"  MDS
 SG_ SingleData6 m0 : 55|8@0+ (1,0) [0|255] "raw"  MDS
 SG_ FlowPadding3 m3 : 47|8@0+ (1,0) [0|255] "raw"  MDS
 SG_ FirstData4 m1 : 47|8@0+ (1,0) [0|255] "raw"  MDS
 SG_ UnknownData5 m4 : 47|8@0+ (1,0) [0|255] "raw"  MDS
 SG_ ConsecutiveData5 m2 : 47|8@0+ (1,0) [0|255] "raw"  MDS
 SG_ SingleData5 m0 : 47|8@0+ (1,0) [0|255] "raw"  MDS
 SG_ FlowPadding2 m3 : 39|8@0+ (1,0) [0|255] "raw"  MDS
 SG_ FirstData3 m1 : 39|8@0+ (1,0) [0|255] "raw"  MDS
 SG_ UnknownData4 m4 : 39|8@0+ (1,0) [0|255] "raw"  MDS
 SG_ ConsecutiveData4 m2 : 39|8@0+ (1,0) [0|255] "raw"  MDS
 SG_ SingleData4 m0 : 39|8@0+ (1,0) [0|255] "raw"  MDS
 SG_ FlowPadding1 m3 : 31|8@0+ (1,0) [0|255] "raw"  MDS
 SG_ FirstData2 m1 : 31|8@0+ (1,0) [0|255] "raw"  MDS
 SG_ UnknownData3 m4 : 31|8@0+ (1,0) [0|255] "raw"  MDS
 SG_ ConsecutiveData3 m2 : 31|8@0+ (1,0) [0|255] "raw"  MDS
 SG_ SingleData3 m0 : 31|8@0+ (1,0) [0|255] "raw"  MDS
 SG_ FirstData1 m1 : 23|8@0+ (1,0) [0|255] "raw"  MDS
 SG_ UnknownData2 m4 : 23|8@0+ (1,0) [0|255] "raw"  MDS
 SG_ ConsecutiveData2 m2 : 23|8@0+ (1,0) [0|255] "raw"  MDS
 SG_ SingleData2 m0 : 23|8@0+ (1,0) [0|255] "raw"  MDS
 SG_ SeparationTimeRaw m3 : 23|8@0+ (1,0) [0|255] "raw"  MDS
 SG_ UnknownData1 m4 : 15|8@0+ (1,0) [0|255] "raw"  MDS
 SG_ ConsecutiveData1 m2 : 15|8@0+ (1,0) [0|255] "raw"  MDS
 SG_ SingleData1 m0 : 15|8@0+ (1,0) [0|255] "raw"  MDS
 SG_ BlockSize m3 : 15|8@0+ (1,0) [0|255] "raw"  MDS
 SG_ UnknownPciLow m4 : 3|4@0+ (1,0) [0|15] "raw"  MDS
 SG_ FlowStatus m3 : 3|4@0+ (1,0) [0|15] "raw"  MDS
 SG_ ConsecutiveSequence m2 : 3|4@0+ (1,0) [0|15] "raw"  MDS
 SG_ FirstFrameLength m1 : 3|12@0+ (1,0) [0|4095] "raw"  MDS
 SG_ SingleFrameLength m0 : 3|4@0+ (1,0) [0|15] "raw"  MDS
 SG_ IsoTpFrameType M : 7|4@0+ (1,0) [0|15] ""  MDS

BO_ 1627 BSI_DiagResponse_15: 8 BSI
 SG_ FlowPadding5 m3 : 63|8@0+ (1,0) [0|255] "raw"  MDS
 SG_ FirstData6 m1 : 63|8@0+ (1,0) [0|255] "raw"  MDS
 SG_ UnknownData7 m4 : 63|8@0+ (1,0) [0|255] "raw"  MDS
 SG_ ConsecutiveData7 m2 : 63|8@0+ (1,0) [0|255] "raw"  MDS
 SG_ SingleData7 m0 : 63|8@0+ (1,0) [0|255] "raw"  MDS
 SG_ FlowPadding4 m3 : 55|8@0+ (1,0) [0|255] "raw"  MDS
 SG_ FirstData5 m1 : 55|8@0+ (1,0) [0|255] "raw"  MDS
 SG_ UnknownData6 m4 : 55|8@0+ (1,0) [0|255] "raw"  MDS
 SG_ ConsecutiveData6 m2 : 55|8@0+ (1,0) [0|255] "raw"  MDS
 SG_ SingleData6 m0 : 55|8@0+ (1,0) [0|255] "raw"  MDS
 SG_ FlowPadding3 m3 : 47|8@0+ (1,0) [0|255] "raw"  MDS
 SG_ FirstData4 m1 : 47|8@0+ (1,0) [0|255] "raw"  MDS
 SG_ UnknownData5 m4 : 47|8@0+ (1,0) [0|255] "raw"  MDS
 SG_ ConsecutiveData5 m2 : 47|8@0+ (1,0) [0|255] "raw"  MDS
 SG_ SingleData5 m0 : 47|8@0+ (1,0) [0|255] "raw"  MDS
 SG_ FlowPadding2 m3 : 39|8@0+ (1,0) [0|255] "raw"  MDS
 SG_ FirstData3 m1 : 39|8@0+ (1,0) [0|255] "raw"  MDS
 SG_ UnknownData4 m4 : 39|8@0+ (1,0) [0|255] "raw"  MDS
 SG_ ConsecutiveData4 m2 : 39|8@0+ (1,0) [0|255] "raw"  MDS
 SG_ SingleData4 m0 : 39|8@0+ (1,0) [0|255] "raw"  MDS
 SG_ FlowPadding1 m3 : 31|8@0+ (1,0) [0|255] "raw"  MDS
 SG_ FirstData2 m1 : 31|8@0+ (1,0) [0|255] "raw"  MDS
 SG_ UnknownData3 m4 : 31|8@0+ (1,0) [0|255] "raw"  MDS
 SG_ ConsecutiveData3 m2 : 31|8@0+ (1,0) [0|255] "raw"  MDS
 SG_ SingleData3 m0 : 31|8@0+ (1,0) [0|255] "raw"  MDS
 SG_ FirstData1 m1 : 23|8@0+ (1,0) [0|255] "raw"  MDS
 SG_ UnknownData2 m4 : 23|8@0+ (1,0) [0|255] "raw"  MDS
 SG_ ConsecutiveData2 m2 : 23|8@0+ (1,0) [0|255] "raw"  MDS
 SG_ SingleData2 m0 : 23|8@0+ (1,0) [0|255] "raw"  MDS
 SG_ SeparationTimeRaw m3 : 23|8@0+ (1,0) [0|255] "raw"  MDS
 SG_ UnknownData1 m4 : 15|8@0+ (1,0) [0|255] "raw"  MDS
 SG_ ConsecutiveData1 m2 : 15|8@0+ (1,0) [0|255] "raw"  MDS
 SG_ SingleData1 m0 : 15|8@0+ (1,0) [0|255] "raw"  MDS
 SG_ BlockSize m3 : 15|8@0+ (1,0) [0|255] "raw"  MDS
 SG_ UnknownPciLow m4 : 3|4@0+ (1,0) [0|15] "raw"  MDS
 SG_ FlowStatus m3 : 3|4@0+ (1,0) [0|15] "raw"  MDS
 SG_ ConsecutiveSequence m2 : 3|4@0+ (1,0) [0|15] "raw"  MDS
 SG_ FirstFrameLength m1 : 3|12@0+ (1,0) [0|4095] "raw"  MDS
 SG_ SingleFrameLength m0 : 3|4@0+ (1,0) [0|15] "raw"  MDS
 SG_ IsoTpFrameType M : 7|4@0+ (1,0) [0|15] ""  MDS

BO_ 1628 BSI_DiagResponse_16: 8 BSI
 SG_ FlowPadding5 m3 : 63|8@0+ (1,0) [0|255] "raw"  MDS
 SG_ FirstData6 m1 : 63|8@0+ (1,0) [0|255] "raw"  MDS
 SG_ UnknownData7 m4 : 63|8@0+ (1,0) [0|255] "raw"  MDS
 SG_ ConsecutiveData7 m2 : 63|8@0+ (1,0) [0|255] "raw"  MDS
 SG_ SingleData7 m0 : 63|8@0+ (1,0) [0|255] "raw"  MDS
 SG_ FlowPadding4 m3 : 55|8@0+ (1,0) [0|255] "raw"  MDS
 SG_ FirstData5 m1 : 55|8@0+ (1,0) [0|255] "raw"  MDS
 SG_ UnknownData6 m4 : 55|8@0+ (1,0) [0|255] "raw"  MDS
 SG_ ConsecutiveData6 m2 : 55|8@0+ (1,0) [0|255] "raw"  MDS
 SG_ SingleData6 m0 : 55|8@0+ (1,0) [0|255] "raw"  MDS
 SG_ FlowPadding3 m3 : 47|8@0+ (1,0) [0|255] "raw"  MDS
 SG_ FirstData4 m1 : 47|8@0+ (1,0) [0|255] "raw"  MDS
 SG_ UnknownData5 m4 : 47|8@0+ (1,0) [0|255] "raw"  MDS
 SG_ ConsecutiveData5 m2 : 47|8@0+ (1,0) [0|255] "raw"  MDS
 SG_ SingleData5 m0 : 47|8@0+ (1,0) [0|255] "raw"  MDS
 SG_ FlowPadding2 m3 : 39|8@0+ (1,0) [0|255] "raw"  MDS
 SG_ FirstData3 m1 : 39|8@0+ (1,0) [0|255] "raw"  MDS
 SG_ UnknownData4 m4 : 39|8@0+ (1,0) [0|255] "raw"  MDS
 SG_ ConsecutiveData4 m2 : 39|8@0+ (1,0) [0|255] "raw"  MDS
 SG_ SingleData4 m0 : 39|8@0+ (1,0) [0|255] "raw"  MDS
 SG_ FlowPadding1 m3 : 31|8@0+ (1,0) [0|255] "raw"  MDS
 SG_ FirstData2 m1 : 31|8@0+ (1,0) [0|255] "raw"  MDS
 SG_ UnknownData3 m4 : 31|8@0+ (1,0) [0|255] "raw"  MDS
 SG_ ConsecutiveData3 m2 : 31|8@0+ (1,0) [0|255] "raw"  MDS
 SG_ SingleData3 m0 : 31|8@0+ (1,0) [0|255] "raw"  MDS
 SG_ FirstData1 m1 : 23|8@0+ (1,0) [0|255] "raw"  MDS
 SG_ UnknownData2 m4 : 23|8@0+ (1,0) [0|255] "raw"  MDS
 SG_ ConsecutiveData2 m2 : 23|8@0+ (1,0) [0|255] "raw"  MDS
 SG_ SingleData2 m0 : 23|8@0+ (1,0) [0|255] "raw"  MDS
 SG_ SeparationTimeRaw m3 : 23|8@0+ (1,0) [0|255] "raw"  MDS
 SG_ UnknownData1 m4 : 15|8@0+ (1,0) [0|255] "raw"  MDS
 SG_ ConsecutiveData1 m2 : 15|8@0+ (1,0) [0|255] "raw"  MDS
 SG_ SingleData1 m0 : 15|8@0+ (1,0) [0|255] "raw"  MDS
 SG_ BlockSize m3 : 15|8@0+ (1,0) [0|255] "raw"  MDS
 SG_ UnknownPciLow m4 : 3|4@0+ (1,0) [0|15] "raw"  MDS
 SG_ FlowStatus m3 : 3|4@0+ (1,0) [0|15] "raw"  MDS
 SG_ ConsecutiveSequence m2 : 3|4@0+ (1,0) [0|15] "raw"  MDS
 SG_ FirstFrameLength m1 : 3|12@0+ (1,0) [0|4095] "raw"  MDS
 SG_ SingleFrameLength m0 : 3|4@0+ (1,0) [0|15] "raw"  MDS
 SG_ IsoTpFrameType M : 7|4@0+ (1,0) [0|15] ""  MDS

BO_ 1629 AAS_DiagResponse: 8 AAS
 SG_ FlowPadding5 m3 : 63|8@0+ (1,0) [0|255] "raw"  BSI,MDS
 SG_ FirstData6 m1 : 63|8@0+ (1,0) [0|255] "raw"  BSI,MDS
 SG_ UnknownData7 m4 : 63|8@0+ (1,0) [0|255] "raw"  BSI,MDS
 SG_ ConsecutiveData7 m2 : 63|8@0+ (1,0) [0|255] "raw"  BSI,MDS
 SG_ SingleData7 m0 : 63|8@0+ (1,0) [0|255] "raw"  BSI,MDS
 SG_ FlowPadding4 m3 : 55|8@0+ (1,0) [0|255] "raw"  BSI,MDS
 SG_ FirstData5 m1 : 55|8@0+ (1,0) [0|255] "raw"  BSI,MDS
 SG_ UnknownData6 m4 : 55|8@0+ (1,0) [0|255] "raw"  BSI,MDS
 SG_ ConsecutiveData6 m2 : 55|8@0+ (1,0) [0|255] "raw"  BSI,MDS
 SG_ SingleData6 m0 : 55|8@0+ (1,0) [0|255] "raw"  BSI,MDS
 SG_ FlowPadding3 m3 : 47|8@0+ (1,0) [0|255] "raw"  BSI,MDS
 SG_ FirstData4 m1 : 47|8@0+ (1,0) [0|255] "raw"  BSI,MDS
 SG_ UnknownData5 m4 : 47|8@0+ (1,0) [0|255] "raw"  BSI,MDS
 SG_ ConsecutiveData5 m2 : 47|8@0+ (1,0) [0|255] "raw"  BSI,MDS
 SG_ SingleData5 m0 : 47|8@0+ (1,0) [0|255] "raw"  BSI,MDS
 SG_ FlowPadding2 m3 : 39|8@0+ (1,0) [0|255] "raw"  BSI,MDS
 SG_ FirstData3 m1 : 39|8@0+ (1,0) [0|255] "raw"  BSI,MDS
 SG_ UnknownData4 m4 : 39|8@0+ (1,0) [0|255] "raw"  BSI,MDS
 SG_ ConsecutiveData4 m2 : 39|8@0+ (1,0) [0|255] "raw"  BSI,MDS
 SG_ SingleData4 m0 : 39|8@0+ (1,0) [0|255] "raw"  BSI,MDS
 SG_ FlowPadding1 m3 : 31|8@0+ (1,0) [0|255] "raw"  BSI,MDS
 SG_ FirstData2 m1 : 31|8@0+ (1,0) [0|255] "raw"  BSI,MDS
 SG_ UnknownData3 m4 : 31|8@0+ (1,0) [0|255] "raw"  BSI,MDS
 SG_ ConsecutiveData3 m2 : 31|8@0+ (1,0) [0|255] "raw"  BSI,MDS
 SG_ SingleData3 m0 : 31|8@0+ (1,0) [0|255] "raw"  BSI,MDS
 SG_ FirstData1 m1 : 23|8@0+ (1,0) [0|255] "raw"  BSI,MDS
 SG_ UnknownData2 m4 : 23|8@0+ (1,0) [0|255] "raw"  BSI,MDS
 SG_ ConsecutiveData2 m2 : 23|8@0+ (1,0) [0|255] "raw"  BSI,MDS
 SG_ SingleData2 m0 : 23|8@0+ (1,0) [0|255] "raw"  BSI,MDS
 SG_ SeparationTimeRaw m3 : 23|8@0+ (1,0) [0|255] "raw"  BSI,MDS
 SG_ UnknownData1 m4 : 15|8@0+ (1,0) [0|255] "raw"  BSI,MDS
 SG_ ConsecutiveData1 m2 : 15|8@0+ (1,0) [0|255] "raw"  BSI,MDS
 SG_ SingleData1 m0 : 15|8@0+ (1,0) [0|255] "raw"  BSI,MDS
 SG_ BlockSize m3 : 15|8@0+ (1,0) [0|255] "raw"  BSI,MDS
 SG_ UnknownPciLow m4 : 3|4@0+ (1,0) [0|15] "raw"  BSI,MDS
 SG_ FlowStatus m3 : 3|4@0+ (1,0) [0|15] "raw"  BSI,MDS
 SG_ ConsecutiveSequence m2 : 3|4@0+ (1,0) [0|15] "raw"  BSI,MDS
 SG_ FirstFrameLength m1 : 3|12@0+ (1,0) [0|4095] "raw"  BSI,MDS
 SG_ SingleFrameLength m0 : 3|4@0+ (1,0) [0|15] "raw"  BSI,MDS
 SG_ IsoTpFrameType M : 7|4@0+ (1,0) [0|15] ""  BSI,MDS

BO_ 1630 BSI_DiagResponse_17: 8 BSI
 SG_ FlowPadding5 m3 : 63|8@0+ (1,0) [0|255] "raw"  MDS
 SG_ FirstData6 m1 : 63|8@0+ (1,0) [0|255] "raw"  MDS
 SG_ UnknownData7 m4 : 63|8@0+ (1,0) [0|255] "raw"  MDS
 SG_ ConsecutiveData7 m2 : 63|8@0+ (1,0) [0|255] "raw"  MDS
 SG_ SingleData7 m0 : 63|8@0+ (1,0) [0|255] "raw"  MDS
 SG_ FlowPadding4 m3 : 55|8@0+ (1,0) [0|255] "raw"  MDS
 SG_ FirstData5 m1 : 55|8@0+ (1,0) [0|255] "raw"  MDS
 SG_ UnknownData6 m4 : 55|8@0+ (1,0) [0|255] "raw"  MDS
 SG_ ConsecutiveData6 m2 : 55|8@0+ (1,0) [0|255] "raw"  MDS
 SG_ SingleData6 m0 : 55|8@0+ (1,0) [0|255] "raw"  MDS
 SG_ FlowPadding3 m3 : 47|8@0+ (1,0) [0|255] "raw"  MDS
 SG_ FirstData4 m1 : 47|8@0+ (1,0) [0|255] "raw"  MDS
 SG_ UnknownData5 m4 : 47|8@0+ (1,0) [0|255] "raw"  MDS
 SG_ ConsecutiveData5 m2 : 47|8@0+ (1,0) [0|255] "raw"  MDS
 SG_ SingleData5 m0 : 47|8@0+ (1,0) [0|255] "raw"  MDS
 SG_ FlowPadding2 m3 : 39|8@0+ (1,0) [0|255] "raw"  MDS
 SG_ FirstData3 m1 : 39|8@0+ (1,0) [0|255] "raw"  MDS
 SG_ UnknownData4 m4 : 39|8@0+ (1,0) [0|255] "raw"  MDS
 SG_ ConsecutiveData4 m2 : 39|8@0+ (1,0) [0|255] "raw"  MDS
 SG_ SingleData4 m0 : 39|8@0+ (1,0) [0|255] "raw"  MDS
 SG_ FlowPadding1 m3 : 31|8@0+ (1,0) [0|255] "raw"  MDS
 SG_ FirstData2 m1 : 31|8@0+ (1,0) [0|255] "raw"  MDS
 SG_ UnknownData3 m4 : 31|8@0+ (1,0) [0|255] "raw"  MDS
 SG_ ConsecutiveData3 m2 : 31|8@0+ (1,0) [0|255] "raw"  MDS
 SG_ SingleData3 m0 : 31|8@0+ (1,0) [0|255] "raw"  MDS
 SG_ FirstData1 m1 : 23|8@0+ (1,0) [0|255] "raw"  MDS
 SG_ UnknownData2 m4 : 23|8@0+ (1,0) [0|255] "raw"  MDS
 SG_ ConsecutiveData2 m2 : 23|8@0+ (1,0) [0|255] "raw"  MDS
 SG_ SingleData2 m0 : 23|8@0+ (1,0) [0|255] "raw"  MDS
 SG_ SeparationTimeRaw m3 : 23|8@0+ (1,0) [0|255] "raw"  MDS
 SG_ UnknownData1 m4 : 15|8@0+ (1,0) [0|255] "raw"  MDS
 SG_ ConsecutiveData1 m2 : 15|8@0+ (1,0) [0|255] "raw"  MDS
 SG_ SingleData1 m0 : 15|8@0+ (1,0) [0|255] "raw"  MDS
 SG_ BlockSize m3 : 15|8@0+ (1,0) [0|255] "raw"  MDS
 SG_ UnknownPciLow m4 : 3|4@0+ (1,0) [0|15] "raw"  MDS
 SG_ FlowStatus m3 : 3|4@0+ (1,0) [0|15] "raw"  MDS
 SG_ ConsecutiveSequence m2 : 3|4@0+ (1,0) [0|15] "raw"  MDS
 SG_ FirstFrameLength m1 : 3|12@0+ (1,0) [0|4095] "raw"  MDS
 SG_ SingleFrameLength m0 : 3|4@0+ (1,0) [0|15] "raw"  MDS
 SG_ IsoTpFrameType M : 7|4@0+ (1,0) [0|15] ""  MDS

BO_ 1631 CMB_DiagResponse: 8 CMB
 SG_ FlowPadding5 m3 : 63|8@0+ (1,0) [0|255] "raw"  BSI,MDS
 SG_ FirstData6 m1 : 63|8@0+ (1,0) [0|255] "raw"  BSI,MDS
 SG_ UnknownData7 m4 : 63|8@0+ (1,0) [0|255] "raw"  BSI,MDS
 SG_ ConsecutiveData7 m2 : 63|8@0+ (1,0) [0|255] "raw"  BSI,MDS
 SG_ SingleData7 m0 : 63|8@0+ (1,0) [0|255] "raw"  BSI,MDS
 SG_ FlowPadding4 m3 : 55|8@0+ (1,0) [0|255] "raw"  BSI,MDS
 SG_ FirstData5 m1 : 55|8@0+ (1,0) [0|255] "raw"  BSI,MDS
 SG_ UnknownData6 m4 : 55|8@0+ (1,0) [0|255] "raw"  BSI,MDS
 SG_ ConsecutiveData6 m2 : 55|8@0+ (1,0) [0|255] "raw"  BSI,MDS
 SG_ SingleData6 m0 : 55|8@0+ (1,0) [0|255] "raw"  BSI,MDS
 SG_ FlowPadding3 m3 : 47|8@0+ (1,0) [0|255] "raw"  BSI,MDS
 SG_ FirstData4 m1 : 47|8@0+ (1,0) [0|255] "raw"  BSI,MDS
 SG_ UnknownData5 m4 : 47|8@0+ (1,0) [0|255] "raw"  BSI,MDS
 SG_ ConsecutiveData5 m2 : 47|8@0+ (1,0) [0|255] "raw"  BSI,MDS
 SG_ SingleData5 m0 : 47|8@0+ (1,0) [0|255] "raw"  BSI,MDS
 SG_ FlowPadding2 m3 : 39|8@0+ (1,0) [0|255] "raw"  BSI,MDS
 SG_ FirstData3 m1 : 39|8@0+ (1,0) [0|255] "raw"  BSI,MDS
 SG_ UnknownData4 m4 : 39|8@0+ (1,0) [0|255] "raw"  BSI,MDS
 SG_ ConsecutiveData4 m2 : 39|8@0+ (1,0) [0|255] "raw"  BSI,MDS
 SG_ SingleData4 m0 : 39|8@0+ (1,0) [0|255] "raw"  BSI,MDS
 SG_ FlowPadding1 m3 : 31|8@0+ (1,0) [0|255] "raw"  BSI,MDS
 SG_ FirstData2 m1 : 31|8@0+ (1,0) [0|255] "raw"  BSI,MDS
 SG_ UnknownData3 m4 : 31|8@0+ (1,0) [0|255] "raw"  BSI,MDS
 SG_ ConsecutiveData3 m2 : 31|8@0+ (1,0) [0|255] "raw"  BSI,MDS
 SG_ SingleData3 m0 : 31|8@0+ (1,0) [0|255] "raw"  BSI,MDS
 SG_ FirstData1 m1 : 23|8@0+ (1,0) [0|255] "raw"  BSI,MDS
 SG_ UnknownData2 m4 : 23|8@0+ (1,0) [0|255] "raw"  BSI,MDS
 SG_ ConsecutiveData2 m2 : 23|8@0+ (1,0) [0|255] "raw"  BSI,MDS
 SG_ SingleData2 m0 : 23|8@0+ (1,0) [0|255] "raw"  BSI,MDS
 SG_ SeparationTimeRaw m3 : 23|8@0+ (1,0) [0|255] "raw"  BSI,MDS
 SG_ UnknownData1 m4 : 15|8@0+ (1,0) [0|255] "raw"  BSI,MDS
 SG_ ConsecutiveData1 m2 : 15|8@0+ (1,0) [0|255] "raw"  BSI,MDS
 SG_ SingleData1 m0 : 15|8@0+ (1,0) [0|255] "raw"  BSI,MDS
 SG_ BlockSize m3 : 15|8@0+ (1,0) [0|255] "raw"  BSI,MDS
 SG_ UnknownPciLow m4 : 3|4@0+ (1,0) [0|15] "raw"  BSI,MDS
 SG_ FlowStatus m3 : 3|4@0+ (1,0) [0|15] "raw"  BSI,MDS
 SG_ ConsecutiveSequence m2 : 3|4@0+ (1,0) [0|15] "raw"  BSI,MDS
 SG_ FirstFrameLength m1 : 3|12@0+ (1,0) [0|4095] "raw"  BSI,MDS
 SG_ SingleFrameLength m0 : 3|4@0+ (1,0) [0|15] "raw"  BSI,MDS
 SG_ IsoTpFrameType M : 7|4@0+ (1,0) [0|15] ""  BSI,MDS

BO_ 1632 BTEL_DiagResponse: 8 BTEL
 SG_ FlowPadding5 m3 : 63|8@0+ (1,0) [0|255] "raw"  MDS,BSI
 SG_ FirstData6 m1 : 63|8@0+ (1,0) [0|255] "raw"  MDS,BSI
 SG_ UnknownData7 m4 : 63|8@0+ (1,0) [0|255] "raw"  MDS,BSI
 SG_ ConsecutiveData7 m2 : 63|8@0+ (1,0) [0|255] "raw"  MDS,BSI
 SG_ SingleData7 m0 : 63|8@0+ (1,0) [0|255] "raw"  MDS,BSI
 SG_ FlowPadding4 m3 : 55|8@0+ (1,0) [0|255] "raw"  MDS,BSI
 SG_ FirstData5 m1 : 55|8@0+ (1,0) [0|255] "raw"  MDS,BSI
 SG_ UnknownData6 m4 : 55|8@0+ (1,0) [0|255] "raw"  MDS,BSI
 SG_ ConsecutiveData6 m2 : 55|8@0+ (1,0) [0|255] "raw"  MDS,BSI
 SG_ SingleData6 m0 : 55|8@0+ (1,0) [0|255] "raw"  MDS,BSI
 SG_ FlowPadding3 m3 : 47|8@0+ (1,0) [0|255] "raw"  MDS,BSI
 SG_ FirstData4 m1 : 47|8@0+ (1,0) [0|255] "raw"  MDS,BSI
 SG_ UnknownData5 m4 : 47|8@0+ (1,0) [0|255] "raw"  MDS,BSI
 SG_ ConsecutiveData5 m2 : 47|8@0+ (1,0) [0|255] "raw"  MDS,BSI
 SG_ SingleData5 m0 : 47|8@0+ (1,0) [0|255] "raw"  MDS,BSI
 SG_ FlowPadding2 m3 : 39|8@0+ (1,0) [0|255] "raw"  MDS,BSI
 SG_ FirstData3 m1 : 39|8@0+ (1,0) [0|255] "raw"  MDS,BSI
 SG_ UnknownData4 m4 : 39|8@0+ (1,0) [0|255] "raw"  MDS,BSI
 SG_ ConsecutiveData4 m2 : 39|8@0+ (1,0) [0|255] "raw"  MDS,BSI
 SG_ SingleData4 m0 : 39|8@0+ (1,0) [0|255] "raw"  MDS,BSI
 SG_ FlowPadding1 m3 : 31|8@0+ (1,0) [0|255] "raw"  MDS,BSI
 SG_ FirstData2 m1 : 31|8@0+ (1,0) [0|255] "raw"  MDS,BSI
 SG_ UnknownData3 m4 : 31|8@0+ (1,0) [0|255] "raw"  MDS,BSI
 SG_ ConsecutiveData3 m2 : 31|8@0+ (1,0) [0|255] "raw"  MDS,BSI
 SG_ SingleData3 m0 : 31|8@0+ (1,0) [0|255] "raw"  MDS,BSI
 SG_ FirstData1 m1 : 23|8@0+ (1,0) [0|255] "raw"  MDS,BSI
 SG_ UnknownData2 m4 : 23|8@0+ (1,0) [0|255] "raw"  MDS,BSI
 SG_ ConsecutiveData2 m2 : 23|8@0+ (1,0) [0|255] "raw"  MDS,BSI
 SG_ SingleData2 m0 : 23|8@0+ (1,0) [0|255] "raw"  MDS,BSI
 SG_ SeparationTimeRaw m3 : 23|8@0+ (1,0) [0|255] "raw"  MDS,BSI
 SG_ UnknownData1 m4 : 15|8@0+ (1,0) [0|255] "raw"  MDS,BSI
 SG_ ConsecutiveData1 m2 : 15|8@0+ (1,0) [0|255] "raw"  MDS,BSI
 SG_ SingleData1 m0 : 15|8@0+ (1,0) [0|255] "raw"  MDS,BSI
 SG_ BlockSize m3 : 15|8@0+ (1,0) [0|255] "raw"  MDS,BSI
 SG_ UnknownPciLow m4 : 3|4@0+ (1,0) [0|15] "raw"  MDS,BSI
 SG_ FlowStatus m3 : 3|4@0+ (1,0) [0|15] "raw"  MDS,BSI
 SG_ ConsecutiveSequence m2 : 3|4@0+ (1,0) [0|15] "raw"  MDS,BSI
 SG_ FirstFrameLength m1 : 3|12@0+ (1,0) [0|4095] "raw"  MDS,BSI
 SG_ SingleFrameLength m0 : 3|4@0+ (1,0) [0|15] "raw"  MDS,BSI
 SG_ IsoTpFrameType M : 7|4@0+ (1,0) [0|15] ""  MDS,BSI

BO_ 1633 BSI_DiagResponse_18: 8 BSI
 SG_ FlowPadding5 m3 : 63|8@0+ (1,0) [0|255] "raw"  MDS
 SG_ FirstData6 m1 : 63|8@0+ (1,0) [0|255] "raw"  MDS
 SG_ UnknownData7 m4 : 63|8@0+ (1,0) [0|255] "raw"  MDS
 SG_ ConsecutiveData7 m2 : 63|8@0+ (1,0) [0|255] "raw"  MDS
 SG_ SingleData7 m0 : 63|8@0+ (1,0) [0|255] "raw"  MDS
 SG_ FlowPadding4 m3 : 55|8@0+ (1,0) [0|255] "raw"  MDS
 SG_ FirstData5 m1 : 55|8@0+ (1,0) [0|255] "raw"  MDS
 SG_ UnknownData6 m4 : 55|8@0+ (1,0) [0|255] "raw"  MDS
 SG_ ConsecutiveData6 m2 : 55|8@0+ (1,0) [0|255] "raw"  MDS
 SG_ SingleData6 m0 : 55|8@0+ (1,0) [0|255] "raw"  MDS
 SG_ FlowPadding3 m3 : 47|8@0+ (1,0) [0|255] "raw"  MDS
 SG_ FirstData4 m1 : 47|8@0+ (1,0) [0|255] "raw"  MDS
 SG_ UnknownData5 m4 : 47|8@0+ (1,0) [0|255] "raw"  MDS
 SG_ ConsecutiveData5 m2 : 47|8@0+ (1,0) [0|255] "raw"  MDS
 SG_ SingleData5 m0 : 47|8@0+ (1,0) [0|255] "raw"  MDS
 SG_ FlowPadding2 m3 : 39|8@0+ (1,0) [0|255] "raw"  MDS
 SG_ FirstData3 m1 : 39|8@0+ (1,0) [0|255] "raw"  MDS
 SG_ UnknownData4 m4 : 39|8@0+ (1,0) [0|255] "raw"  MDS
 SG_ ConsecutiveData4 m2 : 39|8@0+ (1,0) [0|255] "raw"  MDS
 SG_ SingleData4 m0 : 39|8@0+ (1,0) [0|255] "raw"  MDS
 SG_ FlowPadding1 m3 : 31|8@0+ (1,0) [0|255] "raw"  MDS
 SG_ FirstData2 m1 : 31|8@0+ (1,0) [0|255] "raw"  MDS
 SG_ UnknownData3 m4 : 31|8@0+ (1,0) [0|255] "raw"  MDS
 SG_ ConsecutiveData3 m2 : 31|8@0+ (1,0) [0|255] "raw"  MDS
 SG_ SingleData3 m0 : 31|8@0+ (1,0) [0|255] "raw"  MDS
 SG_ FirstData1 m1 : 23|8@0+ (1,0) [0|255] "raw"  MDS
 SG_ UnknownData2 m4 : 23|8@0+ (1,0) [0|255] "raw"  MDS
 SG_ ConsecutiveData2 m2 : 23|8@0+ (1,0) [0|255] "raw"  MDS
 SG_ SingleData2 m0 : 23|8@0+ (1,0) [0|255] "raw"  MDS
 SG_ SeparationTimeRaw m3 : 23|8@0+ (1,0) [0|255] "raw"  MDS
 SG_ UnknownData1 m4 : 15|8@0+ (1,0) [0|255] "raw"  MDS
 SG_ ConsecutiveData1 m2 : 15|8@0+ (1,0) [0|255] "raw"  MDS
 SG_ SingleData1 m0 : 15|8@0+ (1,0) [0|255] "raw"  MDS
 SG_ BlockSize m3 : 15|8@0+ (1,0) [0|255] "raw"  MDS
 SG_ UnknownPciLow m4 : 3|4@0+ (1,0) [0|15] "raw"  MDS
 SG_ FlowStatus m3 : 3|4@0+ (1,0) [0|15] "raw"  MDS
 SG_ ConsecutiveSequence m2 : 3|4@0+ (1,0) [0|15] "raw"  MDS
 SG_ FirstFrameLength m1 : 3|12@0+ (1,0) [0|4095] "raw"  MDS
 SG_ SingleFrameLength m0 : 3|4@0+ (1,0) [0|15] "raw"  MDS
 SG_ IsoTpFrameType M : 7|4@0+ (1,0) [0|15] ""  MDS

BO_ 1634 BSI_DiagResponse_19: 8 BSI
 SG_ FlowPadding5 m3 : 63|8@0+ (1,0) [0|255] "raw"  MDS
 SG_ FirstData6 m1 : 63|8@0+ (1,0) [0|255] "raw"  MDS
 SG_ UnknownData7 m4 : 63|8@0+ (1,0) [0|255] "raw"  MDS
 SG_ ConsecutiveData7 m2 : 63|8@0+ (1,0) [0|255] "raw"  MDS
 SG_ SingleData7 m0 : 63|8@0+ (1,0) [0|255] "raw"  MDS
 SG_ FlowPadding4 m3 : 55|8@0+ (1,0) [0|255] "raw"  MDS
 SG_ FirstData5 m1 : 55|8@0+ (1,0) [0|255] "raw"  MDS
 SG_ UnknownData6 m4 : 55|8@0+ (1,0) [0|255] "raw"  MDS
 SG_ ConsecutiveData6 m2 : 55|8@0+ (1,0) [0|255] "raw"  MDS
 SG_ SingleData6 m0 : 55|8@0+ (1,0) [0|255] "raw"  MDS
 SG_ FlowPadding3 m3 : 47|8@0+ (1,0) [0|255] "raw"  MDS
 SG_ FirstData4 m1 : 47|8@0+ (1,0) [0|255] "raw"  MDS
 SG_ UnknownData5 m4 : 47|8@0+ (1,0) [0|255] "raw"  MDS
 SG_ ConsecutiveData5 m2 : 47|8@0+ (1,0) [0|255] "raw"  MDS
 SG_ SingleData5 m0 : 47|8@0+ (1,0) [0|255] "raw"  MDS
 SG_ FlowPadding2 m3 : 39|8@0+ (1,0) [0|255] "raw"  MDS
 SG_ FirstData3 m1 : 39|8@0+ (1,0) [0|255] "raw"  MDS
 SG_ UnknownData4 m4 : 39|8@0+ (1,0) [0|255] "raw"  MDS
 SG_ ConsecutiveData4 m2 : 39|8@0+ (1,0) [0|255] "raw"  MDS
 SG_ SingleData4 m0 : 39|8@0+ (1,0) [0|255] "raw"  MDS
 SG_ FlowPadding1 m3 : 31|8@0+ (1,0) [0|255] "raw"  MDS
 SG_ FirstData2 m1 : 31|8@0+ (1,0) [0|255] "raw"  MDS
 SG_ UnknownData3 m4 : 31|8@0+ (1,0) [0|255] "raw"  MDS
 SG_ ConsecutiveData3 m2 : 31|8@0+ (1,0) [0|255] "raw"  MDS
 SG_ SingleData3 m0 : 31|8@0+ (1,0) [0|255] "raw"  MDS
 SG_ FirstData1 m1 : 23|8@0+ (1,0) [0|255] "raw"  MDS
 SG_ UnknownData2 m4 : 23|8@0+ (1,0) [0|255] "raw"  MDS
 SG_ ConsecutiveData2 m2 : 23|8@0+ (1,0) [0|255] "raw"  MDS
 SG_ SingleData2 m0 : 23|8@0+ (1,0) [0|255] "raw"  MDS
 SG_ SeparationTimeRaw m3 : 23|8@0+ (1,0) [0|255] "raw"  MDS
 SG_ UnknownData1 m4 : 15|8@0+ (1,0) [0|255] "raw"  MDS
 SG_ ConsecutiveData1 m2 : 15|8@0+ (1,0) [0|255] "raw"  MDS
 SG_ SingleData1 m0 : 15|8@0+ (1,0) [0|255] "raw"  MDS
 SG_ BlockSize m3 : 15|8@0+ (1,0) [0|255] "raw"  MDS
 SG_ UnknownPciLow m4 : 3|4@0+ (1,0) [0|15] "raw"  MDS
 SG_ FlowStatus m3 : 3|4@0+ (1,0) [0|15] "raw"  MDS
 SG_ ConsecutiveSequence m2 : 3|4@0+ (1,0) [0|15] "raw"  MDS
 SG_ FirstFrameLength m1 : 3|12@0+ (1,0) [0|4095] "raw"  MDS
 SG_ SingleFrameLength m0 : 3|4@0+ (1,0) [0|15] "raw"  MDS
 SG_ IsoTpFrameType M : 7|4@0+ (1,0) [0|15] ""  MDS

BO_ 1635 IDVR_DiagResponse: 8 IDVR
 SG_ FlowPadding5 m3 : 63|8@0+ (1,0) [0|255] "raw"  MDS,BSI
 SG_ FirstData6 m1 : 63|8@0+ (1,0) [0|255] "raw"  MDS,BSI
 SG_ UnknownData7 m4 : 63|8@0+ (1,0) [0|255] "raw"  MDS,BSI
 SG_ ConsecutiveData7 m2 : 63|8@0+ (1,0) [0|255] "raw"  MDS,BSI
 SG_ SingleData7 m0 : 63|8@0+ (1,0) [0|255] "raw"  MDS,BSI
 SG_ FlowPadding4 m3 : 55|8@0+ (1,0) [0|255] "raw"  MDS,BSI
 SG_ FirstData5 m1 : 55|8@0+ (1,0) [0|255] "raw"  MDS,BSI
 SG_ UnknownData6 m4 : 55|8@0+ (1,0) [0|255] "raw"  MDS,BSI
 SG_ ConsecutiveData6 m2 : 55|8@0+ (1,0) [0|255] "raw"  MDS,BSI
 SG_ SingleData6 m0 : 55|8@0+ (1,0) [0|255] "raw"  MDS,BSI
 SG_ FlowPadding3 m3 : 47|8@0+ (1,0) [0|255] "raw"  MDS,BSI
 SG_ FirstData4 m1 : 47|8@0+ (1,0) [0|255] "raw"  MDS,BSI
 SG_ UnknownData5 m4 : 47|8@0+ (1,0) [0|255] "raw"  MDS,BSI
 SG_ ConsecutiveData5 m2 : 47|8@0+ (1,0) [0|255] "raw"  MDS,BSI
 SG_ SingleData5 m0 : 47|8@0+ (1,0) [0|255] "raw"  MDS,BSI
 SG_ FlowPadding2 m3 : 39|8@0+ (1,0) [0|255] "raw"  MDS,BSI
 SG_ FirstData3 m1 : 39|8@0+ (1,0) [0|255] "raw"  MDS,BSI
 SG_ UnknownData4 m4 : 39|8@0+ (1,0) [0|255] "raw"  MDS,BSI
 SG_ ConsecutiveData4 m2 : 39|8@0+ (1,0) [0|255] "raw"  MDS,BSI
 SG_ SingleData4 m0 : 39|8@0+ (1,0) [0|255] "raw"  MDS,BSI
 SG_ FlowPadding1 m3 : 31|8@0+ (1,0) [0|255] "raw"  MDS,BSI
 SG_ FirstData2 m1 : 31|8@0+ (1,0) [0|255] "raw"  MDS,BSI
 SG_ UnknownData3 m4 : 31|8@0+ (1,0) [0|255] "raw"  MDS,BSI
 SG_ ConsecutiveData3 m2 : 31|8@0+ (1,0) [0|255] "raw"  MDS,BSI
 SG_ SingleData3 m0 : 31|8@0+ (1,0) [0|255] "raw"  MDS,BSI
 SG_ FirstData1 m1 : 23|8@0+ (1,0) [0|255] "raw"  MDS,BSI
 SG_ UnknownData2 m4 : 23|8@0+ (1,0) [0|255] "raw"  MDS,BSI
 SG_ ConsecutiveData2 m2 : 23|8@0+ (1,0) [0|255] "raw"  MDS,BSI
 SG_ SingleData2 m0 : 23|8@0+ (1,0) [0|255] "raw"  MDS,BSI
 SG_ SeparationTimeRaw m3 : 23|8@0+ (1,0) [0|255] "raw"  MDS,BSI
 SG_ UnknownData1 m4 : 15|8@0+ (1,0) [0|255] "raw"  MDS,BSI
 SG_ ConsecutiveData1 m2 : 15|8@0+ (1,0) [0|255] "raw"  MDS,BSI
 SG_ SingleData1 m0 : 15|8@0+ (1,0) [0|255] "raw"  MDS,BSI
 SG_ BlockSize m3 : 15|8@0+ (1,0) [0|255] "raw"  MDS,BSI
 SG_ UnknownPciLow m4 : 3|4@0+ (1,0) [0|15] "raw"  MDS,BSI
 SG_ FlowStatus m3 : 3|4@0+ (1,0) [0|15] "raw"  MDS,BSI
 SG_ ConsecutiveSequence m2 : 3|4@0+ (1,0) [0|15] "raw"  MDS,BSI
 SG_ FirstFrameLength m1 : 3|12@0+ (1,0) [0|4095] "raw"  MDS,BSI
 SG_ SingleFrameLength m0 : 3|4@0+ (1,0) [0|15] "raw"  MDS,BSI
 SG_ IsoTpFrameType M : 7|4@0+ (1,0) [0|15] ""  MDS,BSI

BO_ 1636 ICSV_DiagResponse: 8 ICSV
 SG_ FlowPadding5 m3 : 63|8@0+ (1,0) [0|255] "raw"  BSI,MDS,DIAG_TOOL
 SG_ FirstData6 m1 : 63|8@0+ (1,0) [0|255] "raw"  BSI,MDS,DIAG_TOOL
 SG_ UnknownData7 m4 : 63|8@0+ (1,0) [0|255] "raw"  BSI,MDS,DIAG_TOOL
 SG_ ConsecutiveData7 m2 : 63|8@0+ (1,0) [0|255] "raw"  BSI,MDS,DIAG_TOOL
 SG_ SingleData7 m0 : 63|8@0+ (1,0) [0|255] "raw"  BSI,MDS,DIAG_TOOL
 SG_ FlowPadding4 m3 : 55|8@0+ (1,0) [0|255] "raw"  BSI,MDS,DIAG_TOOL
 SG_ FirstData5 m1 : 55|8@0+ (1,0) [0|255] "raw"  BSI,MDS,DIAG_TOOL
 SG_ UnknownData6 m4 : 55|8@0+ (1,0) [0|255] "raw"  BSI,MDS,DIAG_TOOL
 SG_ ConsecutiveData6 m2 : 55|8@0+ (1,0) [0|255] "raw"  BSI,MDS,DIAG_TOOL
 SG_ SingleData6 m0 : 55|8@0+ (1,0) [0|255] "raw"  BSI,MDS,DIAG_TOOL
 SG_ FlowPadding3 m3 : 47|8@0+ (1,0) [0|255] "raw"  BSI,MDS,DIAG_TOOL
 SG_ FirstData4 m1 : 47|8@0+ (1,0) [0|255] "raw"  BSI,MDS,DIAG_TOOL
 SG_ UnknownData5 m4 : 47|8@0+ (1,0) [0|255] "raw"  BSI,MDS,DIAG_TOOL
 SG_ ConsecutiveData5 m2 : 47|8@0+ (1,0) [0|255] "raw"  BSI,MDS,DIAG_TOOL
 SG_ SingleData5 m0 : 47|8@0+ (1,0) [0|255] "raw"  BSI,MDS,DIAG_TOOL
 SG_ FlowPadding2 m3 : 39|8@0+ (1,0) [0|255] "raw"  BSI,MDS,DIAG_TOOL
 SG_ FirstData3 m1 : 39|8@0+ (1,0) [0|255] "raw"  BSI,MDS,DIAG_TOOL
 SG_ UnknownData4 m4 : 39|8@0+ (1,0) [0|255] "raw"  BSI,MDS,DIAG_TOOL
 SG_ ConsecutiveData4 m2 : 39|8@0+ (1,0) [0|255] "raw"  BSI,MDS,DIAG_TOOL
 SG_ SingleData4 m0 : 39|8@0+ (1,0) [0|255] "raw"  BSI,MDS,DIAG_TOOL
 SG_ FlowPadding1 m3 : 31|8@0+ (1,0) [0|255] "raw"  BSI,MDS,DIAG_TOOL
 SG_ FirstData2 m1 : 31|8@0+ (1,0) [0|255] "raw"  BSI,MDS,DIAG_TOOL
 SG_ UnknownData3 m4 : 31|8@0+ (1,0) [0|255] "raw"  BSI,MDS,DIAG_TOOL
 SG_ ConsecutiveData3 m2 : 31|8@0+ (1,0) [0|255] "raw"  BSI,MDS,DIAG_TOOL
 SG_ SingleData3 m0 : 31|8@0+ (1,0) [0|255] "raw"  BSI,MDS,DIAG_TOOL
 SG_ FirstData1 m1 : 23|8@0+ (1,0) [0|255] "raw"  BSI,MDS,DIAG_TOOL
 SG_ UnknownData2 m4 : 23|8@0+ (1,0) [0|255] "raw"  BSI,MDS,DIAG_TOOL
 SG_ ConsecutiveData2 m2 : 23|8@0+ (1,0) [0|255] "raw"  BSI,MDS,DIAG_TOOL
 SG_ SingleData2 m0 : 23|8@0+ (1,0) [0|255] "raw"  BSI,MDS,DIAG_TOOL
 SG_ SeparationTimeRaw m3 : 23|8@0+ (1,0) [0|255] "raw"  BSI,MDS,DIAG_TOOL
 SG_ UnknownData1 m4 : 15|8@0+ (1,0) [0|255] "raw"  BSI,MDS,DIAG_TOOL
 SG_ ConsecutiveData1 m2 : 15|8@0+ (1,0) [0|255] "raw"  BSI,MDS,DIAG_TOOL
 SG_ SingleData1 m0 : 15|8@0+ (1,0) [0|255] "raw"  BSI,MDS,DIAG_TOOL
 SG_ BlockSize m3 : 15|8@0+ (1,0) [0|255] "raw"  BSI,MDS,DIAG_TOOL
 SG_ UnknownPciLow m4 : 3|4@0+ (1,0) [0|15] "raw"  BSI,MDS,DIAG_TOOL
 SG_ FlowStatus m3 : 3|4@0+ (1,0) [0|15] "raw"  BSI,MDS,DIAG_TOOL
 SG_ ConsecutiveSequence m2 : 3|4@0+ (1,0) [0|15] "raw"  BSI,MDS,DIAG_TOOL
 SG_ FirstFrameLength m1 : 3|12@0+ (1,0) [0|4095] "raw"  BSI,MDS,DIAG_TOOL
 SG_ SingleFrameLength m0 : 3|4@0+ (1,0) [0|15] "raw"  BSI,MDS,DIAG_TOOL
 SG_ IsoTpFrameType M : 7|4@0+ (1,0) [0|15] ""  BSI,MDS,DIAG_TOOL

BO_ 1637 EMF_DiagResponse: 8 EMF
 SG_ FlowPadding5 m3 : 63|8@0+ (1,0) [0|255] "raw"  MDS,BSI
 SG_ FirstData6 m1 : 63|8@0+ (1,0) [0|255] "raw"  MDS,BSI
 SG_ UnknownData7 m4 : 63|8@0+ (1,0) [0|255] "raw"  MDS,BSI
 SG_ ConsecutiveData7 m2 : 63|8@0+ (1,0) [0|255] "raw"  MDS,BSI
 SG_ SingleData7 m0 : 63|8@0+ (1,0) [0|255] "raw"  MDS,BSI
 SG_ FlowPadding4 m3 : 55|8@0+ (1,0) [0|255] "raw"  MDS,BSI
 SG_ FirstData5 m1 : 55|8@0+ (1,0) [0|255] "raw"  MDS,BSI
 SG_ UnknownData6 m4 : 55|8@0+ (1,0) [0|255] "raw"  MDS,BSI
 SG_ ConsecutiveData6 m2 : 55|8@0+ (1,0) [0|255] "raw"  MDS,BSI
 SG_ SingleData6 m0 : 55|8@0+ (1,0) [0|255] "raw"  MDS,BSI
 SG_ FlowPadding3 m3 : 47|8@0+ (1,0) [0|255] "raw"  MDS,BSI
 SG_ FirstData4 m1 : 47|8@0+ (1,0) [0|255] "raw"  MDS,BSI
 SG_ UnknownData5 m4 : 47|8@0+ (1,0) [0|255] "raw"  MDS,BSI
 SG_ ConsecutiveData5 m2 : 47|8@0+ (1,0) [0|255] "raw"  MDS,BSI
 SG_ SingleData5 m0 : 47|8@0+ (1,0) [0|255] "raw"  MDS,BSI
 SG_ FlowPadding2 m3 : 39|8@0+ (1,0) [0|255] "raw"  MDS,BSI
 SG_ FirstData3 m1 : 39|8@0+ (1,0) [0|255] "raw"  MDS,BSI
 SG_ UnknownData4 m4 : 39|8@0+ (1,0) [0|255] "raw"  MDS,BSI
 SG_ ConsecutiveData4 m2 : 39|8@0+ (1,0) [0|255] "raw"  MDS,BSI
 SG_ SingleData4 m0 : 39|8@0+ (1,0) [0|255] "raw"  MDS,BSI
 SG_ FlowPadding1 m3 : 31|8@0+ (1,0) [0|255] "raw"  MDS,BSI
 SG_ FirstData2 m1 : 31|8@0+ (1,0) [0|255] "raw"  MDS,BSI
 SG_ UnknownData3 m4 : 31|8@0+ (1,0) [0|255] "raw"  MDS,BSI
 SG_ ConsecutiveData3 m2 : 31|8@0+ (1,0) [0|255] "raw"  MDS,BSI
 SG_ SingleData3 m0 : 31|8@0+ (1,0) [0|255] "raw"  MDS,BSI
 SG_ FirstData1 m1 : 23|8@0+ (1,0) [0|255] "raw"  MDS,BSI
 SG_ UnknownData2 m4 : 23|8@0+ (1,0) [0|255] "raw"  MDS,BSI
 SG_ ConsecutiveData2 m2 : 23|8@0+ (1,0) [0|255] "raw"  MDS,BSI
 SG_ SingleData2 m0 : 23|8@0+ (1,0) [0|255] "raw"  MDS,BSI
 SG_ SeparationTimeRaw m3 : 23|8@0+ (1,0) [0|255] "raw"  MDS,BSI
 SG_ UnknownData1 m4 : 15|8@0+ (1,0) [0|255] "raw"  MDS,BSI
 SG_ ConsecutiveData1 m2 : 15|8@0+ (1,0) [0|255] "raw"  MDS,BSI
 SG_ SingleData1 m0 : 15|8@0+ (1,0) [0|255] "raw"  MDS,BSI
 SG_ BlockSize m3 : 15|8@0+ (1,0) [0|255] "raw"  MDS,BSI
 SG_ UnknownPciLow m4 : 3|4@0+ (1,0) [0|15] "raw"  MDS,BSI
 SG_ FlowStatus m3 : 3|4@0+ (1,0) [0|15] "raw"  MDS,BSI
 SG_ ConsecutiveSequence m2 : 3|4@0+ (1,0) [0|15] "raw"  MDS,BSI
 SG_ FirstFrameLength m1 : 3|12@0+ (1,0) [0|4095] "raw"  MDS,BSI
 SG_ SingleFrameLength m0 : 3|4@0+ (1,0) [0|15] "raw"  MDS,BSI
 SG_ IsoTpFrameType M : 7|4@0+ (1,0) [0|15] ""  MDS,BSI

BO_ 1638 WLC_DiagResponse: 8 WLC
 SG_ FlowPadding5 m3 : 63|8@0+ (1,0) [0|255] "raw"  BSI
 SG_ FirstData6 m1 : 63|8@0+ (1,0) [0|255] "raw"  BSI
 SG_ UnknownData7 m4 : 63|8@0+ (1,0) [0|255] "raw"  BSI
 SG_ ConsecutiveData7 m2 : 63|8@0+ (1,0) [0|255] "raw"  BSI
 SG_ SingleData7 m0 : 63|8@0+ (1,0) [0|255] "raw"  BSI
 SG_ FlowPadding4 m3 : 55|8@0+ (1,0) [0|255] "raw"  BSI
 SG_ FirstData5 m1 : 55|8@0+ (1,0) [0|255] "raw"  BSI
 SG_ UnknownData6 m4 : 55|8@0+ (1,0) [0|255] "raw"  BSI
 SG_ ConsecutiveData6 m2 : 55|8@0+ (1,0) [0|255] "raw"  BSI
 SG_ SingleData6 m0 : 55|8@0+ (1,0) [0|255] "raw"  BSI
 SG_ FlowPadding3 m3 : 47|8@0+ (1,0) [0|255] "raw"  BSI
 SG_ FirstData4 m1 : 47|8@0+ (1,0) [0|255] "raw"  BSI
 SG_ UnknownData5 m4 : 47|8@0+ (1,0) [0|255] "raw"  BSI
 SG_ ConsecutiveData5 m2 : 47|8@0+ (1,0) [0|255] "raw"  BSI
 SG_ SingleData5 m0 : 47|8@0+ (1,0) [0|255] "raw"  BSI
 SG_ FlowPadding2 m3 : 39|8@0+ (1,0) [0|255] "raw"  BSI
 SG_ FirstData3 m1 : 39|8@0+ (1,0) [0|255] "raw"  BSI
 SG_ UnknownData4 m4 : 39|8@0+ (1,0) [0|255] "raw"  BSI
 SG_ ConsecutiveData4 m2 : 39|8@0+ (1,0) [0|255] "raw"  BSI
 SG_ SingleData4 m0 : 39|8@0+ (1,0) [0|255] "raw"  BSI
 SG_ FlowPadding1 m3 : 31|8@0+ (1,0) [0|255] "raw"  BSI
 SG_ FirstData2 m1 : 31|8@0+ (1,0) [0|255] "raw"  BSI
 SG_ UnknownData3 m4 : 31|8@0+ (1,0) [0|255] "raw"  BSI
 SG_ ConsecutiveData3 m2 : 31|8@0+ (1,0) [0|255] "raw"  BSI
 SG_ SingleData3 m0 : 31|8@0+ (1,0) [0|255] "raw"  BSI
 SG_ FirstData1 m1 : 23|8@0+ (1,0) [0|255] "raw"  BSI
 SG_ UnknownData2 m4 : 23|8@0+ (1,0) [0|255] "raw"  BSI
 SG_ ConsecutiveData2 m2 : 23|8@0+ (1,0) [0|255] "raw"  BSI
 SG_ SingleData2 m0 : 23|8@0+ (1,0) [0|255] "raw"  BSI
 SG_ SeparationTimeRaw m3 : 23|8@0+ (1,0) [0|255] "raw"  BSI
 SG_ UnknownData1 m4 : 15|8@0+ (1,0) [0|255] "raw"  BSI
 SG_ ConsecutiveData1 m2 : 15|8@0+ (1,0) [0|255] "raw"  BSI
 SG_ SingleData1 m0 : 15|8@0+ (1,0) [0|255] "raw"  BSI
 SG_ BlockSize m3 : 15|8@0+ (1,0) [0|255] "raw"  BSI
 SG_ UnknownPciLow m4 : 3|4@0+ (1,0) [0|15] "raw"  BSI
 SG_ FlowStatus m3 : 3|4@0+ (1,0) [0|15] "raw"  BSI
 SG_ ConsecutiveSequence m2 : 3|4@0+ (1,0) [0|15] "raw"  BSI
 SG_ FirstFrameLength m1 : 3|12@0+ (1,0) [0|4095] "raw"  BSI
 SG_ SingleFrameLength m0 : 3|4@0+ (1,0) [0|15] "raw"  BSI
 SG_ IsoTpFrameType M : 7|4@0+ (1,0) [0|15] ""  BSI

BO_ 1643 BSI_DiagResponse_20: 8 BSI
 SG_ FlowPadding5 m3 : 63|8@0+ (1,0) [0|255] "raw"  MDS
 SG_ FirstData6 m1 : 63|8@0+ (1,0) [0|255] "raw"  MDS
 SG_ UnknownData7 m4 : 63|8@0+ (1,0) [0|255] "raw"  MDS
 SG_ ConsecutiveData7 m2 : 63|8@0+ (1,0) [0|255] "raw"  MDS
 SG_ SingleData7 m0 : 63|8@0+ (1,0) [0|255] "raw"  MDS
 SG_ FlowPadding4 m3 : 55|8@0+ (1,0) [0|255] "raw"  MDS
 SG_ FirstData5 m1 : 55|8@0+ (1,0) [0|255] "raw"  MDS
 SG_ UnknownData6 m4 : 55|8@0+ (1,0) [0|255] "raw"  MDS
 SG_ ConsecutiveData6 m2 : 55|8@0+ (1,0) [0|255] "raw"  MDS
 SG_ SingleData6 m0 : 55|8@0+ (1,0) [0|255] "raw"  MDS
 SG_ FlowPadding3 m3 : 47|8@0+ (1,0) [0|255] "raw"  MDS
 SG_ FirstData4 m1 : 47|8@0+ (1,0) [0|255] "raw"  MDS
 SG_ UnknownData5 m4 : 47|8@0+ (1,0) [0|255] "raw"  MDS
 SG_ ConsecutiveData5 m2 : 47|8@0+ (1,0) [0|255] "raw"  MDS
 SG_ SingleData5 m0 : 47|8@0+ (1,0) [0|255] "raw"  MDS
 SG_ FlowPadding2 m3 : 39|8@0+ (1,0) [0|255] "raw"  MDS
 SG_ FirstData3 m1 : 39|8@0+ (1,0) [0|255] "raw"  MDS
 SG_ UnknownData4 m4 : 39|8@0+ (1,0) [0|255] "raw"  MDS
 SG_ ConsecutiveData4 m2 : 39|8@0+ (1,0) [0|255] "raw"  MDS
 SG_ SingleData4 m0 : 39|8@0+ (1,0) [0|255] "raw"  MDS
 SG_ FlowPadding1 m3 : 31|8@0+ (1,0) [0|255] "raw"  MDS
 SG_ FirstData2 m1 : 31|8@0+ (1,0) [0|255] "raw"  MDS
 SG_ UnknownData3 m4 : 31|8@0+ (1,0) [0|255] "raw"  MDS
 SG_ ConsecutiveData3 m2 : 31|8@0+ (1,0) [0|255] "raw"  MDS
 SG_ SingleData3 m0 : 31|8@0+ (1,0) [0|255] "raw"  MDS
 SG_ FirstData1 m1 : 23|8@0+ (1,0) [0|255] "raw"  MDS
 SG_ UnknownData2 m4 : 23|8@0+ (1,0) [0|255] "raw"  MDS
 SG_ ConsecutiveData2 m2 : 23|8@0+ (1,0) [0|255] "raw"  MDS
 SG_ SingleData2 m0 : 23|8@0+ (1,0) [0|255] "raw"  MDS
 SG_ SeparationTimeRaw m3 : 23|8@0+ (1,0) [0|255] "raw"  MDS
 SG_ UnknownData1 m4 : 15|8@0+ (1,0) [0|255] "raw"  MDS
 SG_ ConsecutiveData1 m2 : 15|8@0+ (1,0) [0|255] "raw"  MDS
 SG_ SingleData1 m0 : 15|8@0+ (1,0) [0|255] "raw"  MDS
 SG_ BlockSize m3 : 15|8@0+ (1,0) [0|255] "raw"  MDS
 SG_ UnknownPciLow m4 : 3|4@0+ (1,0) [0|15] "raw"  MDS
 SG_ FlowStatus m3 : 3|4@0+ (1,0) [0|15] "raw"  MDS
 SG_ ConsecutiveSequence m2 : 3|4@0+ (1,0) [0|15] "raw"  MDS
 SG_ FirstFrameLength m1 : 3|12@0+ (1,0) [0|4095] "raw"  MDS
 SG_ SingleFrameLength m0 : 3|4@0+ (1,0) [0|15] "raw"  MDS
 SG_ IsoTpFrameType M : 7|4@0+ (1,0) [0|15] ""  MDS

BO_ 1644 BSI_DiagResponse_21: 8 BSI
 SG_ FlowPadding5 m3 : 63|8@0+ (1,0) [0|255] "raw"  MDS
 SG_ FirstData6 m1 : 63|8@0+ (1,0) [0|255] "raw"  MDS
 SG_ UnknownData7 m4 : 63|8@0+ (1,0) [0|255] "raw"  MDS
 SG_ ConsecutiveData7 m2 : 63|8@0+ (1,0) [0|255] "raw"  MDS
 SG_ SingleData7 m0 : 63|8@0+ (1,0) [0|255] "raw"  MDS
 SG_ FlowPadding4 m3 : 55|8@0+ (1,0) [0|255] "raw"  MDS
 SG_ FirstData5 m1 : 55|8@0+ (1,0) [0|255] "raw"  MDS
 SG_ UnknownData6 m4 : 55|8@0+ (1,0) [0|255] "raw"  MDS
 SG_ ConsecutiveData6 m2 : 55|8@0+ (1,0) [0|255] "raw"  MDS
 SG_ SingleData6 m0 : 55|8@0+ (1,0) [0|255] "raw"  MDS
 SG_ FlowPadding3 m3 : 47|8@0+ (1,0) [0|255] "raw"  MDS
 SG_ FirstData4 m1 : 47|8@0+ (1,0) [0|255] "raw"  MDS
 SG_ UnknownData5 m4 : 47|8@0+ (1,0) [0|255] "raw"  MDS
 SG_ ConsecutiveData5 m2 : 47|8@0+ (1,0) [0|255] "raw"  MDS
 SG_ SingleData5 m0 : 47|8@0+ (1,0) [0|255] "raw"  MDS
 SG_ FlowPadding2 m3 : 39|8@0+ (1,0) [0|255] "raw"  MDS
 SG_ FirstData3 m1 : 39|8@0+ (1,0) [0|255] "raw"  MDS
 SG_ UnknownData4 m4 : 39|8@0+ (1,0) [0|255] "raw"  MDS
 SG_ ConsecutiveData4 m2 : 39|8@0+ (1,0) [0|255] "raw"  MDS
 SG_ SingleData4 m0 : 39|8@0+ (1,0) [0|255] "raw"  MDS
 SG_ FlowPadding1 m3 : 31|8@0+ (1,0) [0|255] "raw"  MDS
 SG_ FirstData2 m1 : 31|8@0+ (1,0) [0|255] "raw"  MDS
 SG_ UnknownData3 m4 : 31|8@0+ (1,0) [0|255] "raw"  MDS
 SG_ ConsecutiveData3 m2 : 31|8@0+ (1,0) [0|255] "raw"  MDS
 SG_ SingleData3 m0 : 31|8@0+ (1,0) [0|255] "raw"  MDS
 SG_ FirstData1 m1 : 23|8@0+ (1,0) [0|255] "raw"  MDS
 SG_ UnknownData2 m4 : 23|8@0+ (1,0) [0|255] "raw"  MDS
 SG_ ConsecutiveData2 m2 : 23|8@0+ (1,0) [0|255] "raw"  MDS
 SG_ SingleData2 m0 : 23|8@0+ (1,0) [0|255] "raw"  MDS
 SG_ SeparationTimeRaw m3 : 23|8@0+ (1,0) [0|255] "raw"  MDS
 SG_ UnknownData1 m4 : 15|8@0+ (1,0) [0|255] "raw"  MDS
 SG_ ConsecutiveData1 m2 : 15|8@0+ (1,0) [0|255] "raw"  MDS
 SG_ SingleData1 m0 : 15|8@0+ (1,0) [0|255] "raw"  MDS
 SG_ BlockSize m3 : 15|8@0+ (1,0) [0|255] "raw"  MDS
 SG_ UnknownPciLow m4 : 3|4@0+ (1,0) [0|15] "raw"  MDS
 SG_ FlowStatus m3 : 3|4@0+ (1,0) [0|15] "raw"  MDS
 SG_ ConsecutiveSequence m2 : 3|4@0+ (1,0) [0|15] "raw"  MDS
 SG_ FirstFrameLength m1 : 3|12@0+ (1,0) [0|4095] "raw"  MDS
 SG_ SingleFrameLength m0 : 3|4@0+ (1,0) [0|15] "raw"  MDS
 SG_ IsoTpFrameType M : 7|4@0+ (1,0) [0|15] ""  MDS

BO_ 1645 BSI_DiagResponse_22: 8 BSI
 SG_ FlowPadding5 m3 : 63|8@0+ (1,0) [0|255] "raw"  MDS
 SG_ FirstData6 m1 : 63|8@0+ (1,0) [0|255] "raw"  MDS
 SG_ UnknownData7 m4 : 63|8@0+ (1,0) [0|255] "raw"  MDS
 SG_ ConsecutiveData7 m2 : 63|8@0+ (1,0) [0|255] "raw"  MDS
 SG_ SingleData7 m0 : 63|8@0+ (1,0) [0|255] "raw"  MDS
 SG_ FlowPadding4 m3 : 55|8@0+ (1,0) [0|255] "raw"  MDS
 SG_ FirstData5 m1 : 55|8@0+ (1,0) [0|255] "raw"  MDS
 SG_ UnknownData6 m4 : 55|8@0+ (1,0) [0|255] "raw"  MDS
 SG_ ConsecutiveData6 m2 : 55|8@0+ (1,0) [0|255] "raw"  MDS
 SG_ SingleData6 m0 : 55|8@0+ (1,0) [0|255] "raw"  MDS
 SG_ FlowPadding3 m3 : 47|8@0+ (1,0) [0|255] "raw"  MDS
 SG_ FirstData4 m1 : 47|8@0+ (1,0) [0|255] "raw"  MDS
 SG_ UnknownData5 m4 : 47|8@0+ (1,0) [0|255] "raw"  MDS
 SG_ ConsecutiveData5 m2 : 47|8@0+ (1,0) [0|255] "raw"  MDS
 SG_ SingleData5 m0 : 47|8@0+ (1,0) [0|255] "raw"  MDS
 SG_ FlowPadding2 m3 : 39|8@0+ (1,0) [0|255] "raw"  MDS
 SG_ FirstData3 m1 : 39|8@0+ (1,0) [0|255] "raw"  MDS
 SG_ UnknownData4 m4 : 39|8@0+ (1,0) [0|255] "raw"  MDS
 SG_ ConsecutiveData4 m2 : 39|8@0+ (1,0) [0|255] "raw"  MDS
 SG_ SingleData4 m0 : 39|8@0+ (1,0) [0|255] "raw"  MDS
 SG_ FlowPadding1 m3 : 31|8@0+ (1,0) [0|255] "raw"  MDS
 SG_ FirstData2 m1 : 31|8@0+ (1,0) [0|255] "raw"  MDS
 SG_ UnknownData3 m4 : 31|8@0+ (1,0) [0|255] "raw"  MDS
 SG_ ConsecutiveData3 m2 : 31|8@0+ (1,0) [0|255] "raw"  MDS
 SG_ SingleData3 m0 : 31|8@0+ (1,0) [0|255] "raw"  MDS
 SG_ FirstData1 m1 : 23|8@0+ (1,0) [0|255] "raw"  MDS
 SG_ UnknownData2 m4 : 23|8@0+ (1,0) [0|255] "raw"  MDS
 SG_ ConsecutiveData2 m2 : 23|8@0+ (1,0) [0|255] "raw"  MDS
 SG_ SingleData2 m0 : 23|8@0+ (1,0) [0|255] "raw"  MDS
 SG_ SeparationTimeRaw m3 : 23|8@0+ (1,0) [0|255] "raw"  MDS
 SG_ UnknownData1 m4 : 15|8@0+ (1,0) [0|255] "raw"  MDS
 SG_ ConsecutiveData1 m2 : 15|8@0+ (1,0) [0|255] "raw"  MDS
 SG_ SingleData1 m0 : 15|8@0+ (1,0) [0|255] "raw"  MDS
 SG_ BlockSize m3 : 15|8@0+ (1,0) [0|255] "raw"  MDS
 SG_ UnknownPciLow m4 : 3|4@0+ (1,0) [0|15] "raw"  MDS
 SG_ FlowStatus m3 : 3|4@0+ (1,0) [0|15] "raw"  MDS
 SG_ ConsecutiveSequence m2 : 3|4@0+ (1,0) [0|15] "raw"  MDS
 SG_ FirstFrameLength m1 : 3|12@0+ (1,0) [0|4095] "raw"  MDS
 SG_ SingleFrameLength m0 : 3|4@0+ (1,0) [0|15] "raw"  MDS
 SG_ IsoTpFrameType M : 7|4@0+ (1,0) [0|15] ""  MDS

BO_TX_BU_ 1632 : BTEL,RAD,ICSV;
BO_TX_BU_ 1636 : ICSV,BTEL,OVIP;
CM_ BO_ 1611 "DATABASE_CANDIDATE: physical interpretation unverified; capture/layout evidence reported separately. INFO-DIV CAN, 125000 bit/s; CAN ID 0x64B. PSA-RE title: PDPC_DIAG_RESPONSE. Diagnostic response sent by the PDPC ECU. Source: https://github.com/prototux/PSA-RE/blob/67f7581e7622410efdbb29c7eda3b86982b9b450/buses/AEE2010.full/LS.INFO-DIV/64B.yml. Source sender alternatives: BSI; physical TX/gateway forwarding not verified. WIRE ISO-TP ONLY: normal addressing candidate, maximum Classical CAN DLC 8; actual DLC may be shorter. Data includes padding. No reassembly, text, DID or application-layer decoding. Original application layouts are preserved in source JSON; do not decode them at wire offsets. ";
CM_ SG_ 1611 FlowPadding5 "TRANSPORT_CANDIDATE: normal-addressing ISO-TP. PSA-RE bits 8.7-8.0. ";
CM_ SG_ 1611 FirstData6 "TRANSPORT_CANDIDATE: normal-addressing ISO-TP. PSA-RE bits 8.7-8.0. ";
CM_ SG_ 1611 UnknownData7 "TRANSPORT_CANDIDATE: normal-addressing ISO-TP. PSA-RE bits 8.7-8.0. ";
CM_ SG_ 1611 ConsecutiveData7 "TRANSPORT_CANDIDATE: normal-addressing ISO-TP. PSA-RE bits 8.7-8.0. ";
CM_ SG_ 1611 SingleData7 "TRANSPORT_CANDIDATE: normal-addressing ISO-TP. PSA-RE bits 8.7-8.0. ";
CM_ SG_ 1611 FlowPadding4 "TRANSPORT_CANDIDATE: normal-addressing ISO-TP. PSA-RE bits 7.7-7.0. ";
CM_ SG_ 1611 FirstData5 "TRANSPORT_CANDIDATE: normal-addressing ISO-TP. PSA-RE bits 7.7-7.0. ";
CM_ SG_ 1611 UnknownData6 "TRANSPORT_CANDIDATE: normal-addressing ISO-TP. PSA-RE bits 7.7-7.0. ";
CM_ SG_ 1611 ConsecutiveData6 "TRANSPORT_CANDIDATE: normal-addressing ISO-TP. PSA-RE bits 7.7-7.0. ";
CM_ SG_ 1611 SingleData6 "TRANSPORT_CANDIDATE: normal-addressing ISO-TP. PSA-RE bits 7.7-7.0. ";
CM_ SG_ 1611 FlowPadding3 "TRANSPORT_CANDIDATE: normal-addressing ISO-TP. PSA-RE bits 6.7-6.0. ";
CM_ SG_ 1611 FirstData4 "TRANSPORT_CANDIDATE: normal-addressing ISO-TP. PSA-RE bits 6.7-6.0. ";
CM_ SG_ 1611 UnknownData5 "TRANSPORT_CANDIDATE: normal-addressing ISO-TP. PSA-RE bits 6.7-6.0. ";
CM_ SG_ 1611 ConsecutiveData5 "TRANSPORT_CANDIDATE: normal-addressing ISO-TP. PSA-RE bits 6.7-6.0. ";
CM_ SG_ 1611 SingleData5 "TRANSPORT_CANDIDATE: normal-addressing ISO-TP. PSA-RE bits 6.7-6.0. ";
CM_ SG_ 1611 FlowPadding2 "TRANSPORT_CANDIDATE: normal-addressing ISO-TP. PSA-RE bits 5.7-5.0. ";
CM_ SG_ 1611 FirstData3 "TRANSPORT_CANDIDATE: normal-addressing ISO-TP. PSA-RE bits 5.7-5.0. ";
CM_ SG_ 1611 UnknownData4 "TRANSPORT_CANDIDATE: normal-addressing ISO-TP. PSA-RE bits 5.7-5.0. ";
CM_ SG_ 1611 ConsecutiveData4 "TRANSPORT_CANDIDATE: normal-addressing ISO-TP. PSA-RE bits 5.7-5.0. ";
CM_ SG_ 1611 SingleData4 "TRANSPORT_CANDIDATE: normal-addressing ISO-TP. PSA-RE bits 5.7-5.0. ";
CM_ SG_ 1611 FlowPadding1 "TRANSPORT_CANDIDATE: normal-addressing ISO-TP. PSA-RE bits 4.7-4.0. ";
CM_ SG_ 1611 FirstData2 "TRANSPORT_CANDIDATE: normal-addressing ISO-TP. PSA-RE bits 4.7-4.0. ";
CM_ SG_ 1611 UnknownData3 "TRANSPORT_CANDIDATE: normal-addressing ISO-TP. PSA-RE bits 4.7-4.0. ";
CM_ SG_ 1611 ConsecutiveData3 "TRANSPORT_CANDIDATE: normal-addressing ISO-TP. PSA-RE bits 4.7-4.0. ";
CM_ SG_ 1611 SingleData3 "TRANSPORT_CANDIDATE: normal-addressing ISO-TP. PSA-RE bits 4.7-4.0. ";
CM_ SG_ 1611 FirstData1 "TRANSPORT_CANDIDATE: normal-addressing ISO-TP. PSA-RE bits 3.7-3.0. ";
CM_ SG_ 1611 UnknownData2 "TRANSPORT_CANDIDATE: normal-addressing ISO-TP. PSA-RE bits 3.7-3.0. ";
CM_ SG_ 1611 ConsecutiveData2 "TRANSPORT_CANDIDATE: normal-addressing ISO-TP. PSA-RE bits 3.7-3.0. ";
CM_ SG_ 1611 SingleData2 "TRANSPORT_CANDIDATE: normal-addressing ISO-TP. PSA-RE bits 3.7-3.0. ";
CM_ SG_ 1611 SeparationTimeRaw "TRANSPORT_CANDIDATE: normal-addressing ISO-TP. PSA-RE bits 3.7-3.0. Raw STmin code; 0xF1..0xF9 are not milliseconds.";
CM_ SG_ 1611 UnknownData1 "TRANSPORT_CANDIDATE: normal-addressing ISO-TP. PSA-RE bits 2.7-2.0. ";
CM_ SG_ 1611 ConsecutiveData1 "TRANSPORT_CANDIDATE: normal-addressing ISO-TP. PSA-RE bits 2.7-2.0. ";
CM_ SG_ 1611 SingleData1 "TRANSPORT_CANDIDATE: normal-addressing ISO-TP. PSA-RE bits 2.7-2.0. ";
CM_ SG_ 1611 BlockSize "TRANSPORT_CANDIDATE: normal-addressing ISO-TP. PSA-RE bits 2.7-2.0. ";
CM_ SG_ 1611 UnknownPciLow "TRANSPORT_CANDIDATE: normal-addressing ISO-TP. PSA-RE bits 1.3-1.0. ";
CM_ SG_ 1611 FlowStatus "TRANSPORT_CANDIDATE: normal-addressing ISO-TP. PSA-RE bits 1.3-1.0. ";
CM_ SG_ 1611 ConsecutiveSequence "TRANSPORT_CANDIDATE: normal-addressing ISO-TP. PSA-RE bits 1.3-1.0. ";
CM_ SG_ 1611 FirstFrameLength "TRANSPORT_CANDIDATE: normal-addressing ISO-TP. PSA-RE bits 1.3-2.0. 12-bit declared PDU length; not a reassembled value.";
CM_ SG_ 1611 SingleFrameLength "TRANSPORT_CANDIDATE: normal-addressing ISO-TP. PSA-RE bits 1.3-1.0. Declared data length; not a validity check.";
CM_ SG_ 1611 IsoTpFrameType "TRANSPORT_CANDIDATE: normal-addressing ISO-TP. PSA-RE bits 1.7-1.4. PCI high nibble; normal addressing candidate.";
CM_ BO_ 1612 "DATABASE_CANDIDATE: physical interpretation unverified; capture/layout evidence reported separately. INFO-DIV CAN, 125000 bit/s; CAN ID 0x64C. PSA-RE title: CRT_DIAG_RESPONSE. Diagnostic response sent by the CRT ECU. Source: https://github.com/prototux/PSA-RE/blob/67f7581e7622410efdbb29c7eda3b86982b9b450/buses/AEE2010.full/LS.INFO-DIV/64C.yml. Source sender alternatives: CRT; physical TX/gateway forwarding not verified. WIRE ISO-TP ONLY: normal addressing candidate, maximum Classical CAN DLC 8; actual DLC may be shorter. Data includes padding. No reassembly, text, DID or application-layer decoding. Original application layouts are preserved in source JSON; do not decode them at wire offsets. ";
CM_ SG_ 1612 FlowPadding5 "TRANSPORT_CANDIDATE: normal-addressing ISO-TP. PSA-RE bits 8.7-8.0. ";
CM_ SG_ 1612 FirstData6 "TRANSPORT_CANDIDATE: normal-addressing ISO-TP. PSA-RE bits 8.7-8.0. ";
CM_ SG_ 1612 UnknownData7 "TRANSPORT_CANDIDATE: normal-addressing ISO-TP. PSA-RE bits 8.7-8.0. ";
CM_ SG_ 1612 ConsecutiveData7 "TRANSPORT_CANDIDATE: normal-addressing ISO-TP. PSA-RE bits 8.7-8.0. ";
CM_ SG_ 1612 SingleData7 "TRANSPORT_CANDIDATE: normal-addressing ISO-TP. PSA-RE bits 8.7-8.0. ";
CM_ SG_ 1612 FlowPadding4 "TRANSPORT_CANDIDATE: normal-addressing ISO-TP. PSA-RE bits 7.7-7.0. ";
CM_ SG_ 1612 FirstData5 "TRANSPORT_CANDIDATE: normal-addressing ISO-TP. PSA-RE bits 7.7-7.0. ";
CM_ SG_ 1612 UnknownData6 "TRANSPORT_CANDIDATE: normal-addressing ISO-TP. PSA-RE bits 7.7-7.0. ";
CM_ SG_ 1612 ConsecutiveData6 "TRANSPORT_CANDIDATE: normal-addressing ISO-TP. PSA-RE bits 7.7-7.0. ";
CM_ SG_ 1612 SingleData6 "TRANSPORT_CANDIDATE: normal-addressing ISO-TP. PSA-RE bits 7.7-7.0. ";
CM_ SG_ 1612 FlowPadding3 "TRANSPORT_CANDIDATE: normal-addressing ISO-TP. PSA-RE bits 6.7-6.0. ";
CM_ SG_ 1612 FirstData4 "TRANSPORT_CANDIDATE: normal-addressing ISO-TP. PSA-RE bits 6.7-6.0. ";
CM_ SG_ 1612 UnknownData5 "TRANSPORT_CANDIDATE: normal-addressing ISO-TP. PSA-RE bits 6.7-6.0. ";
CM_ SG_ 1612 ConsecutiveData5 "TRANSPORT_CANDIDATE: normal-addressing ISO-TP. PSA-RE bits 6.7-6.0. ";
CM_ SG_ 1612 SingleData5 "TRANSPORT_CANDIDATE: normal-addressing ISO-TP. PSA-RE bits 6.7-6.0. ";
CM_ SG_ 1612 FlowPadding2 "TRANSPORT_CANDIDATE: normal-addressing ISO-TP. PSA-RE bits 5.7-5.0. ";
CM_ SG_ 1612 FirstData3 "TRANSPORT_CANDIDATE: normal-addressing ISO-TP. PSA-RE bits 5.7-5.0. ";
CM_ SG_ 1612 UnknownData4 "TRANSPORT_CANDIDATE: normal-addressing ISO-TP. PSA-RE bits 5.7-5.0. ";
CM_ SG_ 1612 ConsecutiveData4 "TRANSPORT_CANDIDATE: normal-addressing ISO-TP. PSA-RE bits 5.7-5.0. ";
CM_ SG_ 1612 SingleData4 "TRANSPORT_CANDIDATE: normal-addressing ISO-TP. PSA-RE bits 5.7-5.0. ";
CM_ SG_ 1612 FlowPadding1 "TRANSPORT_CANDIDATE: normal-addressing ISO-TP. PSA-RE bits 4.7-4.0. ";
CM_ SG_ 1612 FirstData2 "TRANSPORT_CANDIDATE: normal-addressing ISO-TP. PSA-RE bits 4.7-4.0. ";
CM_ SG_ 1612 UnknownData3 "TRANSPORT_CANDIDATE: normal-addressing ISO-TP. PSA-RE bits 4.7-4.0. ";
CM_ SG_ 1612 ConsecutiveData3 "TRANSPORT_CANDIDATE: normal-addressing ISO-TP. PSA-RE bits 4.7-4.0. ";
CM_ SG_ 1612 SingleData3 "TRANSPORT_CANDIDATE: normal-addressing ISO-TP. PSA-RE bits 4.7-4.0. ";
CM_ SG_ 1612 FirstData1 "TRANSPORT_CANDIDATE: normal-addressing ISO-TP. PSA-RE bits 3.7-3.0. ";
CM_ SG_ 1612 UnknownData2 "TRANSPORT_CANDIDATE: normal-addressing ISO-TP. PSA-RE bits 3.7-3.0. ";
CM_ SG_ 1612 ConsecutiveData2 "TRANSPORT_CANDIDATE: normal-addressing ISO-TP. PSA-RE bits 3.7-3.0. ";
CM_ SG_ 1612 SingleData2 "TRANSPORT_CANDIDATE: normal-addressing ISO-TP. PSA-RE bits 3.7-3.0. ";
CM_ SG_ 1612 SeparationTimeRaw "TRANSPORT_CANDIDATE: normal-addressing ISO-TP. PSA-RE bits 3.7-3.0. Raw STmin code; 0xF1..0xF9 are not milliseconds.";
CM_ SG_ 1612 UnknownData1 "TRANSPORT_CANDIDATE: normal-addressing ISO-TP. PSA-RE bits 2.7-2.0. ";
CM_ SG_ 1612 ConsecutiveData1 "TRANSPORT_CANDIDATE: normal-addressing ISO-TP. PSA-RE bits 2.7-2.0. ";
CM_ SG_ 1612 SingleData1 "TRANSPORT_CANDIDATE: normal-addressing ISO-TP. PSA-RE bits 2.7-2.0. ";
CM_ SG_ 1612 BlockSize "TRANSPORT_CANDIDATE: normal-addressing ISO-TP. PSA-RE bits 2.7-2.0. ";
CM_ SG_ 1612 UnknownPciLow "TRANSPORT_CANDIDATE: normal-addressing ISO-TP. PSA-RE bits 1.3-1.0. ";
CM_ SG_ 1612 FlowStatus "TRANSPORT_CANDIDATE: normal-addressing ISO-TP. PSA-RE bits 1.3-1.0. ";
CM_ SG_ 1612 ConsecutiveSequence "TRANSPORT_CANDIDATE: normal-addressing ISO-TP. PSA-RE bits 1.3-1.0. ";
CM_ SG_ 1612 FirstFrameLength "TRANSPORT_CANDIDATE: normal-addressing ISO-TP. PSA-RE bits 1.3-2.0. 12-bit declared PDU length; not a reassembled value.";
CM_ SG_ 1612 SingleFrameLength "TRANSPORT_CANDIDATE: normal-addressing ISO-TP. PSA-RE bits 1.3-1.0. Declared data length; not a validity check.";
CM_ SG_ 1612 IsoTpFrameType "TRANSPORT_CANDIDATE: normal-addressing ISO-TP. PSA-RE bits 1.7-1.4. PCI high nibble; normal addressing candidate.";
CM_ BO_ 1615 "DATABASE_CANDIDATE: physical interpretation unverified; capture/layout evidence reported separately. INFO-DIV CAN, 125000 bit/s; CAN ID 0x64F. PSA-RE title: AVE_DIAG_RESPONSE. Diagnostic response sent by the AVE ECU. Source: https://github.com/prototux/PSA-RE/blob/67f7581e7622410efdbb29c7eda3b86982b9b450/buses/AEE2010.full/LS.INFO-DIV/64F.yml. Source sender alternatives: BSI; physical TX/gateway forwarding not verified. WIRE ISO-TP ONLY: normal addressing candidate, maximum Classical CAN DLC 8; actual DLC may be shorter. Data includes padding. No reassembly, text, DID or application-layer decoding. Original application layouts are preserved in source JSON; do not decode them at wire offsets. ";
CM_ SG_ 1615 FlowPadding5 "TRANSPORT_CANDIDATE: normal-addressing ISO-TP. PSA-RE bits 8.7-8.0. ";
CM_ SG_ 1615 FirstData6 "TRANSPORT_CANDIDATE: normal-addressing ISO-TP. PSA-RE bits 8.7-8.0. ";
CM_ SG_ 1615 UnknownData7 "TRANSPORT_CANDIDATE: normal-addressing ISO-TP. PSA-RE bits 8.7-8.0. ";
CM_ SG_ 1615 ConsecutiveData7 "TRANSPORT_CANDIDATE: normal-addressing ISO-TP. PSA-RE bits 8.7-8.0. ";
CM_ SG_ 1615 SingleData7 "TRANSPORT_CANDIDATE: normal-addressing ISO-TP. PSA-RE bits 8.7-8.0. ";
CM_ SG_ 1615 FlowPadding4 "TRANSPORT_CANDIDATE: normal-addressing ISO-TP. PSA-RE bits 7.7-7.0. ";
CM_ SG_ 1615 FirstData5 "TRANSPORT_CANDIDATE: normal-addressing ISO-TP. PSA-RE bits 7.7-7.0. ";
CM_ SG_ 1615 UnknownData6 "TRANSPORT_CANDIDATE: normal-addressing ISO-TP. PSA-RE bits 7.7-7.0. ";
CM_ SG_ 1615 ConsecutiveData6 "TRANSPORT_CANDIDATE: normal-addressing ISO-TP. PSA-RE bits 7.7-7.0. ";
CM_ SG_ 1615 SingleData6 "TRANSPORT_CANDIDATE: normal-addressing ISO-TP. PSA-RE bits 7.7-7.0. ";
CM_ SG_ 1615 FlowPadding3 "TRANSPORT_CANDIDATE: normal-addressing ISO-TP. PSA-RE bits 6.7-6.0. ";
CM_ SG_ 1615 FirstData4 "TRANSPORT_CANDIDATE: normal-addressing ISO-TP. PSA-RE bits 6.7-6.0. ";
CM_ SG_ 1615 UnknownData5 "TRANSPORT_CANDIDATE: normal-addressing ISO-TP. PSA-RE bits 6.7-6.0. ";
CM_ SG_ 1615 ConsecutiveData5 "TRANSPORT_CANDIDATE: normal-addressing ISO-TP. PSA-RE bits 6.7-6.0. ";
CM_ SG_ 1615 SingleData5 "TRANSPORT_CANDIDATE: normal-addressing ISO-TP. PSA-RE bits 6.7-6.0. ";
CM_ SG_ 1615 FlowPadding2 "TRANSPORT_CANDIDATE: normal-addressing ISO-TP. PSA-RE bits 5.7-5.0. ";
CM_ SG_ 1615 FirstData3 "TRANSPORT_CANDIDATE: normal-addressing ISO-TP. PSA-RE bits 5.7-5.0. ";
CM_ SG_ 1615 UnknownData4 "TRANSPORT_CANDIDATE: normal-addressing ISO-TP. PSA-RE bits 5.7-5.0. ";
CM_ SG_ 1615 ConsecutiveData4 "TRANSPORT_CANDIDATE: normal-addressing ISO-TP. PSA-RE bits 5.7-5.0. ";
CM_ SG_ 1615 SingleData4 "TRANSPORT_CANDIDATE: normal-addressing ISO-TP. PSA-RE bits 5.7-5.0. ";
CM_ SG_ 1615 FlowPadding1 "TRANSPORT_CANDIDATE: normal-addressing ISO-TP. PSA-RE bits 4.7-4.0. ";
CM_ SG_ 1615 FirstData2 "TRANSPORT_CANDIDATE: normal-addressing ISO-TP. PSA-RE bits 4.7-4.0. ";
CM_ SG_ 1615 UnknownData3 "TRANSPORT_CANDIDATE: normal-addressing ISO-TP. PSA-RE bits 4.7-4.0. ";
CM_ SG_ 1615 ConsecutiveData3 "TRANSPORT_CANDIDATE: normal-addressing ISO-TP. PSA-RE bits 4.7-4.0. ";
CM_ SG_ 1615 SingleData3 "TRANSPORT_CANDIDATE: normal-addressing ISO-TP. PSA-RE bits 4.7-4.0. ";
CM_ SG_ 1615 FirstData1 "TRANSPORT_CANDIDATE: normal-addressing ISO-TP. PSA-RE bits 3.7-3.0. ";
CM_ SG_ 1615 UnknownData2 "TRANSPORT_CANDIDATE: normal-addressing ISO-TP. PSA-RE bits 3.7-3.0. ";
CM_ SG_ 1615 ConsecutiveData2 "TRANSPORT_CANDIDATE: normal-addressing ISO-TP. PSA-RE bits 3.7-3.0. ";
CM_ SG_ 1615 SingleData2 "TRANSPORT_CANDIDATE: normal-addressing ISO-TP. PSA-RE bits 3.7-3.0. ";
CM_ SG_ 1615 SeparationTimeRaw "TRANSPORT_CANDIDATE: normal-addressing ISO-TP. PSA-RE bits 3.7-3.0. Raw STmin code; 0xF1..0xF9 are not milliseconds.";
CM_ SG_ 1615 UnknownData1 "TRANSPORT_CANDIDATE: normal-addressing ISO-TP. PSA-RE bits 2.7-2.0. ";
CM_ SG_ 1615 ConsecutiveData1 "TRANSPORT_CANDIDATE: normal-addressing ISO-TP. PSA-RE bits 2.7-2.0. ";
CM_ SG_ 1615 SingleData1 "TRANSPORT_CANDIDATE: normal-addressing ISO-TP. PSA-RE bits 2.7-2.0. ";
CM_ SG_ 1615 BlockSize "TRANSPORT_CANDIDATE: normal-addressing ISO-TP. PSA-RE bits 2.7-2.0. ";
CM_ SG_ 1615 UnknownPciLow "TRANSPORT_CANDIDATE: normal-addressing ISO-TP. PSA-RE bits 1.3-1.0. ";
CM_ SG_ 1615 FlowStatus "TRANSPORT_CANDIDATE: normal-addressing ISO-TP. PSA-RE bits 1.3-1.0. ";
CM_ SG_ 1615 ConsecutiveSequence "TRANSPORT_CANDIDATE: normal-addressing ISO-TP. PSA-RE bits 1.3-1.0. ";
CM_ SG_ 1615 FirstFrameLength "TRANSPORT_CANDIDATE: normal-addressing ISO-TP. PSA-RE bits 1.3-2.0. 12-bit declared PDU length; not a reassembled value.";
CM_ SG_ 1615 SingleFrameLength "TRANSPORT_CANDIDATE: normal-addressing ISO-TP. PSA-RE bits 1.3-1.0. Declared data length; not a validity check.";
CM_ SG_ 1615 IsoTpFrameType "TRANSPORT_CANDIDATE: normal-addressing ISO-TP. PSA-RE bits 1.7-1.4. PCI high nibble; normal addressing candidate.";
CM_ BO_ 1619 "DATABASE_CANDIDATE: physical interpretation unverified; capture/layout evidence reported separately. INFO-DIV CAN, 125000 bit/s; CAN ID 0x653. PSA-RE title: CAFR_DIAG_RESPONSE. Diagnostic response sent by the CAFR ECU. Source: https://github.com/prototux/PSA-RE/blob/67f7581e7622410efdbb29c7eda3b86982b9b450/buses/AEE2010.full/LS.INFO-DIV/653.yml. Source sender alternatives: BSI; physical TX/gateway forwarding not verified. WIRE ISO-TP ONLY: normal addressing candidate, maximum Classical CAN DLC 8; actual DLC may be shorter. Data includes padding. No reassembly, text, DID or application-layer decoding. Original application layouts are preserved in source JSON; do not decode them at wire offsets. ";
CM_ SG_ 1619 FlowPadding5 "TRANSPORT_CANDIDATE: normal-addressing ISO-TP. PSA-RE bits 8.7-8.0. ";
CM_ SG_ 1619 FirstData6 "TRANSPORT_CANDIDATE: normal-addressing ISO-TP. PSA-RE bits 8.7-8.0. ";
CM_ SG_ 1619 UnknownData7 "TRANSPORT_CANDIDATE: normal-addressing ISO-TP. PSA-RE bits 8.7-8.0. ";
CM_ SG_ 1619 ConsecutiveData7 "TRANSPORT_CANDIDATE: normal-addressing ISO-TP. PSA-RE bits 8.7-8.0. ";
CM_ SG_ 1619 SingleData7 "TRANSPORT_CANDIDATE: normal-addressing ISO-TP. PSA-RE bits 8.7-8.0. ";
CM_ SG_ 1619 FlowPadding4 "TRANSPORT_CANDIDATE: normal-addressing ISO-TP. PSA-RE bits 7.7-7.0. ";
CM_ SG_ 1619 FirstData5 "TRANSPORT_CANDIDATE: normal-addressing ISO-TP. PSA-RE bits 7.7-7.0. ";
CM_ SG_ 1619 UnknownData6 "TRANSPORT_CANDIDATE: normal-addressing ISO-TP. PSA-RE bits 7.7-7.0. ";
CM_ SG_ 1619 ConsecutiveData6 "TRANSPORT_CANDIDATE: normal-addressing ISO-TP. PSA-RE bits 7.7-7.0. ";
CM_ SG_ 1619 SingleData6 "TRANSPORT_CANDIDATE: normal-addressing ISO-TP. PSA-RE bits 7.7-7.0. ";
CM_ SG_ 1619 FlowPadding3 "TRANSPORT_CANDIDATE: normal-addressing ISO-TP. PSA-RE bits 6.7-6.0. ";
CM_ SG_ 1619 FirstData4 "TRANSPORT_CANDIDATE: normal-addressing ISO-TP. PSA-RE bits 6.7-6.0. ";
CM_ SG_ 1619 UnknownData5 "TRANSPORT_CANDIDATE: normal-addressing ISO-TP. PSA-RE bits 6.7-6.0. ";
CM_ SG_ 1619 ConsecutiveData5 "TRANSPORT_CANDIDATE: normal-addressing ISO-TP. PSA-RE bits 6.7-6.0. ";
CM_ SG_ 1619 SingleData5 "TRANSPORT_CANDIDATE: normal-addressing ISO-TP. PSA-RE bits 6.7-6.0. ";
CM_ SG_ 1619 FlowPadding2 "TRANSPORT_CANDIDATE: normal-addressing ISO-TP. PSA-RE bits 5.7-5.0. ";
CM_ SG_ 1619 FirstData3 "TRANSPORT_CANDIDATE: normal-addressing ISO-TP. PSA-RE bits 5.7-5.0. ";
CM_ SG_ 1619 UnknownData4 "TRANSPORT_CANDIDATE: normal-addressing ISO-TP. PSA-RE bits 5.7-5.0. ";
CM_ SG_ 1619 ConsecutiveData4 "TRANSPORT_CANDIDATE: normal-addressing ISO-TP. PSA-RE bits 5.7-5.0. ";
CM_ SG_ 1619 SingleData4 "TRANSPORT_CANDIDATE: normal-addressing ISO-TP. PSA-RE bits 5.7-5.0. ";
CM_ SG_ 1619 FlowPadding1 "TRANSPORT_CANDIDATE: normal-addressing ISO-TP. PSA-RE bits 4.7-4.0. ";
CM_ SG_ 1619 FirstData2 "TRANSPORT_CANDIDATE: normal-addressing ISO-TP. PSA-RE bits 4.7-4.0. ";
CM_ SG_ 1619 UnknownData3 "TRANSPORT_CANDIDATE: normal-addressing ISO-TP. PSA-RE bits 4.7-4.0. ";
CM_ SG_ 1619 ConsecutiveData3 "TRANSPORT_CANDIDATE: normal-addressing ISO-TP. PSA-RE bits 4.7-4.0. ";
CM_ SG_ 1619 SingleData3 "TRANSPORT_CANDIDATE: normal-addressing ISO-TP. PSA-RE bits 4.7-4.0. ";
CM_ SG_ 1619 FirstData1 "TRANSPORT_CANDIDATE: normal-addressing ISO-TP. PSA-RE bits 3.7-3.0. ";
CM_ SG_ 1619 UnknownData2 "TRANSPORT_CANDIDATE: normal-addressing ISO-TP. PSA-RE bits 3.7-3.0. ";
CM_ SG_ 1619 ConsecutiveData2 "TRANSPORT_CANDIDATE: normal-addressing ISO-TP. PSA-RE bits 3.7-3.0. ";
CM_ SG_ 1619 SingleData2 "TRANSPORT_CANDIDATE: normal-addressing ISO-TP. PSA-RE bits 3.7-3.0. ";
CM_ SG_ 1619 SeparationTimeRaw "TRANSPORT_CANDIDATE: normal-addressing ISO-TP. PSA-RE bits 3.7-3.0. Raw STmin code; 0xF1..0xF9 are not milliseconds.";
CM_ SG_ 1619 UnknownData1 "TRANSPORT_CANDIDATE: normal-addressing ISO-TP. PSA-RE bits 2.7-2.0. ";
CM_ SG_ 1619 ConsecutiveData1 "TRANSPORT_CANDIDATE: normal-addressing ISO-TP. PSA-RE bits 2.7-2.0. ";
CM_ SG_ 1619 SingleData1 "TRANSPORT_CANDIDATE: normal-addressing ISO-TP. PSA-RE bits 2.7-2.0. ";
CM_ SG_ 1619 BlockSize "TRANSPORT_CANDIDATE: normal-addressing ISO-TP. PSA-RE bits 2.7-2.0. ";
CM_ SG_ 1619 UnknownPciLow "TRANSPORT_CANDIDATE: normal-addressing ISO-TP. PSA-RE bits 1.3-1.0. ";
CM_ SG_ 1619 FlowStatus "TRANSPORT_CANDIDATE: normal-addressing ISO-TP. PSA-RE bits 1.3-1.0. ";
CM_ SG_ 1619 ConsecutiveSequence "TRANSPORT_CANDIDATE: normal-addressing ISO-TP. PSA-RE bits 1.3-1.0. ";
CM_ SG_ 1619 FirstFrameLength "TRANSPORT_CANDIDATE: normal-addressing ISO-TP. PSA-RE bits 1.3-2.0. 12-bit declared PDU length; not a reassembled value.";
CM_ SG_ 1619 SingleFrameLength "TRANSPORT_CANDIDATE: normal-addressing ISO-TP. PSA-RE bits 1.3-1.0. Declared data length; not a validity check.";
CM_ SG_ 1619 IsoTpFrameType "TRANSPORT_CANDIDATE: normal-addressing ISO-TP. PSA-RE bits 1.7-1.4. PCI high nibble; normal addressing candidate.";
CM_ BO_ 1624 "DATABASE_CANDIDATE: physical interpretation unverified; capture/layout evidence reported separately. INFO-DIV CAN, 125000 bit/s; CAN ID 0x658. PSA-RE title: BOP_DIAG_RESPONSE. Diagnostic response data sent by the body computer for the BOP node. Source: https://github.com/prototux/PSA-RE/blob/67f7581e7622410efdbb29c7eda3b86982b9b450/buses/AEE2010.full/LS.INFO-DIV/658.yml. Source sender alternatives: BSI; physical TX/gateway forwarding not verified. ";
CM_ SG_ 1624 DiagnosticData "DATABASE_CANDIDATE: physical interpretation unverified; capture/layout evidence reported separately. PSA-RE bits 1.7-8.0. Diagnostic data";
CM_ BO_ 1625 "DATABASE_CANDIDATE: physical interpretation unverified; capture/layout evidence reported separately. INFO-DIV CAN, 125000 bit/s; CAN ID 0x659. PSA-RE title: BSE_DIAG_RESPONSE. Diagnostic response sent by the BSE ECU. Source: https://github.com/prototux/PSA-RE/blob/67f7581e7622410efdbb29c7eda3b86982b9b450/buses/AEE2010.full/LS.INFO-DIV/659.yml. Source sender alternatives: BSI; physical TX/gateway forwarding not verified. WIRE ISO-TP ONLY: normal addressing candidate, maximum Classical CAN DLC 8; actual DLC may be shorter. Data includes padding. No reassembly, text, DID or application-layer decoding. Original application layouts are preserved in source JSON; do not decode them at wire offsets. ";
CM_ SG_ 1625 FlowPadding5 "TRANSPORT_CANDIDATE: normal-addressing ISO-TP. PSA-RE bits 8.7-8.0. ";
CM_ SG_ 1625 FirstData6 "TRANSPORT_CANDIDATE: normal-addressing ISO-TP. PSA-RE bits 8.7-8.0. ";
CM_ SG_ 1625 UnknownData7 "TRANSPORT_CANDIDATE: normal-addressing ISO-TP. PSA-RE bits 8.7-8.0. ";
CM_ SG_ 1625 ConsecutiveData7 "TRANSPORT_CANDIDATE: normal-addressing ISO-TP. PSA-RE bits 8.7-8.0. ";
CM_ SG_ 1625 SingleData7 "TRANSPORT_CANDIDATE: normal-addressing ISO-TP. PSA-RE bits 8.7-8.0. ";
CM_ SG_ 1625 FlowPadding4 "TRANSPORT_CANDIDATE: normal-addressing ISO-TP. PSA-RE bits 7.7-7.0. ";
CM_ SG_ 1625 FirstData5 "TRANSPORT_CANDIDATE: normal-addressing ISO-TP. PSA-RE bits 7.7-7.0. ";
CM_ SG_ 1625 UnknownData6 "TRANSPORT_CANDIDATE: normal-addressing ISO-TP. PSA-RE bits 7.7-7.0. ";
CM_ SG_ 1625 ConsecutiveData6 "TRANSPORT_CANDIDATE: normal-addressing ISO-TP. PSA-RE bits 7.7-7.0. ";
CM_ SG_ 1625 SingleData6 "TRANSPORT_CANDIDATE: normal-addressing ISO-TP. PSA-RE bits 7.7-7.0. ";
CM_ SG_ 1625 FlowPadding3 "TRANSPORT_CANDIDATE: normal-addressing ISO-TP. PSA-RE bits 6.7-6.0. ";
CM_ SG_ 1625 FirstData4 "TRANSPORT_CANDIDATE: normal-addressing ISO-TP. PSA-RE bits 6.7-6.0. ";
CM_ SG_ 1625 UnknownData5 "TRANSPORT_CANDIDATE: normal-addressing ISO-TP. PSA-RE bits 6.7-6.0. ";
CM_ SG_ 1625 ConsecutiveData5 "TRANSPORT_CANDIDATE: normal-addressing ISO-TP. PSA-RE bits 6.7-6.0. ";
CM_ SG_ 1625 SingleData5 "TRANSPORT_CANDIDATE: normal-addressing ISO-TP. PSA-RE bits 6.7-6.0. ";
CM_ SG_ 1625 FlowPadding2 "TRANSPORT_CANDIDATE: normal-addressing ISO-TP. PSA-RE bits 5.7-5.0. ";
CM_ SG_ 1625 FirstData3 "TRANSPORT_CANDIDATE: normal-addressing ISO-TP. PSA-RE bits 5.7-5.0. ";
CM_ SG_ 1625 UnknownData4 "TRANSPORT_CANDIDATE: normal-addressing ISO-TP. PSA-RE bits 5.7-5.0. ";
CM_ SG_ 1625 ConsecutiveData4 "TRANSPORT_CANDIDATE: normal-addressing ISO-TP. PSA-RE bits 5.7-5.0. ";
CM_ SG_ 1625 SingleData4 "TRANSPORT_CANDIDATE: normal-addressing ISO-TP. PSA-RE bits 5.7-5.0. ";
CM_ SG_ 1625 FlowPadding1 "TRANSPORT_CANDIDATE: normal-addressing ISO-TP. PSA-RE bits 4.7-4.0. ";
CM_ SG_ 1625 FirstData2 "TRANSPORT_CANDIDATE: normal-addressing ISO-TP. PSA-RE bits 4.7-4.0. ";
CM_ SG_ 1625 UnknownData3 "TRANSPORT_CANDIDATE: normal-addressing ISO-TP. PSA-RE bits 4.7-4.0. ";
CM_ SG_ 1625 ConsecutiveData3 "TRANSPORT_CANDIDATE: normal-addressing ISO-TP. PSA-RE bits 4.7-4.0. ";
CM_ SG_ 1625 SingleData3 "TRANSPORT_CANDIDATE: normal-addressing ISO-TP. PSA-RE bits 4.7-4.0. ";
CM_ SG_ 1625 FirstData1 "TRANSPORT_CANDIDATE: normal-addressing ISO-TP. PSA-RE bits 3.7-3.0. ";
CM_ SG_ 1625 UnknownData2 "TRANSPORT_CANDIDATE: normal-addressing ISO-TP. PSA-RE bits 3.7-3.0. ";
CM_ SG_ 1625 ConsecutiveData2 "TRANSPORT_CANDIDATE: normal-addressing ISO-TP. PSA-RE bits 3.7-3.0. ";
CM_ SG_ 1625 SingleData2 "TRANSPORT_CANDIDATE: normal-addressing ISO-TP. PSA-RE bits 3.7-3.0. ";
CM_ SG_ 1625 SeparationTimeRaw "TRANSPORT_CANDIDATE: normal-addressing ISO-TP. PSA-RE bits 3.7-3.0. Raw STmin code; 0xF1..0xF9 are not milliseconds.";
CM_ SG_ 1625 UnknownData1 "TRANSPORT_CANDIDATE: normal-addressing ISO-TP. PSA-RE bits 2.7-2.0. ";
CM_ SG_ 1625 ConsecutiveData1 "TRANSPORT_CANDIDATE: normal-addressing ISO-TP. PSA-RE bits 2.7-2.0. ";
CM_ SG_ 1625 SingleData1 "TRANSPORT_CANDIDATE: normal-addressing ISO-TP. PSA-RE bits 2.7-2.0. ";
CM_ SG_ 1625 BlockSize "TRANSPORT_CANDIDATE: normal-addressing ISO-TP. PSA-RE bits 2.7-2.0. ";
CM_ SG_ 1625 UnknownPciLow "TRANSPORT_CANDIDATE: normal-addressing ISO-TP. PSA-RE bits 1.3-1.0. ";
CM_ SG_ 1625 FlowStatus "TRANSPORT_CANDIDATE: normal-addressing ISO-TP. PSA-RE bits 1.3-1.0. ";
CM_ SG_ 1625 ConsecutiveSequence "TRANSPORT_CANDIDATE: normal-addressing ISO-TP. PSA-RE bits 1.3-1.0. ";
CM_ SG_ 1625 FirstFrameLength "TRANSPORT_CANDIDATE: normal-addressing ISO-TP. PSA-RE bits 1.3-2.0. 12-bit declared PDU length; not a reassembled value.";
CM_ SG_ 1625 SingleFrameLength "TRANSPORT_CANDIDATE: normal-addressing ISO-TP. PSA-RE bits 1.3-1.0. Declared data length; not a validity check.";
CM_ SG_ 1625 IsoTpFrameType "TRANSPORT_CANDIDATE: normal-addressing ISO-TP. PSA-RE bits 1.7-1.4. PCI high nibble; normal addressing candidate.";
CM_ BO_ 1627 "DATABASE_CANDIDATE: physical interpretation unverified; capture/layout evidence reported separately. INFO-DIV CAN, 125000 bit/s; CAN ID 0x65B. PSA-RE title: SAM_DIAG_RESPONSE. Diagnostic response sent by the SAM ECU. Source: https://github.com/prototux/PSA-RE/blob/67f7581e7622410efdbb29c7eda3b86982b9b450/buses/AEE2010.full/LS.INFO-DIV/65B.yml. Source sender alternatives: BSI; physical TX/gateway forwarding not verified. WIRE ISO-TP ONLY: normal addressing candidate, maximum Classical CAN DLC 8; actual DLC may be shorter. Data includes padding. No reassembly, text, DID or application-layer decoding. Original application layouts are preserved in source JSON; do not decode them at wire offsets. ";
CM_ SG_ 1627 FlowPadding5 "TRANSPORT_CANDIDATE: normal-addressing ISO-TP. PSA-RE bits 8.7-8.0. ";
CM_ SG_ 1627 FirstData6 "TRANSPORT_CANDIDATE: normal-addressing ISO-TP. PSA-RE bits 8.7-8.0. ";
CM_ SG_ 1627 UnknownData7 "TRANSPORT_CANDIDATE: normal-addressing ISO-TP. PSA-RE bits 8.7-8.0. ";
CM_ SG_ 1627 ConsecutiveData7 "TRANSPORT_CANDIDATE: normal-addressing ISO-TP. PSA-RE bits 8.7-8.0. ";
CM_ SG_ 1627 SingleData7 "TRANSPORT_CANDIDATE: normal-addressing ISO-TP. PSA-RE bits 8.7-8.0. ";
CM_ SG_ 1627 FlowPadding4 "TRANSPORT_CANDIDATE: normal-addressing ISO-TP. PSA-RE bits 7.7-7.0. ";
CM_ SG_ 1627 FirstData5 "TRANSPORT_CANDIDATE: normal-addressing ISO-TP. PSA-RE bits 7.7-7.0. ";
CM_ SG_ 1627 UnknownData6 "TRANSPORT_CANDIDATE: normal-addressing ISO-TP. PSA-RE bits 7.7-7.0. ";
CM_ SG_ 1627 ConsecutiveData6 "TRANSPORT_CANDIDATE: normal-addressing ISO-TP. PSA-RE bits 7.7-7.0. ";
CM_ SG_ 1627 SingleData6 "TRANSPORT_CANDIDATE: normal-addressing ISO-TP. PSA-RE bits 7.7-7.0. ";
CM_ SG_ 1627 FlowPadding3 "TRANSPORT_CANDIDATE: normal-addressing ISO-TP. PSA-RE bits 6.7-6.0. ";
CM_ SG_ 1627 FirstData4 "TRANSPORT_CANDIDATE: normal-addressing ISO-TP. PSA-RE bits 6.7-6.0. ";
CM_ SG_ 1627 UnknownData5 "TRANSPORT_CANDIDATE: normal-addressing ISO-TP. PSA-RE bits 6.7-6.0. ";
CM_ SG_ 1627 ConsecutiveData5 "TRANSPORT_CANDIDATE: normal-addressing ISO-TP. PSA-RE bits 6.7-6.0. ";
CM_ SG_ 1627 SingleData5 "TRANSPORT_CANDIDATE: normal-addressing ISO-TP. PSA-RE bits 6.7-6.0. ";
CM_ SG_ 1627 FlowPadding2 "TRANSPORT_CANDIDATE: normal-addressing ISO-TP. PSA-RE bits 5.7-5.0. ";
CM_ SG_ 1627 FirstData3 "TRANSPORT_CANDIDATE: normal-addressing ISO-TP. PSA-RE bits 5.7-5.0. ";
CM_ SG_ 1627 UnknownData4 "TRANSPORT_CANDIDATE: normal-addressing ISO-TP. PSA-RE bits 5.7-5.0. ";
CM_ SG_ 1627 ConsecutiveData4 "TRANSPORT_CANDIDATE: normal-addressing ISO-TP. PSA-RE bits 5.7-5.0. ";
CM_ SG_ 1627 SingleData4 "TRANSPORT_CANDIDATE: normal-addressing ISO-TP. PSA-RE bits 5.7-5.0. ";
CM_ SG_ 1627 FlowPadding1 "TRANSPORT_CANDIDATE: normal-addressing ISO-TP. PSA-RE bits 4.7-4.0. ";
CM_ SG_ 1627 FirstData2 "TRANSPORT_CANDIDATE: normal-addressing ISO-TP. PSA-RE bits 4.7-4.0. ";
CM_ SG_ 1627 UnknownData3 "TRANSPORT_CANDIDATE: normal-addressing ISO-TP. PSA-RE bits 4.7-4.0. ";
CM_ SG_ 1627 ConsecutiveData3 "TRANSPORT_CANDIDATE: normal-addressing ISO-TP. PSA-RE bits 4.7-4.0. ";
CM_ SG_ 1627 SingleData3 "TRANSPORT_CANDIDATE: normal-addressing ISO-TP. PSA-RE bits 4.7-4.0. ";
CM_ SG_ 1627 FirstData1 "TRANSPORT_CANDIDATE: normal-addressing ISO-TP. PSA-RE bits 3.7-3.0. ";
CM_ SG_ 1627 UnknownData2 "TRANSPORT_CANDIDATE: normal-addressing ISO-TP. PSA-RE bits 3.7-3.0. ";
CM_ SG_ 1627 ConsecutiveData2 "TRANSPORT_CANDIDATE: normal-addressing ISO-TP. PSA-RE bits 3.7-3.0. ";
CM_ SG_ 1627 SingleData2 "TRANSPORT_CANDIDATE: normal-addressing ISO-TP. PSA-RE bits 3.7-3.0. ";
CM_ SG_ 1627 SeparationTimeRaw "TRANSPORT_CANDIDATE: normal-addressing ISO-TP. PSA-RE bits 3.7-3.0. Raw STmin code; 0xF1..0xF9 are not milliseconds.";
CM_ SG_ 1627 UnknownData1 "TRANSPORT_CANDIDATE: normal-addressing ISO-TP. PSA-RE bits 2.7-2.0. ";
CM_ SG_ 1627 ConsecutiveData1 "TRANSPORT_CANDIDATE: normal-addressing ISO-TP. PSA-RE bits 2.7-2.0. ";
CM_ SG_ 1627 SingleData1 "TRANSPORT_CANDIDATE: normal-addressing ISO-TP. PSA-RE bits 2.7-2.0. ";
CM_ SG_ 1627 BlockSize "TRANSPORT_CANDIDATE: normal-addressing ISO-TP. PSA-RE bits 2.7-2.0. ";
CM_ SG_ 1627 UnknownPciLow "TRANSPORT_CANDIDATE: normal-addressing ISO-TP. PSA-RE bits 1.3-1.0. ";
CM_ SG_ 1627 FlowStatus "TRANSPORT_CANDIDATE: normal-addressing ISO-TP. PSA-RE bits 1.3-1.0. ";
CM_ SG_ 1627 ConsecutiveSequence "TRANSPORT_CANDIDATE: normal-addressing ISO-TP. PSA-RE bits 1.3-1.0. ";
CM_ SG_ 1627 FirstFrameLength "TRANSPORT_CANDIDATE: normal-addressing ISO-TP. PSA-RE bits 1.3-2.0. 12-bit declared PDU length; not a reassembled value.";
CM_ SG_ 1627 SingleFrameLength "TRANSPORT_CANDIDATE: normal-addressing ISO-TP. PSA-RE bits 1.3-1.0. Declared data length; not a validity check.";
CM_ SG_ 1627 IsoTpFrameType "TRANSPORT_CANDIDATE: normal-addressing ISO-TP. PSA-RE bits 1.7-1.4. PCI high nibble; normal addressing candidate.";
CM_ BO_ 1628 "DATABASE_CANDIDATE: physical interpretation unverified; capture/layout evidence reported separately. INFO-DIV CAN, 125000 bit/s; CAN ID 0x65C. PSA-RE title: AUS_DIAG_RESPONSE. Diagnostic response sent by the AUS ECU. Source: https://github.com/prototux/PSA-RE/blob/67f7581e7622410efdbb29c7eda3b86982b9b450/buses/AEE2010.full/LS.INFO-DIV/65C.yml. Source sender alternatives: BSI; physical TX/gateway forwarding not verified. WIRE ISO-TP ONLY: normal addressing candidate, maximum Classical CAN DLC 8; actual DLC may be shorter. Data includes padding. No reassembly, text, DID or application-layer decoding. Original application layouts are preserved in source JSON; do not decode them at wire offsets. ";
CM_ SG_ 1628 FlowPadding5 "TRANSPORT_CANDIDATE: normal-addressing ISO-TP. PSA-RE bits 8.7-8.0. ";
CM_ SG_ 1628 FirstData6 "TRANSPORT_CANDIDATE: normal-addressing ISO-TP. PSA-RE bits 8.7-8.0. ";
CM_ SG_ 1628 UnknownData7 "TRANSPORT_CANDIDATE: normal-addressing ISO-TP. PSA-RE bits 8.7-8.0. ";
CM_ SG_ 1628 ConsecutiveData7 "TRANSPORT_CANDIDATE: normal-addressing ISO-TP. PSA-RE bits 8.7-8.0. ";
CM_ SG_ 1628 SingleData7 "TRANSPORT_CANDIDATE: normal-addressing ISO-TP. PSA-RE bits 8.7-8.0. ";
CM_ SG_ 1628 FlowPadding4 "TRANSPORT_CANDIDATE: normal-addressing ISO-TP. PSA-RE bits 7.7-7.0. ";
CM_ SG_ 1628 FirstData5 "TRANSPORT_CANDIDATE: normal-addressing ISO-TP. PSA-RE bits 7.7-7.0. ";
CM_ SG_ 1628 UnknownData6 "TRANSPORT_CANDIDATE: normal-addressing ISO-TP. PSA-RE bits 7.7-7.0. ";
CM_ SG_ 1628 ConsecutiveData6 "TRANSPORT_CANDIDATE: normal-addressing ISO-TP. PSA-RE bits 7.7-7.0. ";
CM_ SG_ 1628 SingleData6 "TRANSPORT_CANDIDATE: normal-addressing ISO-TP. PSA-RE bits 7.7-7.0. ";
CM_ SG_ 1628 FlowPadding3 "TRANSPORT_CANDIDATE: normal-addressing ISO-TP. PSA-RE bits 6.7-6.0. ";
CM_ SG_ 1628 FirstData4 "TRANSPORT_CANDIDATE: normal-addressing ISO-TP. PSA-RE bits 6.7-6.0. ";
CM_ SG_ 1628 UnknownData5 "TRANSPORT_CANDIDATE: normal-addressing ISO-TP. PSA-RE bits 6.7-6.0. ";
CM_ SG_ 1628 ConsecutiveData5 "TRANSPORT_CANDIDATE: normal-addressing ISO-TP. PSA-RE bits 6.7-6.0. ";
CM_ SG_ 1628 SingleData5 "TRANSPORT_CANDIDATE: normal-addressing ISO-TP. PSA-RE bits 6.7-6.0. ";
CM_ SG_ 1628 FlowPadding2 "TRANSPORT_CANDIDATE: normal-addressing ISO-TP. PSA-RE bits 5.7-5.0. ";
CM_ SG_ 1628 FirstData3 "TRANSPORT_CANDIDATE: normal-addressing ISO-TP. PSA-RE bits 5.7-5.0. ";
CM_ SG_ 1628 UnknownData4 "TRANSPORT_CANDIDATE: normal-addressing ISO-TP. PSA-RE bits 5.7-5.0. ";
CM_ SG_ 1628 ConsecutiveData4 "TRANSPORT_CANDIDATE: normal-addressing ISO-TP. PSA-RE bits 5.7-5.0. ";
CM_ SG_ 1628 SingleData4 "TRANSPORT_CANDIDATE: normal-addressing ISO-TP. PSA-RE bits 5.7-5.0. ";
CM_ SG_ 1628 FlowPadding1 "TRANSPORT_CANDIDATE: normal-addressing ISO-TP. PSA-RE bits 4.7-4.0. ";
CM_ SG_ 1628 FirstData2 "TRANSPORT_CANDIDATE: normal-addressing ISO-TP. PSA-RE bits 4.7-4.0. ";
CM_ SG_ 1628 UnknownData3 "TRANSPORT_CANDIDATE: normal-addressing ISO-TP. PSA-RE bits 4.7-4.0. ";
CM_ SG_ 1628 ConsecutiveData3 "TRANSPORT_CANDIDATE: normal-addressing ISO-TP. PSA-RE bits 4.7-4.0. ";
CM_ SG_ 1628 SingleData3 "TRANSPORT_CANDIDATE: normal-addressing ISO-TP. PSA-RE bits 4.7-4.0. ";
CM_ SG_ 1628 FirstData1 "TRANSPORT_CANDIDATE: normal-addressing ISO-TP. PSA-RE bits 3.7-3.0. ";
CM_ SG_ 1628 UnknownData2 "TRANSPORT_CANDIDATE: normal-addressing ISO-TP. PSA-RE bits 3.7-3.0. ";
CM_ SG_ 1628 ConsecutiveData2 "TRANSPORT_CANDIDATE: normal-addressing ISO-TP. PSA-RE bits 3.7-3.0. ";
CM_ SG_ 1628 SingleData2 "TRANSPORT_CANDIDATE: normal-addressing ISO-TP. PSA-RE bits 3.7-3.0. ";
CM_ SG_ 1628 SeparationTimeRaw "TRANSPORT_CANDIDATE: normal-addressing ISO-TP. PSA-RE bits 3.7-3.0. Raw STmin code; 0xF1..0xF9 are not milliseconds.";
CM_ SG_ 1628 UnknownData1 "TRANSPORT_CANDIDATE: normal-addressing ISO-TP. PSA-RE bits 2.7-2.0. ";
CM_ SG_ 1628 ConsecutiveData1 "TRANSPORT_CANDIDATE: normal-addressing ISO-TP. PSA-RE bits 2.7-2.0. ";
CM_ SG_ 1628 SingleData1 "TRANSPORT_CANDIDATE: normal-addressing ISO-TP. PSA-RE bits 2.7-2.0. ";
CM_ SG_ 1628 BlockSize "TRANSPORT_CANDIDATE: normal-addressing ISO-TP. PSA-RE bits 2.7-2.0. ";
CM_ SG_ 1628 UnknownPciLow "TRANSPORT_CANDIDATE: normal-addressing ISO-TP. PSA-RE bits 1.3-1.0. ";
CM_ SG_ 1628 FlowStatus "TRANSPORT_CANDIDATE: normal-addressing ISO-TP. PSA-RE bits 1.3-1.0. ";
CM_ SG_ 1628 ConsecutiveSequence "TRANSPORT_CANDIDATE: normal-addressing ISO-TP. PSA-RE bits 1.3-1.0. ";
CM_ SG_ 1628 FirstFrameLength "TRANSPORT_CANDIDATE: normal-addressing ISO-TP. PSA-RE bits 1.3-2.0. 12-bit declared PDU length; not a reassembled value.";
CM_ SG_ 1628 SingleFrameLength "TRANSPORT_CANDIDATE: normal-addressing ISO-TP. PSA-RE bits 1.3-1.0. Declared data length; not a validity check.";
CM_ SG_ 1628 IsoTpFrameType "TRANSPORT_CANDIDATE: normal-addressing ISO-TP. PSA-RE bits 1.7-1.4. PCI high nibble; normal addressing candidate.";
CM_ BO_ 1629 "DATABASE_CANDIDATE: physical interpretation unverified; capture/layout evidence reported separately. INFO-DIV CAN, 125000 bit/s; CAN ID 0x65D. PSA-RE title: AAS_DIAG_RESPONSE. Diagnostic response sent by the AAS ECU. Source: https://github.com/prototux/PSA-RE/blob/67f7581e7622410efdbb29c7eda3b86982b9b450/buses/AEE2010.full/LS.INFO-DIV/65D.yml. Source sender alternatives: AAS; physical TX/gateway forwarding not verified. WIRE ISO-TP ONLY: normal addressing candidate, maximum Classical CAN DLC 8; actual DLC may be shorter. Data includes padding. No reassembly, text, DID or application-layer decoding. Original application layouts are preserved in source JSON; do not decode them at wire offsets. ";
CM_ SG_ 1629 FlowPadding5 "TRANSPORT_CANDIDATE: normal-addressing ISO-TP. PSA-RE bits 8.7-8.0. ";
CM_ SG_ 1629 FirstData6 "TRANSPORT_CANDIDATE: normal-addressing ISO-TP. PSA-RE bits 8.7-8.0. ";
CM_ SG_ 1629 UnknownData7 "TRANSPORT_CANDIDATE: normal-addressing ISO-TP. PSA-RE bits 8.7-8.0. ";
CM_ SG_ 1629 ConsecutiveData7 "TRANSPORT_CANDIDATE: normal-addressing ISO-TP. PSA-RE bits 8.7-8.0. ";
CM_ SG_ 1629 SingleData7 "TRANSPORT_CANDIDATE: normal-addressing ISO-TP. PSA-RE bits 8.7-8.0. ";
CM_ SG_ 1629 FlowPadding4 "TRANSPORT_CANDIDATE: normal-addressing ISO-TP. PSA-RE bits 7.7-7.0. ";
CM_ SG_ 1629 FirstData5 "TRANSPORT_CANDIDATE: normal-addressing ISO-TP. PSA-RE bits 7.7-7.0. ";
CM_ SG_ 1629 UnknownData6 "TRANSPORT_CANDIDATE: normal-addressing ISO-TP. PSA-RE bits 7.7-7.0. ";
CM_ SG_ 1629 ConsecutiveData6 "TRANSPORT_CANDIDATE: normal-addressing ISO-TP. PSA-RE bits 7.7-7.0. ";
CM_ SG_ 1629 SingleData6 "TRANSPORT_CANDIDATE: normal-addressing ISO-TP. PSA-RE bits 7.7-7.0. ";
CM_ SG_ 1629 FlowPadding3 "TRANSPORT_CANDIDATE: normal-addressing ISO-TP. PSA-RE bits 6.7-6.0. ";
CM_ SG_ 1629 FirstData4 "TRANSPORT_CANDIDATE: normal-addressing ISO-TP. PSA-RE bits 6.7-6.0. ";
CM_ SG_ 1629 UnknownData5 "TRANSPORT_CANDIDATE: normal-addressing ISO-TP. PSA-RE bits 6.7-6.0. ";
CM_ SG_ 1629 ConsecutiveData5 "TRANSPORT_CANDIDATE: normal-addressing ISO-TP. PSA-RE bits 6.7-6.0. ";
CM_ SG_ 1629 SingleData5 "TRANSPORT_CANDIDATE: normal-addressing ISO-TP. PSA-RE bits 6.7-6.0. ";
CM_ SG_ 1629 FlowPadding2 "TRANSPORT_CANDIDATE: normal-addressing ISO-TP. PSA-RE bits 5.7-5.0. ";
CM_ SG_ 1629 FirstData3 "TRANSPORT_CANDIDATE: normal-addressing ISO-TP. PSA-RE bits 5.7-5.0. ";
CM_ SG_ 1629 UnknownData4 "TRANSPORT_CANDIDATE: normal-addressing ISO-TP. PSA-RE bits 5.7-5.0. ";
CM_ SG_ 1629 ConsecutiveData4 "TRANSPORT_CANDIDATE: normal-addressing ISO-TP. PSA-RE bits 5.7-5.0. ";
CM_ SG_ 1629 SingleData4 "TRANSPORT_CANDIDATE: normal-addressing ISO-TP. PSA-RE bits 5.7-5.0. ";
CM_ SG_ 1629 FlowPadding1 "TRANSPORT_CANDIDATE: normal-addressing ISO-TP. PSA-RE bits 4.7-4.0. ";
CM_ SG_ 1629 FirstData2 "TRANSPORT_CANDIDATE: normal-addressing ISO-TP. PSA-RE bits 4.7-4.0. ";
CM_ SG_ 1629 UnknownData3 "TRANSPORT_CANDIDATE: normal-addressing ISO-TP. PSA-RE bits 4.7-4.0. ";
CM_ SG_ 1629 ConsecutiveData3 "TRANSPORT_CANDIDATE: normal-addressing ISO-TP. PSA-RE bits 4.7-4.0. ";
CM_ SG_ 1629 SingleData3 "TRANSPORT_CANDIDATE: normal-addressing ISO-TP. PSA-RE bits 4.7-4.0. ";
CM_ SG_ 1629 FirstData1 "TRANSPORT_CANDIDATE: normal-addressing ISO-TP. PSA-RE bits 3.7-3.0. ";
CM_ SG_ 1629 UnknownData2 "TRANSPORT_CANDIDATE: normal-addressing ISO-TP. PSA-RE bits 3.7-3.0. ";
CM_ SG_ 1629 ConsecutiveData2 "TRANSPORT_CANDIDATE: normal-addressing ISO-TP. PSA-RE bits 3.7-3.0. ";
CM_ SG_ 1629 SingleData2 "TRANSPORT_CANDIDATE: normal-addressing ISO-TP. PSA-RE bits 3.7-3.0. ";
CM_ SG_ 1629 SeparationTimeRaw "TRANSPORT_CANDIDATE: normal-addressing ISO-TP. PSA-RE bits 3.7-3.0. Raw STmin code; 0xF1..0xF9 are not milliseconds.";
CM_ SG_ 1629 UnknownData1 "TRANSPORT_CANDIDATE: normal-addressing ISO-TP. PSA-RE bits 2.7-2.0. ";
CM_ SG_ 1629 ConsecutiveData1 "TRANSPORT_CANDIDATE: normal-addressing ISO-TP. PSA-RE bits 2.7-2.0. ";
CM_ SG_ 1629 SingleData1 "TRANSPORT_CANDIDATE: normal-addressing ISO-TP. PSA-RE bits 2.7-2.0. ";
CM_ SG_ 1629 BlockSize "TRANSPORT_CANDIDATE: normal-addressing ISO-TP. PSA-RE bits 2.7-2.0. ";
CM_ SG_ 1629 UnknownPciLow "TRANSPORT_CANDIDATE: normal-addressing ISO-TP. PSA-RE bits 1.3-1.0. ";
CM_ SG_ 1629 FlowStatus "TRANSPORT_CANDIDATE: normal-addressing ISO-TP. PSA-RE bits 1.3-1.0. ";
CM_ SG_ 1629 ConsecutiveSequence "TRANSPORT_CANDIDATE: normal-addressing ISO-TP. PSA-RE bits 1.3-1.0. ";
CM_ SG_ 1629 FirstFrameLength "TRANSPORT_CANDIDATE: normal-addressing ISO-TP. PSA-RE bits 1.3-2.0. 12-bit declared PDU length; not a reassembled value.";
CM_ SG_ 1629 SingleFrameLength "TRANSPORT_CANDIDATE: normal-addressing ISO-TP. PSA-RE bits 1.3-1.0. Declared data length; not a validity check.";
CM_ SG_ 1629 IsoTpFrameType "TRANSPORT_CANDIDATE: normal-addressing ISO-TP. PSA-RE bits 1.7-1.4. PCI high nibble; normal addressing candidate.";
CM_ BO_ 1630 "DATABASE_CANDIDATE: physical interpretation unverified; capture/layout evidence reported separately. INFO-DIV CAN, 125000 bit/s; CAN ID 0x65E. PSA-RE title: MAE_DIAG_RESPONSE. Diagnostic response sent by the MAE ECU. Source: https://github.com/prototux/PSA-RE/blob/67f7581e7622410efdbb29c7eda3b86982b9b450/buses/AEE2010.full/LS.INFO-DIV/65E.yml. Source sender alternatives: BSI; physical TX/gateway forwarding not verified. WIRE ISO-TP ONLY: normal addressing candidate, maximum Classical CAN DLC 8; actual DLC may be shorter. Data includes padding. No reassembly, text, DID or application-layer decoding. Original application layouts are preserved in source JSON; do not decode them at wire offsets. ";
CM_ SG_ 1630 FlowPadding5 "TRANSPORT_CANDIDATE: normal-addressing ISO-TP. PSA-RE bits 8.7-8.0. ";
CM_ SG_ 1630 FirstData6 "TRANSPORT_CANDIDATE: normal-addressing ISO-TP. PSA-RE bits 8.7-8.0. ";
CM_ SG_ 1630 UnknownData7 "TRANSPORT_CANDIDATE: normal-addressing ISO-TP. PSA-RE bits 8.7-8.0. ";
CM_ SG_ 1630 ConsecutiveData7 "TRANSPORT_CANDIDATE: normal-addressing ISO-TP. PSA-RE bits 8.7-8.0. ";
CM_ SG_ 1630 SingleData7 "TRANSPORT_CANDIDATE: normal-addressing ISO-TP. PSA-RE bits 8.7-8.0. ";
CM_ SG_ 1630 FlowPadding4 "TRANSPORT_CANDIDATE: normal-addressing ISO-TP. PSA-RE bits 7.7-7.0. ";
CM_ SG_ 1630 FirstData5 "TRANSPORT_CANDIDATE: normal-addressing ISO-TP. PSA-RE bits 7.7-7.0. ";
CM_ SG_ 1630 UnknownData6 "TRANSPORT_CANDIDATE: normal-addressing ISO-TP. PSA-RE bits 7.7-7.0. ";
CM_ SG_ 1630 ConsecutiveData6 "TRANSPORT_CANDIDATE: normal-addressing ISO-TP. PSA-RE bits 7.7-7.0. ";
CM_ SG_ 1630 SingleData6 "TRANSPORT_CANDIDATE: normal-addressing ISO-TP. PSA-RE bits 7.7-7.0. ";
CM_ SG_ 1630 FlowPadding3 "TRANSPORT_CANDIDATE: normal-addressing ISO-TP. PSA-RE bits 6.7-6.0. ";
CM_ SG_ 1630 FirstData4 "TRANSPORT_CANDIDATE: normal-addressing ISO-TP. PSA-RE bits 6.7-6.0. ";
CM_ SG_ 1630 UnknownData5 "TRANSPORT_CANDIDATE: normal-addressing ISO-TP. PSA-RE bits 6.7-6.0. ";
CM_ SG_ 1630 ConsecutiveData5 "TRANSPORT_CANDIDATE: normal-addressing ISO-TP. PSA-RE bits 6.7-6.0. ";
CM_ SG_ 1630 SingleData5 "TRANSPORT_CANDIDATE: normal-addressing ISO-TP. PSA-RE bits 6.7-6.0. ";
CM_ SG_ 1630 FlowPadding2 "TRANSPORT_CANDIDATE: normal-addressing ISO-TP. PSA-RE bits 5.7-5.0. ";
CM_ SG_ 1630 FirstData3 "TRANSPORT_CANDIDATE: normal-addressing ISO-TP. PSA-RE bits 5.7-5.0. ";
CM_ SG_ 1630 UnknownData4 "TRANSPORT_CANDIDATE: normal-addressing ISO-TP. PSA-RE bits 5.7-5.0. ";
CM_ SG_ 1630 ConsecutiveData4 "TRANSPORT_CANDIDATE: normal-addressing ISO-TP. PSA-RE bits 5.7-5.0. ";
CM_ SG_ 1630 SingleData4 "TRANSPORT_CANDIDATE: normal-addressing ISO-TP. PSA-RE bits 5.7-5.0. ";
CM_ SG_ 1630 FlowPadding1 "TRANSPORT_CANDIDATE: normal-addressing ISO-TP. PSA-RE bits 4.7-4.0. ";
CM_ SG_ 1630 FirstData2 "TRANSPORT_CANDIDATE: normal-addressing ISO-TP. PSA-RE bits 4.7-4.0. ";
CM_ SG_ 1630 UnknownData3 "TRANSPORT_CANDIDATE: normal-addressing ISO-TP. PSA-RE bits 4.7-4.0. ";
CM_ SG_ 1630 ConsecutiveData3 "TRANSPORT_CANDIDATE: normal-addressing ISO-TP. PSA-RE bits 4.7-4.0. ";
CM_ SG_ 1630 SingleData3 "TRANSPORT_CANDIDATE: normal-addressing ISO-TP. PSA-RE bits 4.7-4.0. ";
CM_ SG_ 1630 FirstData1 "TRANSPORT_CANDIDATE: normal-addressing ISO-TP. PSA-RE bits 3.7-3.0. ";
CM_ SG_ 1630 UnknownData2 "TRANSPORT_CANDIDATE: normal-addressing ISO-TP. PSA-RE bits 3.7-3.0. ";
CM_ SG_ 1630 ConsecutiveData2 "TRANSPORT_CANDIDATE: normal-addressing ISO-TP. PSA-RE bits 3.7-3.0. ";
CM_ SG_ 1630 SingleData2 "TRANSPORT_CANDIDATE: normal-addressing ISO-TP. PSA-RE bits 3.7-3.0. ";
CM_ SG_ 1630 SeparationTimeRaw "TRANSPORT_CANDIDATE: normal-addressing ISO-TP. PSA-RE bits 3.7-3.0. Raw STmin code; 0xF1..0xF9 are not milliseconds.";
CM_ SG_ 1630 UnknownData1 "TRANSPORT_CANDIDATE: normal-addressing ISO-TP. PSA-RE bits 2.7-2.0. ";
CM_ SG_ 1630 ConsecutiveData1 "TRANSPORT_CANDIDATE: normal-addressing ISO-TP. PSA-RE bits 2.7-2.0. ";
CM_ SG_ 1630 SingleData1 "TRANSPORT_CANDIDATE: normal-addressing ISO-TP. PSA-RE bits 2.7-2.0. ";
CM_ SG_ 1630 BlockSize "TRANSPORT_CANDIDATE: normal-addressing ISO-TP. PSA-RE bits 2.7-2.0. ";
CM_ SG_ 1630 UnknownPciLow "TRANSPORT_CANDIDATE: normal-addressing ISO-TP. PSA-RE bits 1.3-1.0. ";
CM_ SG_ 1630 FlowStatus "TRANSPORT_CANDIDATE: normal-addressing ISO-TP. PSA-RE bits 1.3-1.0. ";
CM_ SG_ 1630 ConsecutiveSequence "TRANSPORT_CANDIDATE: normal-addressing ISO-TP. PSA-RE bits 1.3-1.0. ";
CM_ SG_ 1630 FirstFrameLength "TRANSPORT_CANDIDATE: normal-addressing ISO-TP. PSA-RE bits 1.3-2.0. 12-bit declared PDU length; not a reassembled value.";
CM_ SG_ 1630 SingleFrameLength "TRANSPORT_CANDIDATE: normal-addressing ISO-TP. PSA-RE bits 1.3-1.0. Declared data length; not a validity check.";
CM_ SG_ 1630 IsoTpFrameType "TRANSPORT_CANDIDATE: normal-addressing ISO-TP. PSA-RE bits 1.7-1.4. PCI high nibble; normal addressing candidate.";
CM_ BO_ 1631 "DATABASE_CANDIDATE: physical interpretation unverified; capture/layout evidence reported separately. INFO-DIV CAN, 125000 bit/s; CAN ID 0x65F. PSA-RE title: CMB_DIAG_RESPONSE. Diagnostic response sent by the CMB ECU. Source: https://github.com/prototux/PSA-RE/blob/67f7581e7622410efdbb29c7eda3b86982b9b450/buses/AEE2010.full/LS.INFO-DIV/65F.yml. Source sender alternatives: CMB; physical TX/gateway forwarding not verified. WIRE ISO-TP ONLY: normal addressing candidate, maximum Classical CAN DLC 8; actual DLC may be shorter. Data includes padding. No reassembly, text, DID or application-layer decoding. Original application layouts are preserved in source JSON; do not decode them at wire offsets. ";
CM_ SG_ 1631 FlowPadding5 "TRANSPORT_CANDIDATE: normal-addressing ISO-TP. PSA-RE bits 8.7-8.0. ";
CM_ SG_ 1631 FirstData6 "TRANSPORT_CANDIDATE: normal-addressing ISO-TP. PSA-RE bits 8.7-8.0. ";
CM_ SG_ 1631 UnknownData7 "TRANSPORT_CANDIDATE: normal-addressing ISO-TP. PSA-RE bits 8.7-8.0. ";
CM_ SG_ 1631 ConsecutiveData7 "TRANSPORT_CANDIDATE: normal-addressing ISO-TP. PSA-RE bits 8.7-8.0. ";
CM_ SG_ 1631 SingleData7 "TRANSPORT_CANDIDATE: normal-addressing ISO-TP. PSA-RE bits 8.7-8.0. ";
CM_ SG_ 1631 FlowPadding4 "TRANSPORT_CANDIDATE: normal-addressing ISO-TP. PSA-RE bits 7.7-7.0. ";
CM_ SG_ 1631 FirstData5 "TRANSPORT_CANDIDATE: normal-addressing ISO-TP. PSA-RE bits 7.7-7.0. ";
CM_ SG_ 1631 UnknownData6 "TRANSPORT_CANDIDATE: normal-addressing ISO-TP. PSA-RE bits 7.7-7.0. ";
CM_ SG_ 1631 ConsecutiveData6 "TRANSPORT_CANDIDATE: normal-addressing ISO-TP. PSA-RE bits 7.7-7.0. ";
CM_ SG_ 1631 SingleData6 "TRANSPORT_CANDIDATE: normal-addressing ISO-TP. PSA-RE bits 7.7-7.0. ";
CM_ SG_ 1631 FlowPadding3 "TRANSPORT_CANDIDATE: normal-addressing ISO-TP. PSA-RE bits 6.7-6.0. ";
CM_ SG_ 1631 FirstData4 "TRANSPORT_CANDIDATE: normal-addressing ISO-TP. PSA-RE bits 6.7-6.0. ";
CM_ SG_ 1631 UnknownData5 "TRANSPORT_CANDIDATE: normal-addressing ISO-TP. PSA-RE bits 6.7-6.0. ";
CM_ SG_ 1631 ConsecutiveData5 "TRANSPORT_CANDIDATE: normal-addressing ISO-TP. PSA-RE bits 6.7-6.0. ";
CM_ SG_ 1631 SingleData5 "TRANSPORT_CANDIDATE: normal-addressing ISO-TP. PSA-RE bits 6.7-6.0. ";
CM_ SG_ 1631 FlowPadding2 "TRANSPORT_CANDIDATE: normal-addressing ISO-TP. PSA-RE bits 5.7-5.0. ";
CM_ SG_ 1631 FirstData3 "TRANSPORT_CANDIDATE: normal-addressing ISO-TP. PSA-RE bits 5.7-5.0. ";
CM_ SG_ 1631 UnknownData4 "TRANSPORT_CANDIDATE: normal-addressing ISO-TP. PSA-RE bits 5.7-5.0. ";
CM_ SG_ 1631 ConsecutiveData4 "TRANSPORT_CANDIDATE: normal-addressing ISO-TP. PSA-RE bits 5.7-5.0. ";
CM_ SG_ 1631 SingleData4 "TRANSPORT_CANDIDATE: normal-addressing ISO-TP. PSA-RE bits 5.7-5.0. ";
CM_ SG_ 1631 FlowPadding1 "TRANSPORT_CANDIDATE: normal-addressing ISO-TP. PSA-RE bits 4.7-4.0. ";
CM_ SG_ 1631 FirstData2 "TRANSPORT_CANDIDATE: normal-addressing ISO-TP. PSA-RE bits 4.7-4.0. ";
CM_ SG_ 1631 UnknownData3 "TRANSPORT_CANDIDATE: normal-addressing ISO-TP. PSA-RE bits 4.7-4.0. ";
CM_ SG_ 1631 ConsecutiveData3 "TRANSPORT_CANDIDATE: normal-addressing ISO-TP. PSA-RE bits 4.7-4.0. ";
CM_ SG_ 1631 SingleData3 "TRANSPORT_CANDIDATE: normal-addressing ISO-TP. PSA-RE bits 4.7-4.0. ";
CM_ SG_ 1631 FirstData1 "TRANSPORT_CANDIDATE: normal-addressing ISO-TP. PSA-RE bits 3.7-3.0. ";
CM_ SG_ 1631 UnknownData2 "TRANSPORT_CANDIDATE: normal-addressing ISO-TP. PSA-RE bits 3.7-3.0. ";
CM_ SG_ 1631 ConsecutiveData2 "TRANSPORT_CANDIDATE: normal-addressing ISO-TP. PSA-RE bits 3.7-3.0. ";
CM_ SG_ 1631 SingleData2 "TRANSPORT_CANDIDATE: normal-addressing ISO-TP. PSA-RE bits 3.7-3.0. ";
CM_ SG_ 1631 SeparationTimeRaw "TRANSPORT_CANDIDATE: normal-addressing ISO-TP. PSA-RE bits 3.7-3.0. Raw STmin code; 0xF1..0xF9 are not milliseconds.";
CM_ SG_ 1631 UnknownData1 "TRANSPORT_CANDIDATE: normal-addressing ISO-TP. PSA-RE bits 2.7-2.0. ";
CM_ SG_ 1631 ConsecutiveData1 "TRANSPORT_CANDIDATE: normal-addressing ISO-TP. PSA-RE bits 2.7-2.0. ";
CM_ SG_ 1631 SingleData1 "TRANSPORT_CANDIDATE: normal-addressing ISO-TP. PSA-RE bits 2.7-2.0. ";
CM_ SG_ 1631 BlockSize "TRANSPORT_CANDIDATE: normal-addressing ISO-TP. PSA-RE bits 2.7-2.0. ";
CM_ SG_ 1631 UnknownPciLow "TRANSPORT_CANDIDATE: normal-addressing ISO-TP. PSA-RE bits 1.3-1.0. ";
CM_ SG_ 1631 FlowStatus "TRANSPORT_CANDIDATE: normal-addressing ISO-TP. PSA-RE bits 1.3-1.0. ";
CM_ SG_ 1631 ConsecutiveSequence "TRANSPORT_CANDIDATE: normal-addressing ISO-TP. PSA-RE bits 1.3-1.0. ";
CM_ SG_ 1631 FirstFrameLength "TRANSPORT_CANDIDATE: normal-addressing ISO-TP. PSA-RE bits 1.3-2.0. 12-bit declared PDU length; not a reassembled value.";
CM_ SG_ 1631 SingleFrameLength "TRANSPORT_CANDIDATE: normal-addressing ISO-TP. PSA-RE bits 1.3-1.0. Declared data length; not a validity check.";
CM_ SG_ 1631 IsoTpFrameType "TRANSPORT_CANDIDATE: normal-addressing ISO-TP. PSA-RE bits 1.7-1.4. PCI high nibble; normal addressing candidate.";
CM_ BO_ 1632 "DATABASE_CANDIDATE: physical interpretation unverified; capture/layout evidence reported separately. INFO-DIV CAN, 125000 bit/s; CAN ID 0x660. PSA-RE title: RAD_DIAG_RESPONSE. Diagnostic response sent by the RAD ECU. Source: https://github.com/prototux/PSA-RE/blob/67f7581e7622410efdbb29c7eda3b86982b9b450/buses/AEE2010.full/LS.INFO-DIV/660.yml. Source sender alternatives: BTEL,RAD,ICSV; physical TX/gateway forwarding not verified. WIRE ISO-TP ONLY: normal addressing candidate, maximum Classical CAN DLC 8; actual DLC may be shorter. Data includes padding. No reassembly, text, DID or application-layer decoding. Original application layouts are preserved in source JSON; do not decode them at wire offsets. ";
CM_ SG_ 1632 FlowPadding5 "TRANSPORT_CANDIDATE: normal-addressing ISO-TP. PSA-RE bits 8.7-8.0. ";
CM_ SG_ 1632 FirstData6 "TRANSPORT_CANDIDATE: normal-addressing ISO-TP. PSA-RE bits 8.7-8.0. ";
CM_ SG_ 1632 UnknownData7 "TRANSPORT_CANDIDATE: normal-addressing ISO-TP. PSA-RE bits 8.7-8.0. ";
CM_ SG_ 1632 ConsecutiveData7 "TRANSPORT_CANDIDATE: normal-addressing ISO-TP. PSA-RE bits 8.7-8.0. ";
CM_ SG_ 1632 SingleData7 "TRANSPORT_CANDIDATE: normal-addressing ISO-TP. PSA-RE bits 8.7-8.0. ";
CM_ SG_ 1632 FlowPadding4 "TRANSPORT_CANDIDATE: normal-addressing ISO-TP. PSA-RE bits 7.7-7.0. ";
CM_ SG_ 1632 FirstData5 "TRANSPORT_CANDIDATE: normal-addressing ISO-TP. PSA-RE bits 7.7-7.0. ";
CM_ SG_ 1632 UnknownData6 "TRANSPORT_CANDIDATE: normal-addressing ISO-TP. PSA-RE bits 7.7-7.0. ";
CM_ SG_ 1632 ConsecutiveData6 "TRANSPORT_CANDIDATE: normal-addressing ISO-TP. PSA-RE bits 7.7-7.0. ";
CM_ SG_ 1632 SingleData6 "TRANSPORT_CANDIDATE: normal-addressing ISO-TP. PSA-RE bits 7.7-7.0. ";
CM_ SG_ 1632 FlowPadding3 "TRANSPORT_CANDIDATE: normal-addressing ISO-TP. PSA-RE bits 6.7-6.0. ";
CM_ SG_ 1632 FirstData4 "TRANSPORT_CANDIDATE: normal-addressing ISO-TP. PSA-RE bits 6.7-6.0. ";
CM_ SG_ 1632 UnknownData5 "TRANSPORT_CANDIDATE: normal-addressing ISO-TP. PSA-RE bits 6.7-6.0. ";
CM_ SG_ 1632 ConsecutiveData5 "TRANSPORT_CANDIDATE: normal-addressing ISO-TP. PSA-RE bits 6.7-6.0. ";
CM_ SG_ 1632 SingleData5 "TRANSPORT_CANDIDATE: normal-addressing ISO-TP. PSA-RE bits 6.7-6.0. ";
CM_ SG_ 1632 FlowPadding2 "TRANSPORT_CANDIDATE: normal-addressing ISO-TP. PSA-RE bits 5.7-5.0. ";
CM_ SG_ 1632 FirstData3 "TRANSPORT_CANDIDATE: normal-addressing ISO-TP. PSA-RE bits 5.7-5.0. ";
CM_ SG_ 1632 UnknownData4 "TRANSPORT_CANDIDATE: normal-addressing ISO-TP. PSA-RE bits 5.7-5.0. ";
CM_ SG_ 1632 ConsecutiveData4 "TRANSPORT_CANDIDATE: normal-addressing ISO-TP. PSA-RE bits 5.7-5.0. ";
CM_ SG_ 1632 SingleData4 "TRANSPORT_CANDIDATE: normal-addressing ISO-TP. PSA-RE bits 5.7-5.0. ";
CM_ SG_ 1632 FlowPadding1 "TRANSPORT_CANDIDATE: normal-addressing ISO-TP. PSA-RE bits 4.7-4.0. ";
CM_ SG_ 1632 FirstData2 "TRANSPORT_CANDIDATE: normal-addressing ISO-TP. PSA-RE bits 4.7-4.0. ";
CM_ SG_ 1632 UnknownData3 "TRANSPORT_CANDIDATE: normal-addressing ISO-TP. PSA-RE bits 4.7-4.0. ";
CM_ SG_ 1632 ConsecutiveData3 "TRANSPORT_CANDIDATE: normal-addressing ISO-TP. PSA-RE bits 4.7-4.0. ";
CM_ SG_ 1632 SingleData3 "TRANSPORT_CANDIDATE: normal-addressing ISO-TP. PSA-RE bits 4.7-4.0. ";
CM_ SG_ 1632 FirstData1 "TRANSPORT_CANDIDATE: normal-addressing ISO-TP. PSA-RE bits 3.7-3.0. ";
CM_ SG_ 1632 UnknownData2 "TRANSPORT_CANDIDATE: normal-addressing ISO-TP. PSA-RE bits 3.7-3.0. ";
CM_ SG_ 1632 ConsecutiveData2 "TRANSPORT_CANDIDATE: normal-addressing ISO-TP. PSA-RE bits 3.7-3.0. ";
CM_ SG_ 1632 SingleData2 "TRANSPORT_CANDIDATE: normal-addressing ISO-TP. PSA-RE bits 3.7-3.0. ";
CM_ SG_ 1632 SeparationTimeRaw "TRANSPORT_CANDIDATE: normal-addressing ISO-TP. PSA-RE bits 3.7-3.0. Raw STmin code; 0xF1..0xF9 are not milliseconds.";
CM_ SG_ 1632 UnknownData1 "TRANSPORT_CANDIDATE: normal-addressing ISO-TP. PSA-RE bits 2.7-2.0. ";
CM_ SG_ 1632 ConsecutiveData1 "TRANSPORT_CANDIDATE: normal-addressing ISO-TP. PSA-RE bits 2.7-2.0. ";
CM_ SG_ 1632 SingleData1 "TRANSPORT_CANDIDATE: normal-addressing ISO-TP. PSA-RE bits 2.7-2.0. ";
CM_ SG_ 1632 BlockSize "TRANSPORT_CANDIDATE: normal-addressing ISO-TP. PSA-RE bits 2.7-2.0. ";
CM_ SG_ 1632 UnknownPciLow "TRANSPORT_CANDIDATE: normal-addressing ISO-TP. PSA-RE bits 1.3-1.0. ";
CM_ SG_ 1632 FlowStatus "TRANSPORT_CANDIDATE: normal-addressing ISO-TP. PSA-RE bits 1.3-1.0. ";
CM_ SG_ 1632 ConsecutiveSequence "TRANSPORT_CANDIDATE: normal-addressing ISO-TP. PSA-RE bits 1.3-1.0. ";
CM_ SG_ 1632 FirstFrameLength "TRANSPORT_CANDIDATE: normal-addressing ISO-TP. PSA-RE bits 1.3-2.0. 12-bit declared PDU length; not a reassembled value.";
CM_ SG_ 1632 SingleFrameLength "TRANSPORT_CANDIDATE: normal-addressing ISO-TP. PSA-RE bits 1.3-1.0. Declared data length; not a validity check.";
CM_ SG_ 1632 IsoTpFrameType "TRANSPORT_CANDIDATE: normal-addressing ISO-TP. PSA-RE bits 1.7-1.4. PCI high nibble; normal addressing candidate.";
CM_ BO_ 1633 "DATABASE_CANDIDATE: physical interpretation unverified; capture/layout evidence reported separately. INFO-DIV CAN, 125000 bit/s; CAN ID 0x661. PSA-RE title: IVC_D_DIAG_RESPONSE. Diagnostic response sent by the IVC_D ECU. Source: https://github.com/prototux/PSA-RE/blob/67f7581e7622410efdbb29c7eda3b86982b9b450/buses/AEE2010.full/LS.INFO-DIV/661.yml. Source sender alternatives: BSI; physical TX/gateway forwarding not verified. WIRE ISO-TP ONLY: normal addressing candidate, maximum Classical CAN DLC 8; actual DLC may be shorter. Data includes padding. No reassembly, text, DID or application-layer decoding. Original application layouts are preserved in source JSON; do not decode them at wire offsets. ";
CM_ SG_ 1633 FlowPadding5 "TRANSPORT_CANDIDATE: normal-addressing ISO-TP. PSA-RE bits 8.7-8.0. ";
CM_ SG_ 1633 FirstData6 "TRANSPORT_CANDIDATE: normal-addressing ISO-TP. PSA-RE bits 8.7-8.0. ";
CM_ SG_ 1633 UnknownData7 "TRANSPORT_CANDIDATE: normal-addressing ISO-TP. PSA-RE bits 8.7-8.0. ";
CM_ SG_ 1633 ConsecutiveData7 "TRANSPORT_CANDIDATE: normal-addressing ISO-TP. PSA-RE bits 8.7-8.0. ";
CM_ SG_ 1633 SingleData7 "TRANSPORT_CANDIDATE: normal-addressing ISO-TP. PSA-RE bits 8.7-8.0. ";
CM_ SG_ 1633 FlowPadding4 "TRANSPORT_CANDIDATE: normal-addressing ISO-TP. PSA-RE bits 7.7-7.0. ";
CM_ SG_ 1633 FirstData5 "TRANSPORT_CANDIDATE: normal-addressing ISO-TP. PSA-RE bits 7.7-7.0. ";
CM_ SG_ 1633 UnknownData6 "TRANSPORT_CANDIDATE: normal-addressing ISO-TP. PSA-RE bits 7.7-7.0. ";
CM_ SG_ 1633 ConsecutiveData6 "TRANSPORT_CANDIDATE: normal-addressing ISO-TP. PSA-RE bits 7.7-7.0. ";
CM_ SG_ 1633 SingleData6 "TRANSPORT_CANDIDATE: normal-addressing ISO-TP. PSA-RE bits 7.7-7.0. ";
CM_ SG_ 1633 FlowPadding3 "TRANSPORT_CANDIDATE: normal-addressing ISO-TP. PSA-RE bits 6.7-6.0. ";
CM_ SG_ 1633 FirstData4 "TRANSPORT_CANDIDATE: normal-addressing ISO-TP. PSA-RE bits 6.7-6.0. ";
CM_ SG_ 1633 UnknownData5 "TRANSPORT_CANDIDATE: normal-addressing ISO-TP. PSA-RE bits 6.7-6.0. ";
CM_ SG_ 1633 ConsecutiveData5 "TRANSPORT_CANDIDATE: normal-addressing ISO-TP. PSA-RE bits 6.7-6.0. ";
CM_ SG_ 1633 SingleData5 "TRANSPORT_CANDIDATE: normal-addressing ISO-TP. PSA-RE bits 6.7-6.0. ";
CM_ SG_ 1633 FlowPadding2 "TRANSPORT_CANDIDATE: normal-addressing ISO-TP. PSA-RE bits 5.7-5.0. ";
CM_ SG_ 1633 FirstData3 "TRANSPORT_CANDIDATE: normal-addressing ISO-TP. PSA-RE bits 5.7-5.0. ";
CM_ SG_ 1633 UnknownData4 "TRANSPORT_CANDIDATE: normal-addressing ISO-TP. PSA-RE bits 5.7-5.0. ";
CM_ SG_ 1633 ConsecutiveData4 "TRANSPORT_CANDIDATE: normal-addressing ISO-TP. PSA-RE bits 5.7-5.0. ";
CM_ SG_ 1633 SingleData4 "TRANSPORT_CANDIDATE: normal-addressing ISO-TP. PSA-RE bits 5.7-5.0. ";
CM_ SG_ 1633 FlowPadding1 "TRANSPORT_CANDIDATE: normal-addressing ISO-TP. PSA-RE bits 4.7-4.0. ";
CM_ SG_ 1633 FirstData2 "TRANSPORT_CANDIDATE: normal-addressing ISO-TP. PSA-RE bits 4.7-4.0. ";
CM_ SG_ 1633 UnknownData3 "TRANSPORT_CANDIDATE: normal-addressing ISO-TP. PSA-RE bits 4.7-4.0. ";
CM_ SG_ 1633 ConsecutiveData3 "TRANSPORT_CANDIDATE: normal-addressing ISO-TP. PSA-RE bits 4.7-4.0. ";
CM_ SG_ 1633 SingleData3 "TRANSPORT_CANDIDATE: normal-addressing ISO-TP. PSA-RE bits 4.7-4.0. ";
CM_ SG_ 1633 FirstData1 "TRANSPORT_CANDIDATE: normal-addressing ISO-TP. PSA-RE bits 3.7-3.0. ";
CM_ SG_ 1633 UnknownData2 "TRANSPORT_CANDIDATE: normal-addressing ISO-TP. PSA-RE bits 3.7-3.0. ";
CM_ SG_ 1633 ConsecutiveData2 "TRANSPORT_CANDIDATE: normal-addressing ISO-TP. PSA-RE bits 3.7-3.0. ";
CM_ SG_ 1633 SingleData2 "TRANSPORT_CANDIDATE: normal-addressing ISO-TP. PSA-RE bits 3.7-3.0. ";
CM_ SG_ 1633 SeparationTimeRaw "TRANSPORT_CANDIDATE: normal-addressing ISO-TP. PSA-RE bits 3.7-3.0. Raw STmin code; 0xF1..0xF9 are not milliseconds.";
CM_ SG_ 1633 UnknownData1 "TRANSPORT_CANDIDATE: normal-addressing ISO-TP. PSA-RE bits 2.7-2.0. ";
CM_ SG_ 1633 ConsecutiveData1 "TRANSPORT_CANDIDATE: normal-addressing ISO-TP. PSA-RE bits 2.7-2.0. ";
CM_ SG_ 1633 SingleData1 "TRANSPORT_CANDIDATE: normal-addressing ISO-TP. PSA-RE bits 2.7-2.0. ";
CM_ SG_ 1633 BlockSize "TRANSPORT_CANDIDATE: normal-addressing ISO-TP. PSA-RE bits 2.7-2.0. ";
CM_ SG_ 1633 UnknownPciLow "TRANSPORT_CANDIDATE: normal-addressing ISO-TP. PSA-RE bits 1.3-1.0. ";
CM_ SG_ 1633 FlowStatus "TRANSPORT_CANDIDATE: normal-addressing ISO-TP. PSA-RE bits 1.3-1.0. ";
CM_ SG_ 1633 ConsecutiveSequence "TRANSPORT_CANDIDATE: normal-addressing ISO-TP. PSA-RE bits 1.3-1.0. ";
CM_ SG_ 1633 FirstFrameLength "TRANSPORT_CANDIDATE: normal-addressing ISO-TP. PSA-RE bits 1.3-2.0. 12-bit declared PDU length; not a reassembled value.";
CM_ SG_ 1633 SingleFrameLength "TRANSPORT_CANDIDATE: normal-addressing ISO-TP. PSA-RE bits 1.3-1.0. Declared data length; not a validity check.";
CM_ SG_ 1633 IsoTpFrameType "TRANSPORT_CANDIDATE: normal-addressing ISO-TP. PSA-RE bits 1.7-1.4. PCI high nibble; normal addressing candidate.";
CM_ BO_ 1634 "DATABASE_CANDIDATE: physical interpretation unverified; capture/layout evidence reported separately. INFO-DIV CAN, 125000 bit/s; CAN ID 0x662. PSA-RE title: STL_DIAG_RESPONSE. Diagnostic response sent by the STL ECU. Source: https://github.com/prototux/PSA-RE/blob/67f7581e7622410efdbb29c7eda3b86982b9b450/buses/AEE2010.full/LS.INFO-DIV/662.yml. Source sender alternatives: BSI; physical TX/gateway forwarding not verified. WIRE ISO-TP ONLY: normal addressing candidate, maximum Classical CAN DLC 8; actual DLC may be shorter. Data includes padding. No reassembly, text, DID or application-layer decoding. Original application layouts are preserved in source JSON; do not decode them at wire offsets. ";
CM_ SG_ 1634 FlowPadding5 "TRANSPORT_CANDIDATE: normal-addressing ISO-TP. PSA-RE bits 8.7-8.0. ";
CM_ SG_ 1634 FirstData6 "TRANSPORT_CANDIDATE: normal-addressing ISO-TP. PSA-RE bits 8.7-8.0. ";
CM_ SG_ 1634 UnknownData7 "TRANSPORT_CANDIDATE: normal-addressing ISO-TP. PSA-RE bits 8.7-8.0. ";
CM_ SG_ 1634 ConsecutiveData7 "TRANSPORT_CANDIDATE: normal-addressing ISO-TP. PSA-RE bits 8.7-8.0. ";
CM_ SG_ 1634 SingleData7 "TRANSPORT_CANDIDATE: normal-addressing ISO-TP. PSA-RE bits 8.7-8.0. ";
CM_ SG_ 1634 FlowPadding4 "TRANSPORT_CANDIDATE: normal-addressing ISO-TP. PSA-RE bits 7.7-7.0. ";
CM_ SG_ 1634 FirstData5 "TRANSPORT_CANDIDATE: normal-addressing ISO-TP. PSA-RE bits 7.7-7.0. ";
CM_ SG_ 1634 UnknownData6 "TRANSPORT_CANDIDATE: normal-addressing ISO-TP. PSA-RE bits 7.7-7.0. ";
CM_ SG_ 1634 ConsecutiveData6 "TRANSPORT_CANDIDATE: normal-addressing ISO-TP. PSA-RE bits 7.7-7.0. ";
CM_ SG_ 1634 SingleData6 "TRANSPORT_CANDIDATE: normal-addressing ISO-TP. PSA-RE bits 7.7-7.0. ";
CM_ SG_ 1634 FlowPadding3 "TRANSPORT_CANDIDATE: normal-addressing ISO-TP. PSA-RE bits 6.7-6.0. ";
CM_ SG_ 1634 FirstData4 "TRANSPORT_CANDIDATE: normal-addressing ISO-TP. PSA-RE bits 6.7-6.0. ";
CM_ SG_ 1634 UnknownData5 "TRANSPORT_CANDIDATE: normal-addressing ISO-TP. PSA-RE bits 6.7-6.0. ";
CM_ SG_ 1634 ConsecutiveData5 "TRANSPORT_CANDIDATE: normal-addressing ISO-TP. PSA-RE bits 6.7-6.0. ";
CM_ SG_ 1634 SingleData5 "TRANSPORT_CANDIDATE: normal-addressing ISO-TP. PSA-RE bits 6.7-6.0. ";
CM_ SG_ 1634 FlowPadding2 "TRANSPORT_CANDIDATE: normal-addressing ISO-TP. PSA-RE bits 5.7-5.0. ";
CM_ SG_ 1634 FirstData3 "TRANSPORT_CANDIDATE: normal-addressing ISO-TP. PSA-RE bits 5.7-5.0. ";
CM_ SG_ 1634 UnknownData4 "TRANSPORT_CANDIDATE: normal-addressing ISO-TP. PSA-RE bits 5.7-5.0. ";
CM_ SG_ 1634 ConsecutiveData4 "TRANSPORT_CANDIDATE: normal-addressing ISO-TP. PSA-RE bits 5.7-5.0. ";
CM_ SG_ 1634 SingleData4 "TRANSPORT_CANDIDATE: normal-addressing ISO-TP. PSA-RE bits 5.7-5.0. ";
CM_ SG_ 1634 FlowPadding1 "TRANSPORT_CANDIDATE: normal-addressing ISO-TP. PSA-RE bits 4.7-4.0. ";
CM_ SG_ 1634 FirstData2 "TRANSPORT_CANDIDATE: normal-addressing ISO-TP. PSA-RE bits 4.7-4.0. ";
CM_ SG_ 1634 UnknownData3 "TRANSPORT_CANDIDATE: normal-addressing ISO-TP. PSA-RE bits 4.7-4.0. ";
CM_ SG_ 1634 ConsecutiveData3 "TRANSPORT_CANDIDATE: normal-addressing ISO-TP. PSA-RE bits 4.7-4.0. ";
CM_ SG_ 1634 SingleData3 "TRANSPORT_CANDIDATE: normal-addressing ISO-TP. PSA-RE bits 4.7-4.0. ";
CM_ SG_ 1634 FirstData1 "TRANSPORT_CANDIDATE: normal-addressing ISO-TP. PSA-RE bits 3.7-3.0. ";
CM_ SG_ 1634 UnknownData2 "TRANSPORT_CANDIDATE: normal-addressing ISO-TP. PSA-RE bits 3.7-3.0. ";
CM_ SG_ 1634 ConsecutiveData2 "TRANSPORT_CANDIDATE: normal-addressing ISO-TP. PSA-RE bits 3.7-3.0. ";
CM_ SG_ 1634 SingleData2 "TRANSPORT_CANDIDATE: normal-addressing ISO-TP. PSA-RE bits 3.7-3.0. ";
CM_ SG_ 1634 SeparationTimeRaw "TRANSPORT_CANDIDATE: normal-addressing ISO-TP. PSA-RE bits 3.7-3.0. Raw STmin code; 0xF1..0xF9 are not milliseconds.";
CM_ SG_ 1634 UnknownData1 "TRANSPORT_CANDIDATE: normal-addressing ISO-TP. PSA-RE bits 2.7-2.0. ";
CM_ SG_ 1634 ConsecutiveData1 "TRANSPORT_CANDIDATE: normal-addressing ISO-TP. PSA-RE bits 2.7-2.0. ";
CM_ SG_ 1634 SingleData1 "TRANSPORT_CANDIDATE: normal-addressing ISO-TP. PSA-RE bits 2.7-2.0. ";
CM_ SG_ 1634 BlockSize "TRANSPORT_CANDIDATE: normal-addressing ISO-TP. PSA-RE bits 2.7-2.0. ";
CM_ SG_ 1634 UnknownPciLow "TRANSPORT_CANDIDATE: normal-addressing ISO-TP. PSA-RE bits 1.3-1.0. ";
CM_ SG_ 1634 FlowStatus "TRANSPORT_CANDIDATE: normal-addressing ISO-TP. PSA-RE bits 1.3-1.0. ";
CM_ SG_ 1634 ConsecutiveSequence "TRANSPORT_CANDIDATE: normal-addressing ISO-TP. PSA-RE bits 1.3-1.0. ";
CM_ SG_ 1634 FirstFrameLength "TRANSPORT_CANDIDATE: normal-addressing ISO-TP. PSA-RE bits 1.3-2.0. 12-bit declared PDU length; not a reassembled value.";
CM_ SG_ 1634 SingleFrameLength "TRANSPORT_CANDIDATE: normal-addressing ISO-TP. PSA-RE bits 1.3-1.0. Declared data length; not a validity check.";
CM_ SG_ 1634 IsoTpFrameType "TRANSPORT_CANDIDATE: normal-addressing ISO-TP. PSA-RE bits 1.7-1.4. PCI high nibble; normal addressing candidate.";
CM_ BO_ 1635 "DATABASE_CANDIDATE: physical interpretation unverified; capture/layout evidence reported separately. INFO-DIV CAN, 125000 bit/s; CAN ID 0x663. PSA-RE title: IDVR_DIAG_RESPONSE. Diagnostic response sent by the IDVR ECU. Source: https://github.com/prototux/PSA-RE/blob/67f7581e7622410efdbb29c7eda3b86982b9b450/buses/AEE2010.full/LS.INFO-DIV/663.yml. Source sender alternatives: IDVR; physical TX/gateway forwarding not verified. WIRE ISO-TP ONLY: normal addressing candidate, maximum Classical CAN DLC 8; actual DLC may be shorter. Data includes padding. No reassembly, text, DID or application-layer decoding. Original application layouts are preserved in source JSON; do not decode them at wire offsets. ";
CM_ SG_ 1635 FlowPadding5 "TRANSPORT_CANDIDATE: normal-addressing ISO-TP. PSA-RE bits 8.7-8.0. ";
CM_ SG_ 1635 FirstData6 "TRANSPORT_CANDIDATE: normal-addressing ISO-TP. PSA-RE bits 8.7-8.0. ";
CM_ SG_ 1635 UnknownData7 "TRANSPORT_CANDIDATE: normal-addressing ISO-TP. PSA-RE bits 8.7-8.0. ";
CM_ SG_ 1635 ConsecutiveData7 "TRANSPORT_CANDIDATE: normal-addressing ISO-TP. PSA-RE bits 8.7-8.0. ";
CM_ SG_ 1635 SingleData7 "TRANSPORT_CANDIDATE: normal-addressing ISO-TP. PSA-RE bits 8.7-8.0. ";
CM_ SG_ 1635 FlowPadding4 "TRANSPORT_CANDIDATE: normal-addressing ISO-TP. PSA-RE bits 7.7-7.0. ";
CM_ SG_ 1635 FirstData5 "TRANSPORT_CANDIDATE: normal-addressing ISO-TP. PSA-RE bits 7.7-7.0. ";
CM_ SG_ 1635 UnknownData6 "TRANSPORT_CANDIDATE: normal-addressing ISO-TP. PSA-RE bits 7.7-7.0. ";
CM_ SG_ 1635 ConsecutiveData6 "TRANSPORT_CANDIDATE: normal-addressing ISO-TP. PSA-RE bits 7.7-7.0. ";
CM_ SG_ 1635 SingleData6 "TRANSPORT_CANDIDATE: normal-addressing ISO-TP. PSA-RE bits 7.7-7.0. ";
CM_ SG_ 1635 FlowPadding3 "TRANSPORT_CANDIDATE: normal-addressing ISO-TP. PSA-RE bits 6.7-6.0. ";
CM_ SG_ 1635 FirstData4 "TRANSPORT_CANDIDATE: normal-addressing ISO-TP. PSA-RE bits 6.7-6.0. ";
CM_ SG_ 1635 UnknownData5 "TRANSPORT_CANDIDATE: normal-addressing ISO-TP. PSA-RE bits 6.7-6.0. ";
CM_ SG_ 1635 ConsecutiveData5 "TRANSPORT_CANDIDATE: normal-addressing ISO-TP. PSA-RE bits 6.7-6.0. ";
CM_ SG_ 1635 SingleData5 "TRANSPORT_CANDIDATE: normal-addressing ISO-TP. PSA-RE bits 6.7-6.0. ";
CM_ SG_ 1635 FlowPadding2 "TRANSPORT_CANDIDATE: normal-addressing ISO-TP. PSA-RE bits 5.7-5.0. ";
CM_ SG_ 1635 FirstData3 "TRANSPORT_CANDIDATE: normal-addressing ISO-TP. PSA-RE bits 5.7-5.0. ";
CM_ SG_ 1635 UnknownData4 "TRANSPORT_CANDIDATE: normal-addressing ISO-TP. PSA-RE bits 5.7-5.0. ";
CM_ SG_ 1635 ConsecutiveData4 "TRANSPORT_CANDIDATE: normal-addressing ISO-TP. PSA-RE bits 5.7-5.0. ";
CM_ SG_ 1635 SingleData4 "TRANSPORT_CANDIDATE: normal-addressing ISO-TP. PSA-RE bits 5.7-5.0. ";
CM_ SG_ 1635 FlowPadding1 "TRANSPORT_CANDIDATE: normal-addressing ISO-TP. PSA-RE bits 4.7-4.0. ";
CM_ SG_ 1635 FirstData2 "TRANSPORT_CANDIDATE: normal-addressing ISO-TP. PSA-RE bits 4.7-4.0. ";
CM_ SG_ 1635 UnknownData3 "TRANSPORT_CANDIDATE: normal-addressing ISO-TP. PSA-RE bits 4.7-4.0. ";
CM_ SG_ 1635 ConsecutiveData3 "TRANSPORT_CANDIDATE: normal-addressing ISO-TP. PSA-RE bits 4.7-4.0. ";
CM_ SG_ 1635 SingleData3 "TRANSPORT_CANDIDATE: normal-addressing ISO-TP. PSA-RE bits 4.7-4.0. ";
CM_ SG_ 1635 FirstData1 "TRANSPORT_CANDIDATE: normal-addressing ISO-TP. PSA-RE bits 3.7-3.0. ";
CM_ SG_ 1635 UnknownData2 "TRANSPORT_CANDIDATE: normal-addressing ISO-TP. PSA-RE bits 3.7-3.0. ";
CM_ SG_ 1635 ConsecutiveData2 "TRANSPORT_CANDIDATE: normal-addressing ISO-TP. PSA-RE bits 3.7-3.0. ";
CM_ SG_ 1635 SingleData2 "TRANSPORT_CANDIDATE: normal-addressing ISO-TP. PSA-RE bits 3.7-3.0. ";
CM_ SG_ 1635 SeparationTimeRaw "TRANSPORT_CANDIDATE: normal-addressing ISO-TP. PSA-RE bits 3.7-3.0. Raw STmin code; 0xF1..0xF9 are not milliseconds.";
CM_ SG_ 1635 UnknownData1 "TRANSPORT_CANDIDATE: normal-addressing ISO-TP. PSA-RE bits 2.7-2.0. ";
CM_ SG_ 1635 ConsecutiveData1 "TRANSPORT_CANDIDATE: normal-addressing ISO-TP. PSA-RE bits 2.7-2.0. ";
CM_ SG_ 1635 SingleData1 "TRANSPORT_CANDIDATE: normal-addressing ISO-TP. PSA-RE bits 2.7-2.0. ";
CM_ SG_ 1635 BlockSize "TRANSPORT_CANDIDATE: normal-addressing ISO-TP. PSA-RE bits 2.7-2.0. ";
CM_ SG_ 1635 UnknownPciLow "TRANSPORT_CANDIDATE: normal-addressing ISO-TP. PSA-RE bits 1.3-1.0. ";
CM_ SG_ 1635 FlowStatus "TRANSPORT_CANDIDATE: normal-addressing ISO-TP. PSA-RE bits 1.3-1.0. ";
CM_ SG_ 1635 ConsecutiveSequence "TRANSPORT_CANDIDATE: normal-addressing ISO-TP. PSA-RE bits 1.3-1.0. ";
CM_ SG_ 1635 FirstFrameLength "TRANSPORT_CANDIDATE: normal-addressing ISO-TP. PSA-RE bits 1.3-2.0. 12-bit declared PDU length; not a reassembled value.";
CM_ SG_ 1635 SingleFrameLength "TRANSPORT_CANDIDATE: normal-addressing ISO-TP. PSA-RE bits 1.3-1.0. Declared data length; not a validity check.";
CM_ SG_ 1635 IsoTpFrameType "TRANSPORT_CANDIDATE: normal-addressing ISO-TP. PSA-RE bits 1.7-1.4. PCI high nibble; normal addressing candidate.";
CM_ BO_ 1636 "DATABASE_CANDIDATE: physical interpretation unverified; capture/layout evidence reported separately. INFO-DIV CAN, 125000 bit/s; CAN ID 0x664. PSA-RE title: BTEL_DIAG_RESPONSE. Diagnostic response sent by the BTEL ECU. Source: https://github.com/prototux/PSA-RE/blob/67f7581e7622410efdbb29c7eda3b86982b9b450/buses/AEE2010.full/LS.INFO-DIV/664.yml. Source sender alternatives: ICSV,BTEL,OVIP; physical TX/gateway forwarding not verified. WIRE ISO-TP ONLY: normal addressing candidate, maximum Classical CAN DLC 8; actual DLC may be shorter. Data includes padding. No reassembly, text, DID or application-layer decoding. Original application layouts are preserved in source JSON; do not decode them at wire offsets. ";
CM_ SG_ 1636 FlowPadding5 "TRANSPORT_CANDIDATE: normal-addressing ISO-TP. PSA-RE bits 8.7-8.0. ";
CM_ SG_ 1636 FirstData6 "TRANSPORT_CANDIDATE: normal-addressing ISO-TP. PSA-RE bits 8.7-8.0. ";
CM_ SG_ 1636 UnknownData7 "TRANSPORT_CANDIDATE: normal-addressing ISO-TP. PSA-RE bits 8.7-8.0. ";
CM_ SG_ 1636 ConsecutiveData7 "TRANSPORT_CANDIDATE: normal-addressing ISO-TP. PSA-RE bits 8.7-8.0. ";
CM_ SG_ 1636 SingleData7 "TRANSPORT_CANDIDATE: normal-addressing ISO-TP. PSA-RE bits 8.7-8.0. ";
CM_ SG_ 1636 FlowPadding4 "TRANSPORT_CANDIDATE: normal-addressing ISO-TP. PSA-RE bits 7.7-7.0. ";
CM_ SG_ 1636 FirstData5 "TRANSPORT_CANDIDATE: normal-addressing ISO-TP. PSA-RE bits 7.7-7.0. ";
CM_ SG_ 1636 UnknownData6 "TRANSPORT_CANDIDATE: normal-addressing ISO-TP. PSA-RE bits 7.7-7.0. ";
CM_ SG_ 1636 ConsecutiveData6 "TRANSPORT_CANDIDATE: normal-addressing ISO-TP. PSA-RE bits 7.7-7.0. ";
CM_ SG_ 1636 SingleData6 "TRANSPORT_CANDIDATE: normal-addressing ISO-TP. PSA-RE bits 7.7-7.0. ";
CM_ SG_ 1636 FlowPadding3 "TRANSPORT_CANDIDATE: normal-addressing ISO-TP. PSA-RE bits 6.7-6.0. ";
CM_ SG_ 1636 FirstData4 "TRANSPORT_CANDIDATE: normal-addressing ISO-TP. PSA-RE bits 6.7-6.0. ";
CM_ SG_ 1636 UnknownData5 "TRANSPORT_CANDIDATE: normal-addressing ISO-TP. PSA-RE bits 6.7-6.0. ";
CM_ SG_ 1636 ConsecutiveData5 "TRANSPORT_CANDIDATE: normal-addressing ISO-TP. PSA-RE bits 6.7-6.0. ";
CM_ SG_ 1636 SingleData5 "TRANSPORT_CANDIDATE: normal-addressing ISO-TP. PSA-RE bits 6.7-6.0. ";
CM_ SG_ 1636 FlowPadding2 "TRANSPORT_CANDIDATE: normal-addressing ISO-TP. PSA-RE bits 5.7-5.0. ";
CM_ SG_ 1636 FirstData3 "TRANSPORT_CANDIDATE: normal-addressing ISO-TP. PSA-RE bits 5.7-5.0. ";
CM_ SG_ 1636 UnknownData4 "TRANSPORT_CANDIDATE: normal-addressing ISO-TP. PSA-RE bits 5.7-5.0. ";
CM_ SG_ 1636 ConsecutiveData4 "TRANSPORT_CANDIDATE: normal-addressing ISO-TP. PSA-RE bits 5.7-5.0. ";
CM_ SG_ 1636 SingleData4 "TRANSPORT_CANDIDATE: normal-addressing ISO-TP. PSA-RE bits 5.7-5.0. ";
CM_ SG_ 1636 FlowPadding1 "TRANSPORT_CANDIDATE: normal-addressing ISO-TP. PSA-RE bits 4.7-4.0. ";
CM_ SG_ 1636 FirstData2 "TRANSPORT_CANDIDATE: normal-addressing ISO-TP. PSA-RE bits 4.7-4.0. ";
CM_ SG_ 1636 UnknownData3 "TRANSPORT_CANDIDATE: normal-addressing ISO-TP. PSA-RE bits 4.7-4.0. ";
CM_ SG_ 1636 ConsecutiveData3 "TRANSPORT_CANDIDATE: normal-addressing ISO-TP. PSA-RE bits 4.7-4.0. ";
CM_ SG_ 1636 SingleData3 "TRANSPORT_CANDIDATE: normal-addressing ISO-TP. PSA-RE bits 4.7-4.0. ";
CM_ SG_ 1636 FirstData1 "TRANSPORT_CANDIDATE: normal-addressing ISO-TP. PSA-RE bits 3.7-3.0. ";
CM_ SG_ 1636 UnknownData2 "TRANSPORT_CANDIDATE: normal-addressing ISO-TP. PSA-RE bits 3.7-3.0. ";
CM_ SG_ 1636 ConsecutiveData2 "TRANSPORT_CANDIDATE: normal-addressing ISO-TP. PSA-RE bits 3.7-3.0. ";
CM_ SG_ 1636 SingleData2 "TRANSPORT_CANDIDATE: normal-addressing ISO-TP. PSA-RE bits 3.7-3.0. ";
CM_ SG_ 1636 SeparationTimeRaw "TRANSPORT_CANDIDATE: normal-addressing ISO-TP. PSA-RE bits 3.7-3.0. Raw STmin code; 0xF1..0xF9 are not milliseconds.";
CM_ SG_ 1636 UnknownData1 "TRANSPORT_CANDIDATE: normal-addressing ISO-TP. PSA-RE bits 2.7-2.0. ";
CM_ SG_ 1636 ConsecutiveData1 "TRANSPORT_CANDIDATE: normal-addressing ISO-TP. PSA-RE bits 2.7-2.0. ";
CM_ SG_ 1636 SingleData1 "TRANSPORT_CANDIDATE: normal-addressing ISO-TP. PSA-RE bits 2.7-2.0. ";
CM_ SG_ 1636 BlockSize "TRANSPORT_CANDIDATE: normal-addressing ISO-TP. PSA-RE bits 2.7-2.0. ";
CM_ SG_ 1636 UnknownPciLow "TRANSPORT_CANDIDATE: normal-addressing ISO-TP. PSA-RE bits 1.3-1.0. ";
CM_ SG_ 1636 FlowStatus "TRANSPORT_CANDIDATE: normal-addressing ISO-TP. PSA-RE bits 1.3-1.0. ";
CM_ SG_ 1636 ConsecutiveSequence "TRANSPORT_CANDIDATE: normal-addressing ISO-TP. PSA-RE bits 1.3-1.0. ";
CM_ SG_ 1636 FirstFrameLength "TRANSPORT_CANDIDATE: normal-addressing ISO-TP. PSA-RE bits 1.3-2.0. 12-bit declared PDU length; not a reassembled value.";
CM_ SG_ 1636 SingleFrameLength "TRANSPORT_CANDIDATE: normal-addressing ISO-TP. PSA-RE bits 1.3-1.0. Declared data length; not a validity check.";
CM_ SG_ 1636 IsoTpFrameType "TRANSPORT_CANDIDATE: normal-addressing ISO-TP. PSA-RE bits 1.7-1.4. PCI high nibble; normal addressing candidate.";
CM_ BO_ 1637 "DATABASE_CANDIDATE: physical interpretation unverified; capture/layout evidence reported separately. INFO-DIV CAN, 125000 bit/s; CAN ID 0x665. PSA-RE title: EMF_DIAG_RESPONSE. Diagnostic response sent by the EMF ECU. Source: https://github.com/prototux/PSA-RE/blob/67f7581e7622410efdbb29c7eda3b86982b9b450/buses/AEE2010.full/LS.INFO-DIV/665.yml. Source sender alternatives: EMF; physical TX/gateway forwarding not verified. WIRE ISO-TP ONLY: normal addressing candidate, maximum Classical CAN DLC 8; actual DLC may be shorter. Data includes padding. No reassembly, text, DID or application-layer decoding. Original application layouts are preserved in source JSON; do not decode them at wire offsets. ";
CM_ SG_ 1637 FlowPadding5 "TRANSPORT_CANDIDATE: normal-addressing ISO-TP. PSA-RE bits 8.7-8.0. ";
CM_ SG_ 1637 FirstData6 "TRANSPORT_CANDIDATE: normal-addressing ISO-TP. PSA-RE bits 8.7-8.0. ";
CM_ SG_ 1637 UnknownData7 "TRANSPORT_CANDIDATE: normal-addressing ISO-TP. PSA-RE bits 8.7-8.0. ";
CM_ SG_ 1637 ConsecutiveData7 "TRANSPORT_CANDIDATE: normal-addressing ISO-TP. PSA-RE bits 8.7-8.0. ";
CM_ SG_ 1637 SingleData7 "TRANSPORT_CANDIDATE: normal-addressing ISO-TP. PSA-RE bits 8.7-8.0. ";
CM_ SG_ 1637 FlowPadding4 "TRANSPORT_CANDIDATE: normal-addressing ISO-TP. PSA-RE bits 7.7-7.0. ";
CM_ SG_ 1637 FirstData5 "TRANSPORT_CANDIDATE: normal-addressing ISO-TP. PSA-RE bits 7.7-7.0. ";
CM_ SG_ 1637 UnknownData6 "TRANSPORT_CANDIDATE: normal-addressing ISO-TP. PSA-RE bits 7.7-7.0. ";
CM_ SG_ 1637 ConsecutiveData6 "TRANSPORT_CANDIDATE: normal-addressing ISO-TP. PSA-RE bits 7.7-7.0. ";
CM_ SG_ 1637 SingleData6 "TRANSPORT_CANDIDATE: normal-addressing ISO-TP. PSA-RE bits 7.7-7.0. ";
CM_ SG_ 1637 FlowPadding3 "TRANSPORT_CANDIDATE: normal-addressing ISO-TP. PSA-RE bits 6.7-6.0. ";
CM_ SG_ 1637 FirstData4 "TRANSPORT_CANDIDATE: normal-addressing ISO-TP. PSA-RE bits 6.7-6.0. ";
CM_ SG_ 1637 UnknownData5 "TRANSPORT_CANDIDATE: normal-addressing ISO-TP. PSA-RE bits 6.7-6.0. ";
CM_ SG_ 1637 ConsecutiveData5 "TRANSPORT_CANDIDATE: normal-addressing ISO-TP. PSA-RE bits 6.7-6.0. ";
CM_ SG_ 1637 SingleData5 "TRANSPORT_CANDIDATE: normal-addressing ISO-TP. PSA-RE bits 6.7-6.0. ";
CM_ SG_ 1637 FlowPadding2 "TRANSPORT_CANDIDATE: normal-addressing ISO-TP. PSA-RE bits 5.7-5.0. ";
CM_ SG_ 1637 FirstData3 "TRANSPORT_CANDIDATE: normal-addressing ISO-TP. PSA-RE bits 5.7-5.0. ";
CM_ SG_ 1637 UnknownData4 "TRANSPORT_CANDIDATE: normal-addressing ISO-TP. PSA-RE bits 5.7-5.0. ";
CM_ SG_ 1637 ConsecutiveData4 "TRANSPORT_CANDIDATE: normal-addressing ISO-TP. PSA-RE bits 5.7-5.0. ";
CM_ SG_ 1637 SingleData4 "TRANSPORT_CANDIDATE: normal-addressing ISO-TP. PSA-RE bits 5.7-5.0. ";
CM_ SG_ 1637 FlowPadding1 "TRANSPORT_CANDIDATE: normal-addressing ISO-TP. PSA-RE bits 4.7-4.0. ";
CM_ SG_ 1637 FirstData2 "TRANSPORT_CANDIDATE: normal-addressing ISO-TP. PSA-RE bits 4.7-4.0. ";
CM_ SG_ 1637 UnknownData3 "TRANSPORT_CANDIDATE: normal-addressing ISO-TP. PSA-RE bits 4.7-4.0. ";
CM_ SG_ 1637 ConsecutiveData3 "TRANSPORT_CANDIDATE: normal-addressing ISO-TP. PSA-RE bits 4.7-4.0. ";
CM_ SG_ 1637 SingleData3 "TRANSPORT_CANDIDATE: normal-addressing ISO-TP. PSA-RE bits 4.7-4.0. ";
CM_ SG_ 1637 FirstData1 "TRANSPORT_CANDIDATE: normal-addressing ISO-TP. PSA-RE bits 3.7-3.0. ";
CM_ SG_ 1637 UnknownData2 "TRANSPORT_CANDIDATE: normal-addressing ISO-TP. PSA-RE bits 3.7-3.0. ";
CM_ SG_ 1637 ConsecutiveData2 "TRANSPORT_CANDIDATE: normal-addressing ISO-TP. PSA-RE bits 3.7-3.0. ";
CM_ SG_ 1637 SingleData2 "TRANSPORT_CANDIDATE: normal-addressing ISO-TP. PSA-RE bits 3.7-3.0. ";
CM_ SG_ 1637 SeparationTimeRaw "TRANSPORT_CANDIDATE: normal-addressing ISO-TP. PSA-RE bits 3.7-3.0. Raw STmin code; 0xF1..0xF9 are not milliseconds.";
CM_ SG_ 1637 UnknownData1 "TRANSPORT_CANDIDATE: normal-addressing ISO-TP. PSA-RE bits 2.7-2.0. ";
CM_ SG_ 1637 ConsecutiveData1 "TRANSPORT_CANDIDATE: normal-addressing ISO-TP. PSA-RE bits 2.7-2.0. ";
CM_ SG_ 1637 SingleData1 "TRANSPORT_CANDIDATE: normal-addressing ISO-TP. PSA-RE bits 2.7-2.0. ";
CM_ SG_ 1637 BlockSize "TRANSPORT_CANDIDATE: normal-addressing ISO-TP. PSA-RE bits 2.7-2.0. ";
CM_ SG_ 1637 UnknownPciLow "TRANSPORT_CANDIDATE: normal-addressing ISO-TP. PSA-RE bits 1.3-1.0. ";
CM_ SG_ 1637 FlowStatus "TRANSPORT_CANDIDATE: normal-addressing ISO-TP. PSA-RE bits 1.3-1.0. ";
CM_ SG_ 1637 ConsecutiveSequence "TRANSPORT_CANDIDATE: normal-addressing ISO-TP. PSA-RE bits 1.3-1.0. ";
CM_ SG_ 1637 FirstFrameLength "TRANSPORT_CANDIDATE: normal-addressing ISO-TP. PSA-RE bits 1.3-2.0. 12-bit declared PDU length; not a reassembled value.";
CM_ SG_ 1637 SingleFrameLength "TRANSPORT_CANDIDATE: normal-addressing ISO-TP. PSA-RE bits 1.3-1.0. Declared data length; not a validity check.";
CM_ SG_ 1637 IsoTpFrameType "TRANSPORT_CANDIDATE: normal-addressing ISO-TP. PSA-RE bits 1.7-1.4. PCI high nibble; normal addressing candidate.";
CM_ BO_ 1638 "DATABASE_CANDIDATE: physical interpretation unverified; capture/layout evidence reported separately. INFO-DIV CAN, 125000 bit/s; CAN ID 0x666. PSA-RE title: WLC_DIAG_RESPONSE. Diagnostic response sent by the WLC ECU. Source: https://github.com/prototux/PSA-RE/blob/67f7581e7622410efdbb29c7eda3b86982b9b450/buses/AEE2010.full/LS.INFO-DIV/666.yml. Source sender alternatives: WLC; physical TX/gateway forwarding not verified. WIRE ISO-TP ONLY: normal addressing candidate, maximum Classical CAN DLC 8; actual DLC may be shorter. Data includes padding. No reassembly, text, DID or application-layer decoding. Original application layouts are preserved in source JSON; do not decode them at wire offsets. ";
CM_ SG_ 1638 FlowPadding5 "TRANSPORT_CANDIDATE: normal-addressing ISO-TP. PSA-RE bits 8.7-8.0. ";
CM_ SG_ 1638 FirstData6 "TRANSPORT_CANDIDATE: normal-addressing ISO-TP. PSA-RE bits 8.7-8.0. ";
CM_ SG_ 1638 UnknownData7 "TRANSPORT_CANDIDATE: normal-addressing ISO-TP. PSA-RE bits 8.7-8.0. ";
CM_ SG_ 1638 ConsecutiveData7 "TRANSPORT_CANDIDATE: normal-addressing ISO-TP. PSA-RE bits 8.7-8.0. ";
CM_ SG_ 1638 SingleData7 "TRANSPORT_CANDIDATE: normal-addressing ISO-TP. PSA-RE bits 8.7-8.0. ";
CM_ SG_ 1638 FlowPadding4 "TRANSPORT_CANDIDATE: normal-addressing ISO-TP. PSA-RE bits 7.7-7.0. ";
CM_ SG_ 1638 FirstData5 "TRANSPORT_CANDIDATE: normal-addressing ISO-TP. PSA-RE bits 7.7-7.0. ";
CM_ SG_ 1638 UnknownData6 "TRANSPORT_CANDIDATE: normal-addressing ISO-TP. PSA-RE bits 7.7-7.0. ";
CM_ SG_ 1638 ConsecutiveData6 "TRANSPORT_CANDIDATE: normal-addressing ISO-TP. PSA-RE bits 7.7-7.0. ";
CM_ SG_ 1638 SingleData6 "TRANSPORT_CANDIDATE: normal-addressing ISO-TP. PSA-RE bits 7.7-7.0. ";
CM_ SG_ 1638 FlowPadding3 "TRANSPORT_CANDIDATE: normal-addressing ISO-TP. PSA-RE bits 6.7-6.0. ";
CM_ SG_ 1638 FirstData4 "TRANSPORT_CANDIDATE: normal-addressing ISO-TP. PSA-RE bits 6.7-6.0. ";
CM_ SG_ 1638 UnknownData5 "TRANSPORT_CANDIDATE: normal-addressing ISO-TP. PSA-RE bits 6.7-6.0. ";
CM_ SG_ 1638 ConsecutiveData5 "TRANSPORT_CANDIDATE: normal-addressing ISO-TP. PSA-RE bits 6.7-6.0. ";
CM_ SG_ 1638 SingleData5 "TRANSPORT_CANDIDATE: normal-addressing ISO-TP. PSA-RE bits 6.7-6.0. ";
CM_ SG_ 1638 FlowPadding2 "TRANSPORT_CANDIDATE: normal-addressing ISO-TP. PSA-RE bits 5.7-5.0. ";
CM_ SG_ 1638 FirstData3 "TRANSPORT_CANDIDATE: normal-addressing ISO-TP. PSA-RE bits 5.7-5.0. ";
CM_ SG_ 1638 UnknownData4 "TRANSPORT_CANDIDATE: normal-addressing ISO-TP. PSA-RE bits 5.7-5.0. ";
CM_ SG_ 1638 ConsecutiveData4 "TRANSPORT_CANDIDATE: normal-addressing ISO-TP. PSA-RE bits 5.7-5.0. ";
CM_ SG_ 1638 SingleData4 "TRANSPORT_CANDIDATE: normal-addressing ISO-TP. PSA-RE bits 5.7-5.0. ";
CM_ SG_ 1638 FlowPadding1 "TRANSPORT_CANDIDATE: normal-addressing ISO-TP. PSA-RE bits 4.7-4.0. ";
CM_ SG_ 1638 FirstData2 "TRANSPORT_CANDIDATE: normal-addressing ISO-TP. PSA-RE bits 4.7-4.0. ";
CM_ SG_ 1638 UnknownData3 "TRANSPORT_CANDIDATE: normal-addressing ISO-TP. PSA-RE bits 4.7-4.0. ";
CM_ SG_ 1638 ConsecutiveData3 "TRANSPORT_CANDIDATE: normal-addressing ISO-TP. PSA-RE bits 4.7-4.0. ";
CM_ SG_ 1638 SingleData3 "TRANSPORT_CANDIDATE: normal-addressing ISO-TP. PSA-RE bits 4.7-4.0. ";
CM_ SG_ 1638 FirstData1 "TRANSPORT_CANDIDATE: normal-addressing ISO-TP. PSA-RE bits 3.7-3.0. ";
CM_ SG_ 1638 UnknownData2 "TRANSPORT_CANDIDATE: normal-addressing ISO-TP. PSA-RE bits 3.7-3.0. ";
CM_ SG_ 1638 ConsecutiveData2 "TRANSPORT_CANDIDATE: normal-addressing ISO-TP. PSA-RE bits 3.7-3.0. ";
CM_ SG_ 1638 SingleData2 "TRANSPORT_CANDIDATE: normal-addressing ISO-TP. PSA-RE bits 3.7-3.0. ";
CM_ SG_ 1638 SeparationTimeRaw "TRANSPORT_CANDIDATE: normal-addressing ISO-TP. PSA-RE bits 3.7-3.0. Raw STmin code; 0xF1..0xF9 are not milliseconds.";
CM_ SG_ 1638 UnknownData1 "TRANSPORT_CANDIDATE: normal-addressing ISO-TP. PSA-RE bits 2.7-2.0. ";
CM_ SG_ 1638 ConsecutiveData1 "TRANSPORT_CANDIDATE: normal-addressing ISO-TP. PSA-RE bits 2.7-2.0. ";
CM_ SG_ 1638 SingleData1 "TRANSPORT_CANDIDATE: normal-addressing ISO-TP. PSA-RE bits 2.7-2.0. ";
CM_ SG_ 1638 BlockSize "TRANSPORT_CANDIDATE: normal-addressing ISO-TP. PSA-RE bits 2.7-2.0. ";
CM_ SG_ 1638 UnknownPciLow "TRANSPORT_CANDIDATE: normal-addressing ISO-TP. PSA-RE bits 1.3-1.0. ";
CM_ SG_ 1638 FlowStatus "TRANSPORT_CANDIDATE: normal-addressing ISO-TP. PSA-RE bits 1.3-1.0. ";
CM_ SG_ 1638 ConsecutiveSequence "TRANSPORT_CANDIDATE: normal-addressing ISO-TP. PSA-RE bits 1.3-1.0. ";
CM_ SG_ 1638 FirstFrameLength "TRANSPORT_CANDIDATE: normal-addressing ISO-TP. PSA-RE bits 1.3-2.0. 12-bit declared PDU length; not a reassembled value.";
CM_ SG_ 1638 SingleFrameLength "TRANSPORT_CANDIDATE: normal-addressing ISO-TP. PSA-RE bits 1.3-1.0. Declared data length; not a validity check.";
CM_ SG_ 1638 IsoTpFrameType "TRANSPORT_CANDIDATE: normal-addressing ISO-TP. PSA-RE bits 1.7-1.4. PCI high nibble; normal addressing candidate.";
CM_ BO_ 1643 "DATABASE_CANDIDATE: physical interpretation unverified; capture/layout evidence reported separately. INFO-DIV CAN, 125000 bit/s; CAN ID 0x66B. PSA-RE title: CATVM_DIAG_RESPONSE. Diagnostic response sent by the CATVM ECU. Source: https://github.com/prototux/PSA-RE/blob/67f7581e7622410efdbb29c7eda3b86982b9b450/buses/AEE2010.full/LS.INFO-DIV/66B.yml. Source sender alternatives: BSI; physical TX/gateway forwarding not verified. WIRE ISO-TP ONLY: normal addressing candidate, maximum Classical CAN DLC 8; actual DLC may be shorter. Data includes padding. No reassembly, text, DID or application-layer decoding. Original application layouts are preserved in source JSON; do not decode them at wire offsets. ";
CM_ SG_ 1643 FlowPadding5 "TRANSPORT_CANDIDATE: normal-addressing ISO-TP. PSA-RE bits 8.7-8.0. ";
CM_ SG_ 1643 FirstData6 "TRANSPORT_CANDIDATE: normal-addressing ISO-TP. PSA-RE bits 8.7-8.0. ";
CM_ SG_ 1643 UnknownData7 "TRANSPORT_CANDIDATE: normal-addressing ISO-TP. PSA-RE bits 8.7-8.0. ";
CM_ SG_ 1643 ConsecutiveData7 "TRANSPORT_CANDIDATE: normal-addressing ISO-TP. PSA-RE bits 8.7-8.0. ";
CM_ SG_ 1643 SingleData7 "TRANSPORT_CANDIDATE: normal-addressing ISO-TP. PSA-RE bits 8.7-8.0. ";
CM_ SG_ 1643 FlowPadding4 "TRANSPORT_CANDIDATE: normal-addressing ISO-TP. PSA-RE bits 7.7-7.0. ";
CM_ SG_ 1643 FirstData5 "TRANSPORT_CANDIDATE: normal-addressing ISO-TP. PSA-RE bits 7.7-7.0. ";
CM_ SG_ 1643 UnknownData6 "TRANSPORT_CANDIDATE: normal-addressing ISO-TP. PSA-RE bits 7.7-7.0. ";
CM_ SG_ 1643 ConsecutiveData6 "TRANSPORT_CANDIDATE: normal-addressing ISO-TP. PSA-RE bits 7.7-7.0. ";
CM_ SG_ 1643 SingleData6 "TRANSPORT_CANDIDATE: normal-addressing ISO-TP. PSA-RE bits 7.7-7.0. ";
CM_ SG_ 1643 FlowPadding3 "TRANSPORT_CANDIDATE: normal-addressing ISO-TP. PSA-RE bits 6.7-6.0. ";
CM_ SG_ 1643 FirstData4 "TRANSPORT_CANDIDATE: normal-addressing ISO-TP. PSA-RE bits 6.7-6.0. ";
CM_ SG_ 1643 UnknownData5 "TRANSPORT_CANDIDATE: normal-addressing ISO-TP. PSA-RE bits 6.7-6.0. ";
CM_ SG_ 1643 ConsecutiveData5 "TRANSPORT_CANDIDATE: normal-addressing ISO-TP. PSA-RE bits 6.7-6.0. ";
CM_ SG_ 1643 SingleData5 "TRANSPORT_CANDIDATE: normal-addressing ISO-TP. PSA-RE bits 6.7-6.0. ";
CM_ SG_ 1643 FlowPadding2 "TRANSPORT_CANDIDATE: normal-addressing ISO-TP. PSA-RE bits 5.7-5.0. ";
CM_ SG_ 1643 FirstData3 "TRANSPORT_CANDIDATE: normal-addressing ISO-TP. PSA-RE bits 5.7-5.0. ";
CM_ SG_ 1643 UnknownData4 "TRANSPORT_CANDIDATE: normal-addressing ISO-TP. PSA-RE bits 5.7-5.0. ";
CM_ SG_ 1643 ConsecutiveData4 "TRANSPORT_CANDIDATE: normal-addressing ISO-TP. PSA-RE bits 5.7-5.0. ";
CM_ SG_ 1643 SingleData4 "TRANSPORT_CANDIDATE: normal-addressing ISO-TP. PSA-RE bits 5.7-5.0. ";
CM_ SG_ 1643 FlowPadding1 "TRANSPORT_CANDIDATE: normal-addressing ISO-TP. PSA-RE bits 4.7-4.0. ";
CM_ SG_ 1643 FirstData2 "TRANSPORT_CANDIDATE: normal-addressing ISO-TP. PSA-RE bits 4.7-4.0. ";
CM_ SG_ 1643 UnknownData3 "TRANSPORT_CANDIDATE: normal-addressing ISO-TP. PSA-RE bits 4.7-4.0. ";
CM_ SG_ 1643 ConsecutiveData3 "TRANSPORT_CANDIDATE: normal-addressing ISO-TP. PSA-RE bits 4.7-4.0. ";
CM_ SG_ 1643 SingleData3 "TRANSPORT_CANDIDATE: normal-addressing ISO-TP. PSA-RE bits 4.7-4.0. ";
CM_ SG_ 1643 FirstData1 "TRANSPORT_CANDIDATE: normal-addressing ISO-TP. PSA-RE bits 3.7-3.0. ";
CM_ SG_ 1643 UnknownData2 "TRANSPORT_CANDIDATE: normal-addressing ISO-TP. PSA-RE bits 3.7-3.0. ";
CM_ SG_ 1643 ConsecutiveData2 "TRANSPORT_CANDIDATE: normal-addressing ISO-TP. PSA-RE bits 3.7-3.0. ";
CM_ SG_ 1643 SingleData2 "TRANSPORT_CANDIDATE: normal-addressing ISO-TP. PSA-RE bits 3.7-3.0. ";
CM_ SG_ 1643 SeparationTimeRaw "TRANSPORT_CANDIDATE: normal-addressing ISO-TP. PSA-RE bits 3.7-3.0. Raw STmin code; 0xF1..0xF9 are not milliseconds.";
CM_ SG_ 1643 UnknownData1 "TRANSPORT_CANDIDATE: normal-addressing ISO-TP. PSA-RE bits 2.7-2.0. ";
CM_ SG_ 1643 ConsecutiveData1 "TRANSPORT_CANDIDATE: normal-addressing ISO-TP. PSA-RE bits 2.7-2.0. ";
CM_ SG_ 1643 SingleData1 "TRANSPORT_CANDIDATE: normal-addressing ISO-TP. PSA-RE bits 2.7-2.0. ";
CM_ SG_ 1643 BlockSize "TRANSPORT_CANDIDATE: normal-addressing ISO-TP. PSA-RE bits 2.7-2.0. ";
CM_ SG_ 1643 UnknownPciLow "TRANSPORT_CANDIDATE: normal-addressing ISO-TP. PSA-RE bits 1.3-1.0. ";
CM_ SG_ 1643 FlowStatus "TRANSPORT_CANDIDATE: normal-addressing ISO-TP. PSA-RE bits 1.3-1.0. ";
CM_ SG_ 1643 ConsecutiveSequence "TRANSPORT_CANDIDATE: normal-addressing ISO-TP. PSA-RE bits 1.3-1.0. ";
CM_ SG_ 1643 FirstFrameLength "TRANSPORT_CANDIDATE: normal-addressing ISO-TP. PSA-RE bits 1.3-2.0. 12-bit declared PDU length; not a reassembled value.";
CM_ SG_ 1643 SingleFrameLength "TRANSPORT_CANDIDATE: normal-addressing ISO-TP. PSA-RE bits 1.3-1.0. Declared data length; not a validity check.";
CM_ SG_ 1643 IsoTpFrameType "TRANSPORT_CANDIDATE: normal-addressing ISO-TP. PSA-RE bits 1.7-1.4. PCI high nibble; normal addressing candidate.";
CM_ BO_ 1644 "DATABASE_CANDIDATE: physical interpretation unverified; capture/layout evidence reported separately. INFO-DIV CAN, 125000 bit/s; CAN ID 0x66C. PSA-RE title: BRQ_DIAG_RESPONSE. Diagnostic response sent by the BRQ ECU. Source: https://github.com/prototux/PSA-RE/blob/67f7581e7622410efdbb29c7eda3b86982b9b450/buses/AEE2010.full/LS.INFO-DIV/66C.yml. Source sender alternatives: BSI; physical TX/gateway forwarding not verified. WIRE ISO-TP ONLY: normal addressing candidate, maximum Classical CAN DLC 8; actual DLC may be shorter. Data includes padding. No reassembly, text, DID or application-layer decoding. Original application layouts are preserved in source JSON; do not decode them at wire offsets. ";
CM_ SG_ 1644 FlowPadding5 "TRANSPORT_CANDIDATE: normal-addressing ISO-TP. PSA-RE bits 8.7-8.0. ";
CM_ SG_ 1644 FirstData6 "TRANSPORT_CANDIDATE: normal-addressing ISO-TP. PSA-RE bits 8.7-8.0. ";
CM_ SG_ 1644 UnknownData7 "TRANSPORT_CANDIDATE: normal-addressing ISO-TP. PSA-RE bits 8.7-8.0. ";
CM_ SG_ 1644 ConsecutiveData7 "TRANSPORT_CANDIDATE: normal-addressing ISO-TP. PSA-RE bits 8.7-8.0. ";
CM_ SG_ 1644 SingleData7 "TRANSPORT_CANDIDATE: normal-addressing ISO-TP. PSA-RE bits 8.7-8.0. ";
CM_ SG_ 1644 FlowPadding4 "TRANSPORT_CANDIDATE: normal-addressing ISO-TP. PSA-RE bits 7.7-7.0. ";
CM_ SG_ 1644 FirstData5 "TRANSPORT_CANDIDATE: normal-addressing ISO-TP. PSA-RE bits 7.7-7.0. ";
CM_ SG_ 1644 UnknownData6 "TRANSPORT_CANDIDATE: normal-addressing ISO-TP. PSA-RE bits 7.7-7.0. ";
CM_ SG_ 1644 ConsecutiveData6 "TRANSPORT_CANDIDATE: normal-addressing ISO-TP. PSA-RE bits 7.7-7.0. ";
CM_ SG_ 1644 SingleData6 "TRANSPORT_CANDIDATE: normal-addressing ISO-TP. PSA-RE bits 7.7-7.0. ";
CM_ SG_ 1644 FlowPadding3 "TRANSPORT_CANDIDATE: normal-addressing ISO-TP. PSA-RE bits 6.7-6.0. ";
CM_ SG_ 1644 FirstData4 "TRANSPORT_CANDIDATE: normal-addressing ISO-TP. PSA-RE bits 6.7-6.0. ";
CM_ SG_ 1644 UnknownData5 "TRANSPORT_CANDIDATE: normal-addressing ISO-TP. PSA-RE bits 6.7-6.0. ";
CM_ SG_ 1644 ConsecutiveData5 "TRANSPORT_CANDIDATE: normal-addressing ISO-TP. PSA-RE bits 6.7-6.0. ";
CM_ SG_ 1644 SingleData5 "TRANSPORT_CANDIDATE: normal-addressing ISO-TP. PSA-RE bits 6.7-6.0. ";
CM_ SG_ 1644 FlowPadding2 "TRANSPORT_CANDIDATE: normal-addressing ISO-TP. PSA-RE bits 5.7-5.0. ";
CM_ SG_ 1644 FirstData3 "TRANSPORT_CANDIDATE: normal-addressing ISO-TP. PSA-RE bits 5.7-5.0. ";
CM_ SG_ 1644 UnknownData4 "TRANSPORT_CANDIDATE: normal-addressing ISO-TP. PSA-RE bits 5.7-5.0. ";
CM_ SG_ 1644 ConsecutiveData4 "TRANSPORT_CANDIDATE: normal-addressing ISO-TP. PSA-RE bits 5.7-5.0. ";
CM_ SG_ 1644 SingleData4 "TRANSPORT_CANDIDATE: normal-addressing ISO-TP. PSA-RE bits 5.7-5.0. ";
CM_ SG_ 1644 FlowPadding1 "TRANSPORT_CANDIDATE: normal-addressing ISO-TP. PSA-RE bits 4.7-4.0. ";
CM_ SG_ 1644 FirstData2 "TRANSPORT_CANDIDATE: normal-addressing ISO-TP. PSA-RE bits 4.7-4.0. ";
CM_ SG_ 1644 UnknownData3 "TRANSPORT_CANDIDATE: normal-addressing ISO-TP. PSA-RE bits 4.7-4.0. ";
CM_ SG_ 1644 ConsecutiveData3 "TRANSPORT_CANDIDATE: normal-addressing ISO-TP. PSA-RE bits 4.7-4.0. ";
CM_ SG_ 1644 SingleData3 "TRANSPORT_CANDIDATE: normal-addressing ISO-TP. PSA-RE bits 4.7-4.0. ";
CM_ SG_ 1644 FirstData1 "TRANSPORT_CANDIDATE: normal-addressing ISO-TP. PSA-RE bits 3.7-3.0. ";
CM_ SG_ 1644 UnknownData2 "TRANSPORT_CANDIDATE: normal-addressing ISO-TP. PSA-RE bits 3.7-3.0. ";
CM_ SG_ 1644 ConsecutiveData2 "TRANSPORT_CANDIDATE: normal-addressing ISO-TP. PSA-RE bits 3.7-3.0. ";
CM_ SG_ 1644 SingleData2 "TRANSPORT_CANDIDATE: normal-addressing ISO-TP. PSA-RE bits 3.7-3.0. ";
CM_ SG_ 1644 SeparationTimeRaw "TRANSPORT_CANDIDATE: normal-addressing ISO-TP. PSA-RE bits 3.7-3.0. Raw STmin code; 0xF1..0xF9 are not milliseconds.";
CM_ SG_ 1644 UnknownData1 "TRANSPORT_CANDIDATE: normal-addressing ISO-TP. PSA-RE bits 2.7-2.0. ";
CM_ SG_ 1644 ConsecutiveData1 "TRANSPORT_CANDIDATE: normal-addressing ISO-TP. PSA-RE bits 2.7-2.0. ";
CM_ SG_ 1644 SingleData1 "TRANSPORT_CANDIDATE: normal-addressing ISO-TP. PSA-RE bits 2.7-2.0. ";
CM_ SG_ 1644 BlockSize "TRANSPORT_CANDIDATE: normal-addressing ISO-TP. PSA-RE bits 2.7-2.0. ";
CM_ SG_ 1644 UnknownPciLow "TRANSPORT_CANDIDATE: normal-addressing ISO-TP. PSA-RE bits 1.3-1.0. ";
CM_ SG_ 1644 FlowStatus "TRANSPORT_CANDIDATE: normal-addressing ISO-TP. PSA-RE bits 1.3-1.0. ";
CM_ SG_ 1644 ConsecutiveSequence "TRANSPORT_CANDIDATE: normal-addressing ISO-TP. PSA-RE bits 1.3-1.0. ";
CM_ SG_ 1644 FirstFrameLength "TRANSPORT_CANDIDATE: normal-addressing ISO-TP. PSA-RE bits 1.3-2.0. 12-bit declared PDU length; not a reassembled value.";
CM_ SG_ 1644 SingleFrameLength "TRANSPORT_CANDIDATE: normal-addressing ISO-TP. PSA-RE bits 1.3-1.0. Declared data length; not a validity check.";
CM_ SG_ 1644 IsoTpFrameType "TRANSPORT_CANDIDATE: normal-addressing ISO-TP. PSA-RE bits 1.7-1.4. PCI high nibble; normal addressing candidate.";
CM_ BO_ 1645 "DATABASE_CANDIDATE: physical interpretation unverified; capture/layout evidence reported separately. INFO-DIV CAN, 125000 bit/s; CAN ID 0x66D. PSA-RE title: CLV_DIAG_RESPONSE. Diagnostic response sent by the CLV ECU. Source: https://github.com/prototux/PSA-RE/blob/67f7581e7622410efdbb29c7eda3b86982b9b450/buses/AEE2010.full/LS.INFO-DIV/66D.yml. Source sender alternatives: BSI; physical TX/gateway forwarding not verified. WIRE ISO-TP ONLY: normal addressing candidate, maximum Classical CAN DLC 8; actual DLC may be shorter. Data includes padding. No reassembly, text, DID or application-layer decoding. Original application layouts are preserved in source JSON; do not decode them at wire offsets. ";
CM_ SG_ 1645 FlowPadding5 "TRANSPORT_CANDIDATE: normal-addressing ISO-TP. PSA-RE bits 8.7-8.0. ";
CM_ SG_ 1645 FirstData6 "TRANSPORT_CANDIDATE: normal-addressing ISO-TP. PSA-RE bits 8.7-8.0. ";
CM_ SG_ 1645 UnknownData7 "TRANSPORT_CANDIDATE: normal-addressing ISO-TP. PSA-RE bits 8.7-8.0. ";
CM_ SG_ 1645 ConsecutiveData7 "TRANSPORT_CANDIDATE: normal-addressing ISO-TP. PSA-RE bits 8.7-8.0. ";
CM_ SG_ 1645 SingleData7 "TRANSPORT_CANDIDATE: normal-addressing ISO-TP. PSA-RE bits 8.7-8.0. ";
CM_ SG_ 1645 FlowPadding4 "TRANSPORT_CANDIDATE: normal-addressing ISO-TP. PSA-RE bits 7.7-7.0. ";
CM_ SG_ 1645 FirstData5 "TRANSPORT_CANDIDATE: normal-addressing ISO-TP. PSA-RE bits 7.7-7.0. ";
CM_ SG_ 1645 UnknownData6 "TRANSPORT_CANDIDATE: normal-addressing ISO-TP. PSA-RE bits 7.7-7.0. ";
CM_ SG_ 1645 ConsecutiveData6 "TRANSPORT_CANDIDATE: normal-addressing ISO-TP. PSA-RE bits 7.7-7.0. ";
CM_ SG_ 1645 SingleData6 "TRANSPORT_CANDIDATE: normal-addressing ISO-TP. PSA-RE bits 7.7-7.0. ";
CM_ SG_ 1645 FlowPadding3 "TRANSPORT_CANDIDATE: normal-addressing ISO-TP. PSA-RE bits 6.7-6.0. ";
CM_ SG_ 1645 FirstData4 "TRANSPORT_CANDIDATE: normal-addressing ISO-TP. PSA-RE bits 6.7-6.0. ";
CM_ SG_ 1645 UnknownData5 "TRANSPORT_CANDIDATE: normal-addressing ISO-TP. PSA-RE bits 6.7-6.0. ";
CM_ SG_ 1645 ConsecutiveData5 "TRANSPORT_CANDIDATE: normal-addressing ISO-TP. PSA-RE bits 6.7-6.0. ";
CM_ SG_ 1645 SingleData5 "TRANSPORT_CANDIDATE: normal-addressing ISO-TP. PSA-RE bits 6.7-6.0. ";
CM_ SG_ 1645 FlowPadding2 "TRANSPORT_CANDIDATE: normal-addressing ISO-TP. PSA-RE bits 5.7-5.0. ";
CM_ SG_ 1645 FirstData3 "TRANSPORT_CANDIDATE: normal-addressing ISO-TP. PSA-RE bits 5.7-5.0. ";
CM_ SG_ 1645 UnknownData4 "TRANSPORT_CANDIDATE: normal-addressing ISO-TP. PSA-RE bits 5.7-5.0. ";
CM_ SG_ 1645 ConsecutiveData4 "TRANSPORT_CANDIDATE: normal-addressing ISO-TP. PSA-RE bits 5.7-5.0. ";
CM_ SG_ 1645 SingleData4 "TRANSPORT_CANDIDATE: normal-addressing ISO-TP. PSA-RE bits 5.7-5.0. ";
CM_ SG_ 1645 FlowPadding1 "TRANSPORT_CANDIDATE: normal-addressing ISO-TP. PSA-RE bits 4.7-4.0. ";
CM_ SG_ 1645 FirstData2 "TRANSPORT_CANDIDATE: normal-addressing ISO-TP. PSA-RE bits 4.7-4.0. ";
CM_ SG_ 1645 UnknownData3 "TRANSPORT_CANDIDATE: normal-addressing ISO-TP. PSA-RE bits 4.7-4.0. ";
CM_ SG_ 1645 ConsecutiveData3 "TRANSPORT_CANDIDATE: normal-addressing ISO-TP. PSA-RE bits 4.7-4.0. ";
CM_ SG_ 1645 SingleData3 "TRANSPORT_CANDIDATE: normal-addressing ISO-TP. PSA-RE bits 4.7-4.0. ";
CM_ SG_ 1645 FirstData1 "TRANSPORT_CANDIDATE: normal-addressing ISO-TP. PSA-RE bits 3.7-3.0. ";
CM_ SG_ 1645 UnknownData2 "TRANSPORT_CANDIDATE: normal-addressing ISO-TP. PSA-RE bits 3.7-3.0. ";
CM_ SG_ 1645 ConsecutiveData2 "TRANSPORT_CANDIDATE: normal-addressing ISO-TP. PSA-RE bits 3.7-3.0. ";
CM_ SG_ 1645 SingleData2 "TRANSPORT_CANDIDATE: normal-addressing ISO-TP. PSA-RE bits 3.7-3.0. ";
CM_ SG_ 1645 SeparationTimeRaw "TRANSPORT_CANDIDATE: normal-addressing ISO-TP. PSA-RE bits 3.7-3.0. Raw STmin code; 0xF1..0xF9 are not milliseconds.";
CM_ SG_ 1645 UnknownData1 "TRANSPORT_CANDIDATE: normal-addressing ISO-TP. PSA-RE bits 2.7-2.0. ";
CM_ SG_ 1645 ConsecutiveData1 "TRANSPORT_CANDIDATE: normal-addressing ISO-TP. PSA-RE bits 2.7-2.0. ";
CM_ SG_ 1645 SingleData1 "TRANSPORT_CANDIDATE: normal-addressing ISO-TP. PSA-RE bits 2.7-2.0. ";
CM_ SG_ 1645 BlockSize "TRANSPORT_CANDIDATE: normal-addressing ISO-TP. PSA-RE bits 2.7-2.0. ";
CM_ SG_ 1645 UnknownPciLow "TRANSPORT_CANDIDATE: normal-addressing ISO-TP. PSA-RE bits 1.3-1.0. ";
CM_ SG_ 1645 FlowStatus "TRANSPORT_CANDIDATE: normal-addressing ISO-TP. PSA-RE bits 1.3-1.0. ";
CM_ SG_ 1645 ConsecutiveSequence "TRANSPORT_CANDIDATE: normal-addressing ISO-TP. PSA-RE bits 1.3-1.0. ";
CM_ SG_ 1645 FirstFrameLength "TRANSPORT_CANDIDATE: normal-addressing ISO-TP. PSA-RE bits 1.3-2.0. 12-bit declared PDU length; not a reassembled value.";
CM_ SG_ 1645 SingleFrameLength "TRANSPORT_CANDIDATE: normal-addressing ISO-TP. PSA-RE bits 1.3-1.0. Declared data length; not a validity check.";
CM_ SG_ 1645 IsoTpFrameType "TRANSPORT_CANDIDATE: normal-addressing ISO-TP. PSA-RE bits 1.7-1.4. PCI high nibble; normal addressing candidate.";
VAL_ 1611 FlowStatus 0 "ContinueToSend" 1 "Wait" 2 "Overflow" ;
VAL_ 1611 IsoTpFrameType 0 "SingleFrame" 1 "FirstFrame" 2 "ConsecutiveFrame" 3 "FlowControl" ;
VAL_ 1612 FlowStatus 0 "ContinueToSend" 1 "Wait" 2 "Overflow" ;
VAL_ 1612 IsoTpFrameType 0 "SingleFrame" 1 "FirstFrame" 2 "ConsecutiveFrame" 3 "FlowControl" ;
VAL_ 1615 FlowStatus 0 "ContinueToSend" 1 "Wait" 2 "Overflow" ;
VAL_ 1615 IsoTpFrameType 0 "SingleFrame" 1 "FirstFrame" 2 "ConsecutiveFrame" 3 "FlowControl" ;
VAL_ 1619 FlowStatus 0 "ContinueToSend" 1 "Wait" 2 "Overflow" ;
VAL_ 1619 IsoTpFrameType 0 "SingleFrame" 1 "FirstFrame" 2 "ConsecutiveFrame" 3 "FlowControl" ;
VAL_ 1625 FlowStatus 0 "ContinueToSend" 1 "Wait" 2 "Overflow" ;
VAL_ 1625 IsoTpFrameType 0 "SingleFrame" 1 "FirstFrame" 2 "ConsecutiveFrame" 3 "FlowControl" ;
VAL_ 1627 FlowStatus 0 "ContinueToSend" 1 "Wait" 2 "Overflow" ;
VAL_ 1627 IsoTpFrameType 0 "SingleFrame" 1 "FirstFrame" 2 "ConsecutiveFrame" 3 "FlowControl" ;
VAL_ 1628 FlowStatus 0 "ContinueToSend" 1 "Wait" 2 "Overflow" ;
VAL_ 1628 IsoTpFrameType 0 "SingleFrame" 1 "FirstFrame" 2 "ConsecutiveFrame" 3 "FlowControl" ;
VAL_ 1629 FlowStatus 0 "ContinueToSend" 1 "Wait" 2 "Overflow" ;
VAL_ 1629 IsoTpFrameType 0 "SingleFrame" 1 "FirstFrame" 2 "ConsecutiveFrame" 3 "FlowControl" ;
VAL_ 1630 FlowStatus 0 "ContinueToSend" 1 "Wait" 2 "Overflow" ;
VAL_ 1630 IsoTpFrameType 0 "SingleFrame" 1 "FirstFrame" 2 "ConsecutiveFrame" 3 "FlowControl" ;
VAL_ 1631 FlowStatus 0 "ContinueToSend" 1 "Wait" 2 "Overflow" ;
VAL_ 1631 IsoTpFrameType 0 "SingleFrame" 1 "FirstFrame" 2 "ConsecutiveFrame" 3 "FlowControl" ;
VAL_ 1632 FlowStatus 0 "ContinueToSend" 1 "Wait" 2 "Overflow" ;
VAL_ 1632 IsoTpFrameType 0 "SingleFrame" 1 "FirstFrame" 2 "ConsecutiveFrame" 3 "FlowControl" ;
VAL_ 1633 FlowStatus 0 "ContinueToSend" 1 "Wait" 2 "Overflow" ;
VAL_ 1633 IsoTpFrameType 0 "SingleFrame" 1 "FirstFrame" 2 "ConsecutiveFrame" 3 "FlowControl" ;
VAL_ 1634 FlowStatus 0 "ContinueToSend" 1 "Wait" 2 "Overflow" ;
VAL_ 1634 IsoTpFrameType 0 "SingleFrame" 1 "FirstFrame" 2 "ConsecutiveFrame" 3 "FlowControl" ;
VAL_ 1635 FlowStatus 0 "ContinueToSend" 1 "Wait" 2 "Overflow" ;
VAL_ 1635 IsoTpFrameType 0 "SingleFrame" 1 "FirstFrame" 2 "ConsecutiveFrame" 3 "FlowControl" ;
VAL_ 1636 FlowStatus 0 "ContinueToSend" 1 "Wait" 2 "Overflow" ;
VAL_ 1636 IsoTpFrameType 0 "SingleFrame" 1 "FirstFrame" 2 "ConsecutiveFrame" 3 "FlowControl" ;
VAL_ 1637 FlowStatus 0 "ContinueToSend" 1 "Wait" 2 "Overflow" ;
VAL_ 1637 IsoTpFrameType 0 "SingleFrame" 1 "FirstFrame" 2 "ConsecutiveFrame" 3 "FlowControl" ;
VAL_ 1638 FlowStatus 0 "ContinueToSend" 1 "Wait" 2 "Overflow" ;
VAL_ 1638 IsoTpFrameType 0 "SingleFrame" 1 "FirstFrame" 2 "ConsecutiveFrame" 3 "FlowControl" ;
VAL_ 1643 FlowStatus 0 "ContinueToSend" 1 "Wait" 2 "Overflow" ;
VAL_ 1643 IsoTpFrameType 0 "SingleFrame" 1 "FirstFrame" 2 "ConsecutiveFrame" 3 "FlowControl" ;
VAL_ 1644 FlowStatus 0 "ContinueToSend" 1 "Wait" 2 "Overflow" ;
VAL_ 1644 IsoTpFrameType 0 "SingleFrame" 1 "FirstFrame" 2 "ConsecutiveFrame" 3 "FlowControl" ;
VAL_ 1645 FlowStatus 0 "ContinueToSend" 1 "Wait" 2 "Overflow" ;
VAL_ 1645 IsoTpFrameType 0 "SingleFrame" 1 "FirstFrame" 2 "ConsecutiveFrame" 3 "FlowControl" ;
SG_MUL_VAL_ 1611 SingleFrameLength IsoTpFrameType 0-0;
SG_MUL_VAL_ 1611 FirstFrameLength IsoTpFrameType 1-1;
SG_MUL_VAL_ 1611 ConsecutiveSequence IsoTpFrameType 2-2;
SG_MUL_VAL_ 1611 FlowStatus IsoTpFrameType 3-3;
SG_MUL_VAL_ 1611 UnknownPciLow IsoTpFrameType 4-15;
SG_MUL_VAL_ 1611 BlockSize IsoTpFrameType 3-3;
SG_MUL_VAL_ 1611 SingleData1 IsoTpFrameType 0-0;
SG_MUL_VAL_ 1611 ConsecutiveData1 IsoTpFrameType 2-2;
SG_MUL_VAL_ 1611 UnknownData1 IsoTpFrameType 4-15;
SG_MUL_VAL_ 1611 SeparationTimeRaw IsoTpFrameType 3-3;
SG_MUL_VAL_ 1611 SingleData2 IsoTpFrameType 0-0;
SG_MUL_VAL_ 1611 ConsecutiveData2 IsoTpFrameType 2-2;
SG_MUL_VAL_ 1611 UnknownData2 IsoTpFrameType 4-15;
SG_MUL_VAL_ 1611 FirstData1 IsoTpFrameType 1-1;
SG_MUL_VAL_ 1611 SingleData3 IsoTpFrameType 0-0;
SG_MUL_VAL_ 1611 ConsecutiveData3 IsoTpFrameType 2-2;
SG_MUL_VAL_ 1611 UnknownData3 IsoTpFrameType 4-15;
SG_MUL_VAL_ 1611 FirstData2 IsoTpFrameType 1-1;
SG_MUL_VAL_ 1611 FlowPadding1 IsoTpFrameType 3-3;
SG_MUL_VAL_ 1611 SingleData4 IsoTpFrameType 0-0;
SG_MUL_VAL_ 1611 ConsecutiveData4 IsoTpFrameType 2-2;
SG_MUL_VAL_ 1611 UnknownData4 IsoTpFrameType 4-15;
SG_MUL_VAL_ 1611 FirstData3 IsoTpFrameType 1-1;
SG_MUL_VAL_ 1611 FlowPadding2 IsoTpFrameType 3-3;
SG_MUL_VAL_ 1611 SingleData5 IsoTpFrameType 0-0;
SG_MUL_VAL_ 1611 ConsecutiveData5 IsoTpFrameType 2-2;
SG_MUL_VAL_ 1611 UnknownData5 IsoTpFrameType 4-15;
SG_MUL_VAL_ 1611 FirstData4 IsoTpFrameType 1-1;
SG_MUL_VAL_ 1611 FlowPadding3 IsoTpFrameType 3-3;
SG_MUL_VAL_ 1611 SingleData6 IsoTpFrameType 0-0;
SG_MUL_VAL_ 1611 ConsecutiveData6 IsoTpFrameType 2-2;
SG_MUL_VAL_ 1611 UnknownData6 IsoTpFrameType 4-15;
SG_MUL_VAL_ 1611 FirstData5 IsoTpFrameType 1-1;
SG_MUL_VAL_ 1611 FlowPadding4 IsoTpFrameType 3-3;
SG_MUL_VAL_ 1611 SingleData7 IsoTpFrameType 0-0;
SG_MUL_VAL_ 1611 ConsecutiveData7 IsoTpFrameType 2-2;
SG_MUL_VAL_ 1611 UnknownData7 IsoTpFrameType 4-15;
SG_MUL_VAL_ 1611 FirstData6 IsoTpFrameType 1-1;
SG_MUL_VAL_ 1611 FlowPadding5 IsoTpFrameType 3-3;
SG_MUL_VAL_ 1612 SingleFrameLength IsoTpFrameType 0-0;
SG_MUL_VAL_ 1612 FirstFrameLength IsoTpFrameType 1-1;
SG_MUL_VAL_ 1612 ConsecutiveSequence IsoTpFrameType 2-2;
SG_MUL_VAL_ 1612 FlowStatus IsoTpFrameType 3-3;
SG_MUL_VAL_ 1612 UnknownPciLow IsoTpFrameType 4-15;
SG_MUL_VAL_ 1612 BlockSize IsoTpFrameType 3-3;
SG_MUL_VAL_ 1612 SingleData1 IsoTpFrameType 0-0;
SG_MUL_VAL_ 1612 ConsecutiveData1 IsoTpFrameType 2-2;
SG_MUL_VAL_ 1612 UnknownData1 IsoTpFrameType 4-15;
SG_MUL_VAL_ 1612 SeparationTimeRaw IsoTpFrameType 3-3;
SG_MUL_VAL_ 1612 SingleData2 IsoTpFrameType 0-0;
SG_MUL_VAL_ 1612 ConsecutiveData2 IsoTpFrameType 2-2;
SG_MUL_VAL_ 1612 UnknownData2 IsoTpFrameType 4-15;
SG_MUL_VAL_ 1612 FirstData1 IsoTpFrameType 1-1;
SG_MUL_VAL_ 1612 SingleData3 IsoTpFrameType 0-0;
SG_MUL_VAL_ 1612 ConsecutiveData3 IsoTpFrameType 2-2;
SG_MUL_VAL_ 1612 UnknownData3 IsoTpFrameType 4-15;
SG_MUL_VAL_ 1612 FirstData2 IsoTpFrameType 1-1;
SG_MUL_VAL_ 1612 FlowPadding1 IsoTpFrameType 3-3;
SG_MUL_VAL_ 1612 SingleData4 IsoTpFrameType 0-0;
SG_MUL_VAL_ 1612 ConsecutiveData4 IsoTpFrameType 2-2;
SG_MUL_VAL_ 1612 UnknownData4 IsoTpFrameType 4-15;
SG_MUL_VAL_ 1612 FirstData3 IsoTpFrameType 1-1;
SG_MUL_VAL_ 1612 FlowPadding2 IsoTpFrameType 3-3;
SG_MUL_VAL_ 1612 SingleData5 IsoTpFrameType 0-0;
SG_MUL_VAL_ 1612 ConsecutiveData5 IsoTpFrameType 2-2;
SG_MUL_VAL_ 1612 UnknownData5 IsoTpFrameType 4-15;
SG_MUL_VAL_ 1612 FirstData4 IsoTpFrameType 1-1;
SG_MUL_VAL_ 1612 FlowPadding3 IsoTpFrameType 3-3;
SG_MUL_VAL_ 1612 SingleData6 IsoTpFrameType 0-0;
SG_MUL_VAL_ 1612 ConsecutiveData6 IsoTpFrameType 2-2;
SG_MUL_VAL_ 1612 UnknownData6 IsoTpFrameType 4-15;
SG_MUL_VAL_ 1612 FirstData5 IsoTpFrameType 1-1;
SG_MUL_VAL_ 1612 FlowPadding4 IsoTpFrameType 3-3;
SG_MUL_VAL_ 1612 SingleData7 IsoTpFrameType 0-0;
SG_MUL_VAL_ 1612 ConsecutiveData7 IsoTpFrameType 2-2;
SG_MUL_VAL_ 1612 UnknownData7 IsoTpFrameType 4-15;
SG_MUL_VAL_ 1612 FirstData6 IsoTpFrameType 1-1;
SG_MUL_VAL_ 1612 FlowPadding5 IsoTpFrameType 3-3;
SG_MUL_VAL_ 1615 SingleFrameLength IsoTpFrameType 0-0;
SG_MUL_VAL_ 1615 FirstFrameLength IsoTpFrameType 1-1;
SG_MUL_VAL_ 1615 ConsecutiveSequence IsoTpFrameType 2-2;
SG_MUL_VAL_ 1615 FlowStatus IsoTpFrameType 3-3;
SG_MUL_VAL_ 1615 UnknownPciLow IsoTpFrameType 4-15;
SG_MUL_VAL_ 1615 BlockSize IsoTpFrameType 3-3;
SG_MUL_VAL_ 1615 SingleData1 IsoTpFrameType 0-0;
SG_MUL_VAL_ 1615 ConsecutiveData1 IsoTpFrameType 2-2;
SG_MUL_VAL_ 1615 UnknownData1 IsoTpFrameType 4-15;
SG_MUL_VAL_ 1615 SeparationTimeRaw IsoTpFrameType 3-3;
SG_MUL_VAL_ 1615 SingleData2 IsoTpFrameType 0-0;
SG_MUL_VAL_ 1615 ConsecutiveData2 IsoTpFrameType 2-2;
SG_MUL_VAL_ 1615 UnknownData2 IsoTpFrameType 4-15;
SG_MUL_VAL_ 1615 FirstData1 IsoTpFrameType 1-1;
SG_MUL_VAL_ 1615 SingleData3 IsoTpFrameType 0-0;
SG_MUL_VAL_ 1615 ConsecutiveData3 IsoTpFrameType 2-2;
SG_MUL_VAL_ 1615 UnknownData3 IsoTpFrameType 4-15;
SG_MUL_VAL_ 1615 FirstData2 IsoTpFrameType 1-1;
SG_MUL_VAL_ 1615 FlowPadding1 IsoTpFrameType 3-3;
SG_MUL_VAL_ 1615 SingleData4 IsoTpFrameType 0-0;
SG_MUL_VAL_ 1615 ConsecutiveData4 IsoTpFrameType 2-2;
SG_MUL_VAL_ 1615 UnknownData4 IsoTpFrameType 4-15;
SG_MUL_VAL_ 1615 FirstData3 IsoTpFrameType 1-1;
SG_MUL_VAL_ 1615 FlowPadding2 IsoTpFrameType 3-3;
SG_MUL_VAL_ 1615 SingleData5 IsoTpFrameType 0-0;
SG_MUL_VAL_ 1615 ConsecutiveData5 IsoTpFrameType 2-2;
SG_MUL_VAL_ 1615 UnknownData5 IsoTpFrameType 4-15;
SG_MUL_VAL_ 1615 FirstData4 IsoTpFrameType 1-1;
SG_MUL_VAL_ 1615 FlowPadding3 IsoTpFrameType 3-3;
SG_MUL_VAL_ 1615 SingleData6 IsoTpFrameType 0-0;
SG_MUL_VAL_ 1615 ConsecutiveData6 IsoTpFrameType 2-2;
SG_MUL_VAL_ 1615 UnknownData6 IsoTpFrameType 4-15;
SG_MUL_VAL_ 1615 FirstData5 IsoTpFrameType 1-1;
SG_MUL_VAL_ 1615 FlowPadding4 IsoTpFrameType 3-3;
SG_MUL_VAL_ 1615 SingleData7 IsoTpFrameType 0-0;
SG_MUL_VAL_ 1615 ConsecutiveData7 IsoTpFrameType 2-2;
SG_MUL_VAL_ 1615 UnknownData7 IsoTpFrameType 4-15;
SG_MUL_VAL_ 1615 FirstData6 IsoTpFrameType 1-1;
SG_MUL_VAL_ 1615 FlowPadding5 IsoTpFrameType 3-3;
SG_MUL_VAL_ 1619 SingleFrameLength IsoTpFrameType 0-0;
SG_MUL_VAL_ 1619 FirstFrameLength IsoTpFrameType 1-1;
SG_MUL_VAL_ 1619 ConsecutiveSequence IsoTpFrameType 2-2;
SG_MUL_VAL_ 1619 FlowStatus IsoTpFrameType 3-3;
SG_MUL_VAL_ 1619 UnknownPciLow IsoTpFrameType 4-15;
SG_MUL_VAL_ 1619 BlockSize IsoTpFrameType 3-3;
SG_MUL_VAL_ 1619 SingleData1 IsoTpFrameType 0-0;
SG_MUL_VAL_ 1619 ConsecutiveData1 IsoTpFrameType 2-2;
SG_MUL_VAL_ 1619 UnknownData1 IsoTpFrameType 4-15;
SG_MUL_VAL_ 1619 SeparationTimeRaw IsoTpFrameType 3-3;
SG_MUL_VAL_ 1619 SingleData2 IsoTpFrameType 0-0;
SG_MUL_VAL_ 1619 ConsecutiveData2 IsoTpFrameType 2-2;
SG_MUL_VAL_ 1619 UnknownData2 IsoTpFrameType 4-15;
SG_MUL_VAL_ 1619 FirstData1 IsoTpFrameType 1-1;
SG_MUL_VAL_ 1619 SingleData3 IsoTpFrameType 0-0;
SG_MUL_VAL_ 1619 ConsecutiveData3 IsoTpFrameType 2-2;
SG_MUL_VAL_ 1619 UnknownData3 IsoTpFrameType 4-15;
SG_MUL_VAL_ 1619 FirstData2 IsoTpFrameType 1-1;
SG_MUL_VAL_ 1619 FlowPadding1 IsoTpFrameType 3-3;
SG_MUL_VAL_ 1619 SingleData4 IsoTpFrameType 0-0;
SG_MUL_VAL_ 1619 ConsecutiveData4 IsoTpFrameType 2-2;
SG_MUL_VAL_ 1619 UnknownData4 IsoTpFrameType 4-15;
SG_MUL_VAL_ 1619 FirstData3 IsoTpFrameType 1-1;
SG_MUL_VAL_ 1619 FlowPadding2 IsoTpFrameType 3-3;
SG_MUL_VAL_ 1619 SingleData5 IsoTpFrameType 0-0;
SG_MUL_VAL_ 1619 ConsecutiveData5 IsoTpFrameType 2-2;
SG_MUL_VAL_ 1619 UnknownData5 IsoTpFrameType 4-15;
SG_MUL_VAL_ 1619 FirstData4 IsoTpFrameType 1-1;
SG_MUL_VAL_ 1619 FlowPadding3 IsoTpFrameType 3-3;
SG_MUL_VAL_ 1619 SingleData6 IsoTpFrameType 0-0;
SG_MUL_VAL_ 1619 ConsecutiveData6 IsoTpFrameType 2-2;
SG_MUL_VAL_ 1619 UnknownData6 IsoTpFrameType 4-15;
SG_MUL_VAL_ 1619 FirstData5 IsoTpFrameType 1-1;
SG_MUL_VAL_ 1619 FlowPadding4 IsoTpFrameType 3-3;
SG_MUL_VAL_ 1619 SingleData7 IsoTpFrameType 0-0;
SG_MUL_VAL_ 1619 ConsecutiveData7 IsoTpFrameType 2-2;
SG_MUL_VAL_ 1619 UnknownData7 IsoTpFrameType 4-15;
SG_MUL_VAL_ 1619 FirstData6 IsoTpFrameType 1-1;
SG_MUL_VAL_ 1619 FlowPadding5 IsoTpFrameType 3-3;
SG_MUL_VAL_ 1625 SingleFrameLength IsoTpFrameType 0-0;
SG_MUL_VAL_ 1625 FirstFrameLength IsoTpFrameType 1-1;
SG_MUL_VAL_ 1625 ConsecutiveSequence IsoTpFrameType 2-2;
SG_MUL_VAL_ 1625 FlowStatus IsoTpFrameType 3-3;
SG_MUL_VAL_ 1625 UnknownPciLow IsoTpFrameType 4-15;
SG_MUL_VAL_ 1625 BlockSize IsoTpFrameType 3-3;
SG_MUL_VAL_ 1625 SingleData1 IsoTpFrameType 0-0;
SG_MUL_VAL_ 1625 ConsecutiveData1 IsoTpFrameType 2-2;
SG_MUL_VAL_ 1625 UnknownData1 IsoTpFrameType 4-15;
SG_MUL_VAL_ 1625 SeparationTimeRaw IsoTpFrameType 3-3;
SG_MUL_VAL_ 1625 SingleData2 IsoTpFrameType 0-0;
SG_MUL_VAL_ 1625 ConsecutiveData2 IsoTpFrameType 2-2;
SG_MUL_VAL_ 1625 UnknownData2 IsoTpFrameType 4-15;
SG_MUL_VAL_ 1625 FirstData1 IsoTpFrameType 1-1;
SG_MUL_VAL_ 1625 SingleData3 IsoTpFrameType 0-0;
SG_MUL_VAL_ 1625 ConsecutiveData3 IsoTpFrameType 2-2;
SG_MUL_VAL_ 1625 UnknownData3 IsoTpFrameType 4-15;
SG_MUL_VAL_ 1625 FirstData2 IsoTpFrameType 1-1;
SG_MUL_VAL_ 1625 FlowPadding1 IsoTpFrameType 3-3;
SG_MUL_VAL_ 1625 SingleData4 IsoTpFrameType 0-0;
SG_MUL_VAL_ 1625 ConsecutiveData4 IsoTpFrameType 2-2;
SG_MUL_VAL_ 1625 UnknownData4 IsoTpFrameType 4-15;
SG_MUL_VAL_ 1625 FirstData3 IsoTpFrameType 1-1;
SG_MUL_VAL_ 1625 FlowPadding2 IsoTpFrameType 3-3;
SG_MUL_VAL_ 1625 SingleData5 IsoTpFrameType 0-0;
SG_MUL_VAL_ 1625 ConsecutiveData5 IsoTpFrameType 2-2;
SG_MUL_VAL_ 1625 UnknownData5 IsoTpFrameType 4-15;
SG_MUL_VAL_ 1625 FirstData4 IsoTpFrameType 1-1;
SG_MUL_VAL_ 1625 FlowPadding3 IsoTpFrameType 3-3;
SG_MUL_VAL_ 1625 SingleData6 IsoTpFrameType 0-0;
SG_MUL_VAL_ 1625 ConsecutiveData6 IsoTpFrameType 2-2;
SG_MUL_VAL_ 1625 UnknownData6 IsoTpFrameType 4-15;
SG_MUL_VAL_ 1625 FirstData5 IsoTpFrameType 1-1;
SG_MUL_VAL_ 1625 FlowPadding4 IsoTpFrameType 3-3;
SG_MUL_VAL_ 1625 SingleData7 IsoTpFrameType 0-0;
SG_MUL_VAL_ 1625 ConsecutiveData7 IsoTpFrameType 2-2;
SG_MUL_VAL_ 1625 UnknownData7 IsoTpFrameType 4-15;
SG_MUL_VAL_ 1625 FirstData6 IsoTpFrameType 1-1;
SG_MUL_VAL_ 1625 FlowPadding5 IsoTpFrameType 3-3;
SG_MUL_VAL_ 1627 SingleFrameLength IsoTpFrameType 0-0;
SG_MUL_VAL_ 1627 FirstFrameLength IsoTpFrameType 1-1;
SG_MUL_VAL_ 1627 ConsecutiveSequence IsoTpFrameType 2-2;
SG_MUL_VAL_ 1627 FlowStatus IsoTpFrameType 3-3;
SG_MUL_VAL_ 1627 UnknownPciLow IsoTpFrameType 4-15;
SG_MUL_VAL_ 1627 BlockSize IsoTpFrameType 3-3;
SG_MUL_VAL_ 1627 SingleData1 IsoTpFrameType 0-0;
SG_MUL_VAL_ 1627 ConsecutiveData1 IsoTpFrameType 2-2;
SG_MUL_VAL_ 1627 UnknownData1 IsoTpFrameType 4-15;
SG_MUL_VAL_ 1627 SeparationTimeRaw IsoTpFrameType 3-3;
SG_MUL_VAL_ 1627 SingleData2 IsoTpFrameType 0-0;
SG_MUL_VAL_ 1627 ConsecutiveData2 IsoTpFrameType 2-2;
SG_MUL_VAL_ 1627 UnknownData2 IsoTpFrameType 4-15;
SG_MUL_VAL_ 1627 FirstData1 IsoTpFrameType 1-1;
SG_MUL_VAL_ 1627 SingleData3 IsoTpFrameType 0-0;
SG_MUL_VAL_ 1627 ConsecutiveData3 IsoTpFrameType 2-2;
SG_MUL_VAL_ 1627 UnknownData3 IsoTpFrameType 4-15;
SG_MUL_VAL_ 1627 FirstData2 IsoTpFrameType 1-1;
SG_MUL_VAL_ 1627 FlowPadding1 IsoTpFrameType 3-3;
SG_MUL_VAL_ 1627 SingleData4 IsoTpFrameType 0-0;
SG_MUL_VAL_ 1627 ConsecutiveData4 IsoTpFrameType 2-2;
SG_MUL_VAL_ 1627 UnknownData4 IsoTpFrameType 4-15;
SG_MUL_VAL_ 1627 FirstData3 IsoTpFrameType 1-1;
SG_MUL_VAL_ 1627 FlowPadding2 IsoTpFrameType 3-3;
SG_MUL_VAL_ 1627 SingleData5 IsoTpFrameType 0-0;
SG_MUL_VAL_ 1627 ConsecutiveData5 IsoTpFrameType 2-2;
SG_MUL_VAL_ 1627 UnknownData5 IsoTpFrameType 4-15;
SG_MUL_VAL_ 1627 FirstData4 IsoTpFrameType 1-1;
SG_MUL_VAL_ 1627 FlowPadding3 IsoTpFrameType 3-3;
SG_MUL_VAL_ 1627 SingleData6 IsoTpFrameType 0-0;
SG_MUL_VAL_ 1627 ConsecutiveData6 IsoTpFrameType 2-2;
SG_MUL_VAL_ 1627 UnknownData6 IsoTpFrameType 4-15;
SG_MUL_VAL_ 1627 FirstData5 IsoTpFrameType 1-1;
SG_MUL_VAL_ 1627 FlowPadding4 IsoTpFrameType 3-3;
SG_MUL_VAL_ 1627 SingleData7 IsoTpFrameType 0-0;
SG_MUL_VAL_ 1627 ConsecutiveData7 IsoTpFrameType 2-2;
SG_MUL_VAL_ 1627 UnknownData7 IsoTpFrameType 4-15;
SG_MUL_VAL_ 1627 FirstData6 IsoTpFrameType 1-1;
SG_MUL_VAL_ 1627 FlowPadding5 IsoTpFrameType 3-3;
SG_MUL_VAL_ 1628 SingleFrameLength IsoTpFrameType 0-0;
SG_MUL_VAL_ 1628 FirstFrameLength IsoTpFrameType 1-1;
SG_MUL_VAL_ 1628 ConsecutiveSequence IsoTpFrameType 2-2;
SG_MUL_VAL_ 1628 FlowStatus IsoTpFrameType 3-3;
SG_MUL_VAL_ 1628 UnknownPciLow IsoTpFrameType 4-15;
SG_MUL_VAL_ 1628 BlockSize IsoTpFrameType 3-3;
SG_MUL_VAL_ 1628 SingleData1 IsoTpFrameType 0-0;
SG_MUL_VAL_ 1628 ConsecutiveData1 IsoTpFrameType 2-2;
SG_MUL_VAL_ 1628 UnknownData1 IsoTpFrameType 4-15;
SG_MUL_VAL_ 1628 SeparationTimeRaw IsoTpFrameType 3-3;
SG_MUL_VAL_ 1628 SingleData2 IsoTpFrameType 0-0;
SG_MUL_VAL_ 1628 ConsecutiveData2 IsoTpFrameType 2-2;
SG_MUL_VAL_ 1628 UnknownData2 IsoTpFrameType 4-15;
SG_MUL_VAL_ 1628 FirstData1 IsoTpFrameType 1-1;
SG_MUL_VAL_ 1628 SingleData3 IsoTpFrameType 0-0;
SG_MUL_VAL_ 1628 ConsecutiveData3 IsoTpFrameType 2-2;
SG_MUL_VAL_ 1628 UnknownData3 IsoTpFrameType 4-15;
SG_MUL_VAL_ 1628 FirstData2 IsoTpFrameType 1-1;
SG_MUL_VAL_ 1628 FlowPadding1 IsoTpFrameType 3-3;
SG_MUL_VAL_ 1628 SingleData4 IsoTpFrameType 0-0;
SG_MUL_VAL_ 1628 ConsecutiveData4 IsoTpFrameType 2-2;
SG_MUL_VAL_ 1628 UnknownData4 IsoTpFrameType 4-15;
SG_MUL_VAL_ 1628 FirstData3 IsoTpFrameType 1-1;
SG_MUL_VAL_ 1628 FlowPadding2 IsoTpFrameType 3-3;
SG_MUL_VAL_ 1628 SingleData5 IsoTpFrameType 0-0;
SG_MUL_VAL_ 1628 ConsecutiveData5 IsoTpFrameType 2-2;
SG_MUL_VAL_ 1628 UnknownData5 IsoTpFrameType 4-15;
SG_MUL_VAL_ 1628 FirstData4 IsoTpFrameType 1-1;
SG_MUL_VAL_ 1628 FlowPadding3 IsoTpFrameType 3-3;
SG_MUL_VAL_ 1628 SingleData6 IsoTpFrameType 0-0;
SG_MUL_VAL_ 1628 ConsecutiveData6 IsoTpFrameType 2-2;
SG_MUL_VAL_ 1628 UnknownData6 IsoTpFrameType 4-15;
SG_MUL_VAL_ 1628 FirstData5 IsoTpFrameType 1-1;
SG_MUL_VAL_ 1628 FlowPadding4 IsoTpFrameType 3-3;
SG_MUL_VAL_ 1628 SingleData7 IsoTpFrameType 0-0;
SG_MUL_VAL_ 1628 ConsecutiveData7 IsoTpFrameType 2-2;
SG_MUL_VAL_ 1628 UnknownData7 IsoTpFrameType 4-15;
SG_MUL_VAL_ 1628 FirstData6 IsoTpFrameType 1-1;
SG_MUL_VAL_ 1628 FlowPadding5 IsoTpFrameType 3-3;
SG_MUL_VAL_ 1629 SingleFrameLength IsoTpFrameType 0-0;
SG_MUL_VAL_ 1629 FirstFrameLength IsoTpFrameType 1-1;
SG_MUL_VAL_ 1629 ConsecutiveSequence IsoTpFrameType 2-2;
SG_MUL_VAL_ 1629 FlowStatus IsoTpFrameType 3-3;
SG_MUL_VAL_ 1629 UnknownPciLow IsoTpFrameType 4-15;
SG_MUL_VAL_ 1629 BlockSize IsoTpFrameType 3-3;
SG_MUL_VAL_ 1629 SingleData1 IsoTpFrameType 0-0;
SG_MUL_VAL_ 1629 ConsecutiveData1 IsoTpFrameType 2-2;
SG_MUL_VAL_ 1629 UnknownData1 IsoTpFrameType 4-15;
SG_MUL_VAL_ 1629 SeparationTimeRaw IsoTpFrameType 3-3;
SG_MUL_VAL_ 1629 SingleData2 IsoTpFrameType 0-0;
SG_MUL_VAL_ 1629 ConsecutiveData2 IsoTpFrameType 2-2;
SG_MUL_VAL_ 1629 UnknownData2 IsoTpFrameType 4-15;
SG_MUL_VAL_ 1629 FirstData1 IsoTpFrameType 1-1;
SG_MUL_VAL_ 1629 SingleData3 IsoTpFrameType 0-0;
SG_MUL_VAL_ 1629 ConsecutiveData3 IsoTpFrameType 2-2;
SG_MUL_VAL_ 1629 UnknownData3 IsoTpFrameType 4-15;
SG_MUL_VAL_ 1629 FirstData2 IsoTpFrameType 1-1;
SG_MUL_VAL_ 1629 FlowPadding1 IsoTpFrameType 3-3;
SG_MUL_VAL_ 1629 SingleData4 IsoTpFrameType 0-0;
SG_MUL_VAL_ 1629 ConsecutiveData4 IsoTpFrameType 2-2;
SG_MUL_VAL_ 1629 UnknownData4 IsoTpFrameType 4-15;
SG_MUL_VAL_ 1629 FirstData3 IsoTpFrameType 1-1;
SG_MUL_VAL_ 1629 FlowPadding2 IsoTpFrameType 3-3;
SG_MUL_VAL_ 1629 SingleData5 IsoTpFrameType 0-0;
SG_MUL_VAL_ 1629 ConsecutiveData5 IsoTpFrameType 2-2;
SG_MUL_VAL_ 1629 UnknownData5 IsoTpFrameType 4-15;
SG_MUL_VAL_ 1629 FirstData4 IsoTpFrameType 1-1;
SG_MUL_VAL_ 1629 FlowPadding3 IsoTpFrameType 3-3;
SG_MUL_VAL_ 1629 SingleData6 IsoTpFrameType 0-0;
SG_MUL_VAL_ 1629 ConsecutiveData6 IsoTpFrameType 2-2;
SG_MUL_VAL_ 1629 UnknownData6 IsoTpFrameType 4-15;
SG_MUL_VAL_ 1629 FirstData5 IsoTpFrameType 1-1;
SG_MUL_VAL_ 1629 FlowPadding4 IsoTpFrameType 3-3;
SG_MUL_VAL_ 1629 SingleData7 IsoTpFrameType 0-0;
SG_MUL_VAL_ 1629 ConsecutiveData7 IsoTpFrameType 2-2;
SG_MUL_VAL_ 1629 UnknownData7 IsoTpFrameType 4-15;
SG_MUL_VAL_ 1629 FirstData6 IsoTpFrameType 1-1;
SG_MUL_VAL_ 1629 FlowPadding5 IsoTpFrameType 3-3;
SG_MUL_VAL_ 1630 SingleFrameLength IsoTpFrameType 0-0;
SG_MUL_VAL_ 1630 FirstFrameLength IsoTpFrameType 1-1;
SG_MUL_VAL_ 1630 ConsecutiveSequence IsoTpFrameType 2-2;
SG_MUL_VAL_ 1630 FlowStatus IsoTpFrameType 3-3;
SG_MUL_VAL_ 1630 UnknownPciLow IsoTpFrameType 4-15;
SG_MUL_VAL_ 1630 BlockSize IsoTpFrameType 3-3;
SG_MUL_VAL_ 1630 SingleData1 IsoTpFrameType 0-0;
SG_MUL_VAL_ 1630 ConsecutiveData1 IsoTpFrameType 2-2;
SG_MUL_VAL_ 1630 UnknownData1 IsoTpFrameType 4-15;
SG_MUL_VAL_ 1630 SeparationTimeRaw IsoTpFrameType 3-3;
SG_MUL_VAL_ 1630 SingleData2 IsoTpFrameType 0-0;
SG_MUL_VAL_ 1630 ConsecutiveData2 IsoTpFrameType 2-2;
SG_MUL_VAL_ 1630 UnknownData2 IsoTpFrameType 4-15;
SG_MUL_VAL_ 1630 FirstData1 IsoTpFrameType 1-1;
SG_MUL_VAL_ 1630 SingleData3 IsoTpFrameType 0-0;
SG_MUL_VAL_ 1630 ConsecutiveData3 IsoTpFrameType 2-2;
SG_MUL_VAL_ 1630 UnknownData3 IsoTpFrameType 4-15;
SG_MUL_VAL_ 1630 FirstData2 IsoTpFrameType 1-1;
SG_MUL_VAL_ 1630 FlowPadding1 IsoTpFrameType 3-3;
SG_MUL_VAL_ 1630 SingleData4 IsoTpFrameType 0-0;
SG_MUL_VAL_ 1630 ConsecutiveData4 IsoTpFrameType 2-2;
SG_MUL_VAL_ 1630 UnknownData4 IsoTpFrameType 4-15;
SG_MUL_VAL_ 1630 FirstData3 IsoTpFrameType 1-1;
SG_MUL_VAL_ 1630 FlowPadding2 IsoTpFrameType 3-3;
SG_MUL_VAL_ 1630 SingleData5 IsoTpFrameType 0-0;
SG_MUL_VAL_ 1630 ConsecutiveData5 IsoTpFrameType 2-2;
SG_MUL_VAL_ 1630 UnknownData5 IsoTpFrameType 4-15;
SG_MUL_VAL_ 1630 FirstData4 IsoTpFrameType 1-1;
SG_MUL_VAL_ 1630 FlowPadding3 IsoTpFrameType 3-3;
SG_MUL_VAL_ 1630 SingleData6 IsoTpFrameType 0-0;
SG_MUL_VAL_ 1630 ConsecutiveData6 IsoTpFrameType 2-2;
SG_MUL_VAL_ 1630 UnknownData6 IsoTpFrameType 4-15;
SG_MUL_VAL_ 1630 FirstData5 IsoTpFrameType 1-1;
SG_MUL_VAL_ 1630 FlowPadding4 IsoTpFrameType 3-3;
SG_MUL_VAL_ 1630 SingleData7 IsoTpFrameType 0-0;
SG_MUL_VAL_ 1630 ConsecutiveData7 IsoTpFrameType 2-2;
SG_MUL_VAL_ 1630 UnknownData7 IsoTpFrameType 4-15;
SG_MUL_VAL_ 1630 FirstData6 IsoTpFrameType 1-1;
SG_MUL_VAL_ 1630 FlowPadding5 IsoTpFrameType 3-3;
SG_MUL_VAL_ 1631 SingleFrameLength IsoTpFrameType 0-0;
SG_MUL_VAL_ 1631 FirstFrameLength IsoTpFrameType 1-1;
SG_MUL_VAL_ 1631 ConsecutiveSequence IsoTpFrameType 2-2;
SG_MUL_VAL_ 1631 FlowStatus IsoTpFrameType 3-3;
SG_MUL_VAL_ 1631 UnknownPciLow IsoTpFrameType 4-15;
SG_MUL_VAL_ 1631 BlockSize IsoTpFrameType 3-3;
SG_MUL_VAL_ 1631 SingleData1 IsoTpFrameType 0-0;
SG_MUL_VAL_ 1631 ConsecutiveData1 IsoTpFrameType 2-2;
SG_MUL_VAL_ 1631 UnknownData1 IsoTpFrameType 4-15;
SG_MUL_VAL_ 1631 SeparationTimeRaw IsoTpFrameType 3-3;
SG_MUL_VAL_ 1631 SingleData2 IsoTpFrameType 0-0;
SG_MUL_VAL_ 1631 ConsecutiveData2 IsoTpFrameType 2-2;
SG_MUL_VAL_ 1631 UnknownData2 IsoTpFrameType 4-15;
SG_MUL_VAL_ 1631 FirstData1 IsoTpFrameType 1-1;
SG_MUL_VAL_ 1631 SingleData3 IsoTpFrameType 0-0;
SG_MUL_VAL_ 1631 ConsecutiveData3 IsoTpFrameType 2-2;
SG_MUL_VAL_ 1631 UnknownData3 IsoTpFrameType 4-15;
SG_MUL_VAL_ 1631 FirstData2 IsoTpFrameType 1-1;
SG_MUL_VAL_ 1631 FlowPadding1 IsoTpFrameType 3-3;
SG_MUL_VAL_ 1631 SingleData4 IsoTpFrameType 0-0;
SG_MUL_VAL_ 1631 ConsecutiveData4 IsoTpFrameType 2-2;
SG_MUL_VAL_ 1631 UnknownData4 IsoTpFrameType 4-15;
SG_MUL_VAL_ 1631 FirstData3 IsoTpFrameType 1-1;
SG_MUL_VAL_ 1631 FlowPadding2 IsoTpFrameType 3-3;
SG_MUL_VAL_ 1631 SingleData5 IsoTpFrameType 0-0;
SG_MUL_VAL_ 1631 ConsecutiveData5 IsoTpFrameType 2-2;
SG_MUL_VAL_ 1631 UnknownData5 IsoTpFrameType 4-15;
SG_MUL_VAL_ 1631 FirstData4 IsoTpFrameType 1-1;
SG_MUL_VAL_ 1631 FlowPadding3 IsoTpFrameType 3-3;
SG_MUL_VAL_ 1631 SingleData6 IsoTpFrameType 0-0;
SG_MUL_VAL_ 1631 ConsecutiveData6 IsoTpFrameType 2-2;
SG_MUL_VAL_ 1631 UnknownData6 IsoTpFrameType 4-15;
SG_MUL_VAL_ 1631 FirstData5 IsoTpFrameType 1-1;
SG_MUL_VAL_ 1631 FlowPadding4 IsoTpFrameType 3-3;
SG_MUL_VAL_ 1631 SingleData7 IsoTpFrameType 0-0;
SG_MUL_VAL_ 1631 ConsecutiveData7 IsoTpFrameType 2-2;
SG_MUL_VAL_ 1631 UnknownData7 IsoTpFrameType 4-15;
SG_MUL_VAL_ 1631 FirstData6 IsoTpFrameType 1-1;
SG_MUL_VAL_ 1631 FlowPadding5 IsoTpFrameType 3-3;
SG_MUL_VAL_ 1632 SingleFrameLength IsoTpFrameType 0-0;
SG_MUL_VAL_ 1632 FirstFrameLength IsoTpFrameType 1-1;
SG_MUL_VAL_ 1632 ConsecutiveSequence IsoTpFrameType 2-2;
SG_MUL_VAL_ 1632 FlowStatus IsoTpFrameType 3-3;
SG_MUL_VAL_ 1632 UnknownPciLow IsoTpFrameType 4-15;
SG_MUL_VAL_ 1632 BlockSize IsoTpFrameType 3-3;
SG_MUL_VAL_ 1632 SingleData1 IsoTpFrameType 0-0;
SG_MUL_VAL_ 1632 ConsecutiveData1 IsoTpFrameType 2-2;
SG_MUL_VAL_ 1632 UnknownData1 IsoTpFrameType 4-15;
SG_MUL_VAL_ 1632 SeparationTimeRaw IsoTpFrameType 3-3;
SG_MUL_VAL_ 1632 SingleData2 IsoTpFrameType 0-0;
SG_MUL_VAL_ 1632 ConsecutiveData2 IsoTpFrameType 2-2;
SG_MUL_VAL_ 1632 UnknownData2 IsoTpFrameType 4-15;
SG_MUL_VAL_ 1632 FirstData1 IsoTpFrameType 1-1;
SG_MUL_VAL_ 1632 SingleData3 IsoTpFrameType 0-0;
SG_MUL_VAL_ 1632 ConsecutiveData3 IsoTpFrameType 2-2;
SG_MUL_VAL_ 1632 UnknownData3 IsoTpFrameType 4-15;
SG_MUL_VAL_ 1632 FirstData2 IsoTpFrameType 1-1;
SG_MUL_VAL_ 1632 FlowPadding1 IsoTpFrameType 3-3;
SG_MUL_VAL_ 1632 SingleData4 IsoTpFrameType 0-0;
SG_MUL_VAL_ 1632 ConsecutiveData4 IsoTpFrameType 2-2;
SG_MUL_VAL_ 1632 UnknownData4 IsoTpFrameType 4-15;
SG_MUL_VAL_ 1632 FirstData3 IsoTpFrameType 1-1;
SG_MUL_VAL_ 1632 FlowPadding2 IsoTpFrameType 3-3;
SG_MUL_VAL_ 1632 SingleData5 IsoTpFrameType 0-0;
SG_MUL_VAL_ 1632 ConsecutiveData5 IsoTpFrameType 2-2;
SG_MUL_VAL_ 1632 UnknownData5 IsoTpFrameType 4-15;
SG_MUL_VAL_ 1632 FirstData4 IsoTpFrameType 1-1;
SG_MUL_VAL_ 1632 FlowPadding3 IsoTpFrameType 3-3;
SG_MUL_VAL_ 1632 SingleData6 IsoTpFrameType 0-0;
SG_MUL_VAL_ 1632 ConsecutiveData6 IsoTpFrameType 2-2;
SG_MUL_VAL_ 1632 UnknownData6 IsoTpFrameType 4-15;
SG_MUL_VAL_ 1632 FirstData5 IsoTpFrameType 1-1;
SG_MUL_VAL_ 1632 FlowPadding4 IsoTpFrameType 3-3;
SG_MUL_VAL_ 1632 SingleData7 IsoTpFrameType 0-0;
SG_MUL_VAL_ 1632 ConsecutiveData7 IsoTpFrameType 2-2;
SG_MUL_VAL_ 1632 UnknownData7 IsoTpFrameType 4-15;
SG_MUL_VAL_ 1632 FirstData6 IsoTpFrameType 1-1;
SG_MUL_VAL_ 1632 FlowPadding5 IsoTpFrameType 3-3;
SG_MUL_VAL_ 1633 SingleFrameLength IsoTpFrameType 0-0;
SG_MUL_VAL_ 1633 FirstFrameLength IsoTpFrameType 1-1;
SG_MUL_VAL_ 1633 ConsecutiveSequence IsoTpFrameType 2-2;
SG_MUL_VAL_ 1633 FlowStatus IsoTpFrameType 3-3;
SG_MUL_VAL_ 1633 UnknownPciLow IsoTpFrameType 4-15;
SG_MUL_VAL_ 1633 BlockSize IsoTpFrameType 3-3;
SG_MUL_VAL_ 1633 SingleData1 IsoTpFrameType 0-0;
SG_MUL_VAL_ 1633 ConsecutiveData1 IsoTpFrameType 2-2;
SG_MUL_VAL_ 1633 UnknownData1 IsoTpFrameType 4-15;
SG_MUL_VAL_ 1633 SeparationTimeRaw IsoTpFrameType 3-3;
SG_MUL_VAL_ 1633 SingleData2 IsoTpFrameType 0-0;
SG_MUL_VAL_ 1633 ConsecutiveData2 IsoTpFrameType 2-2;
SG_MUL_VAL_ 1633 UnknownData2 IsoTpFrameType 4-15;
SG_MUL_VAL_ 1633 FirstData1 IsoTpFrameType 1-1;
SG_MUL_VAL_ 1633 SingleData3 IsoTpFrameType 0-0;
SG_MUL_VAL_ 1633 ConsecutiveData3 IsoTpFrameType 2-2;
SG_MUL_VAL_ 1633 UnknownData3 IsoTpFrameType 4-15;
SG_MUL_VAL_ 1633 FirstData2 IsoTpFrameType 1-1;
SG_MUL_VAL_ 1633 FlowPadding1 IsoTpFrameType 3-3;
SG_MUL_VAL_ 1633 SingleData4 IsoTpFrameType 0-0;
SG_MUL_VAL_ 1633 ConsecutiveData4 IsoTpFrameType 2-2;
SG_MUL_VAL_ 1633 UnknownData4 IsoTpFrameType 4-15;
SG_MUL_VAL_ 1633 FirstData3 IsoTpFrameType 1-1;
SG_MUL_VAL_ 1633 FlowPadding2 IsoTpFrameType 3-3;
SG_MUL_VAL_ 1633 SingleData5 IsoTpFrameType 0-0;
SG_MUL_VAL_ 1633 ConsecutiveData5 IsoTpFrameType 2-2;
SG_MUL_VAL_ 1633 UnknownData5 IsoTpFrameType 4-15;
SG_MUL_VAL_ 1633 FirstData4 IsoTpFrameType 1-1;
SG_MUL_VAL_ 1633 FlowPadding3 IsoTpFrameType 3-3;
SG_MUL_VAL_ 1633 SingleData6 IsoTpFrameType 0-0;
SG_MUL_VAL_ 1633 ConsecutiveData6 IsoTpFrameType 2-2;
SG_MUL_VAL_ 1633 UnknownData6 IsoTpFrameType 4-15;
SG_MUL_VAL_ 1633 FirstData5 IsoTpFrameType 1-1;
SG_MUL_VAL_ 1633 FlowPadding4 IsoTpFrameType 3-3;
SG_MUL_VAL_ 1633 SingleData7 IsoTpFrameType 0-0;
SG_MUL_VAL_ 1633 ConsecutiveData7 IsoTpFrameType 2-2;
SG_MUL_VAL_ 1633 UnknownData7 IsoTpFrameType 4-15;
SG_MUL_VAL_ 1633 FirstData6 IsoTpFrameType 1-1;
SG_MUL_VAL_ 1633 FlowPadding5 IsoTpFrameType 3-3;
SG_MUL_VAL_ 1634 SingleFrameLength IsoTpFrameType 0-0;
SG_MUL_VAL_ 1634 FirstFrameLength IsoTpFrameType 1-1;
SG_MUL_VAL_ 1634 ConsecutiveSequence IsoTpFrameType 2-2;
SG_MUL_VAL_ 1634 FlowStatus IsoTpFrameType 3-3;
SG_MUL_VAL_ 1634 UnknownPciLow IsoTpFrameType 4-15;
SG_MUL_VAL_ 1634 BlockSize IsoTpFrameType 3-3;
SG_MUL_VAL_ 1634 SingleData1 IsoTpFrameType 0-0;
SG_MUL_VAL_ 1634 ConsecutiveData1 IsoTpFrameType 2-2;
SG_MUL_VAL_ 1634 UnknownData1 IsoTpFrameType 4-15;
SG_MUL_VAL_ 1634 SeparationTimeRaw IsoTpFrameType 3-3;
SG_MUL_VAL_ 1634 SingleData2 IsoTpFrameType 0-0;
SG_MUL_VAL_ 1634 ConsecutiveData2 IsoTpFrameType 2-2;
SG_MUL_VAL_ 1634 UnknownData2 IsoTpFrameType 4-15;
SG_MUL_VAL_ 1634 FirstData1 IsoTpFrameType 1-1;
SG_MUL_VAL_ 1634 SingleData3 IsoTpFrameType 0-0;
SG_MUL_VAL_ 1634 ConsecutiveData3 IsoTpFrameType 2-2;
SG_MUL_VAL_ 1634 UnknownData3 IsoTpFrameType 4-15;
SG_MUL_VAL_ 1634 FirstData2 IsoTpFrameType 1-1;
SG_MUL_VAL_ 1634 FlowPadding1 IsoTpFrameType 3-3;
SG_MUL_VAL_ 1634 SingleData4 IsoTpFrameType 0-0;
SG_MUL_VAL_ 1634 ConsecutiveData4 IsoTpFrameType 2-2;
SG_MUL_VAL_ 1634 UnknownData4 IsoTpFrameType 4-15;
SG_MUL_VAL_ 1634 FirstData3 IsoTpFrameType 1-1;
SG_MUL_VAL_ 1634 FlowPadding2 IsoTpFrameType 3-3;
SG_MUL_VAL_ 1634 SingleData5 IsoTpFrameType 0-0;
SG_MUL_VAL_ 1634 ConsecutiveData5 IsoTpFrameType 2-2;
SG_MUL_VAL_ 1634 UnknownData5 IsoTpFrameType 4-15;
SG_MUL_VAL_ 1634 FirstData4 IsoTpFrameType 1-1;
SG_MUL_VAL_ 1634 FlowPadding3 IsoTpFrameType 3-3;
SG_MUL_VAL_ 1634 SingleData6 IsoTpFrameType 0-0;
SG_MUL_VAL_ 1634 ConsecutiveData6 IsoTpFrameType 2-2;
SG_MUL_VAL_ 1634 UnknownData6 IsoTpFrameType 4-15;
SG_MUL_VAL_ 1634 FirstData5 IsoTpFrameType 1-1;
SG_MUL_VAL_ 1634 FlowPadding4 IsoTpFrameType 3-3;
SG_MUL_VAL_ 1634 SingleData7 IsoTpFrameType 0-0;
SG_MUL_VAL_ 1634 ConsecutiveData7 IsoTpFrameType 2-2;
SG_MUL_VAL_ 1634 UnknownData7 IsoTpFrameType 4-15;
SG_MUL_VAL_ 1634 FirstData6 IsoTpFrameType 1-1;
SG_MUL_VAL_ 1634 FlowPadding5 IsoTpFrameType 3-3;
SG_MUL_VAL_ 1635 SingleFrameLength IsoTpFrameType 0-0;
SG_MUL_VAL_ 1635 FirstFrameLength IsoTpFrameType 1-1;
SG_MUL_VAL_ 1635 ConsecutiveSequence IsoTpFrameType 2-2;
SG_MUL_VAL_ 1635 FlowStatus IsoTpFrameType 3-3;
SG_MUL_VAL_ 1635 UnknownPciLow IsoTpFrameType 4-15;
SG_MUL_VAL_ 1635 BlockSize IsoTpFrameType 3-3;
SG_MUL_VAL_ 1635 SingleData1 IsoTpFrameType 0-0;
SG_MUL_VAL_ 1635 ConsecutiveData1 IsoTpFrameType 2-2;
SG_MUL_VAL_ 1635 UnknownData1 IsoTpFrameType 4-15;
SG_MUL_VAL_ 1635 SeparationTimeRaw IsoTpFrameType 3-3;
SG_MUL_VAL_ 1635 SingleData2 IsoTpFrameType 0-0;
SG_MUL_VAL_ 1635 ConsecutiveData2 IsoTpFrameType 2-2;
SG_MUL_VAL_ 1635 UnknownData2 IsoTpFrameType 4-15;
SG_MUL_VAL_ 1635 FirstData1 IsoTpFrameType 1-1;
SG_MUL_VAL_ 1635 SingleData3 IsoTpFrameType 0-0;
SG_MUL_VAL_ 1635 ConsecutiveData3 IsoTpFrameType 2-2;
SG_MUL_VAL_ 1635 UnknownData3 IsoTpFrameType 4-15;
SG_MUL_VAL_ 1635 FirstData2 IsoTpFrameType 1-1;
SG_MUL_VAL_ 1635 FlowPadding1 IsoTpFrameType 3-3;
SG_MUL_VAL_ 1635 SingleData4 IsoTpFrameType 0-0;
SG_MUL_VAL_ 1635 ConsecutiveData4 IsoTpFrameType 2-2;
SG_MUL_VAL_ 1635 UnknownData4 IsoTpFrameType 4-15;
SG_MUL_VAL_ 1635 FirstData3 IsoTpFrameType 1-1;
SG_MUL_VAL_ 1635 FlowPadding2 IsoTpFrameType 3-3;
SG_MUL_VAL_ 1635 SingleData5 IsoTpFrameType 0-0;
SG_MUL_VAL_ 1635 ConsecutiveData5 IsoTpFrameType 2-2;
SG_MUL_VAL_ 1635 UnknownData5 IsoTpFrameType 4-15;
SG_MUL_VAL_ 1635 FirstData4 IsoTpFrameType 1-1;
SG_MUL_VAL_ 1635 FlowPadding3 IsoTpFrameType 3-3;
SG_MUL_VAL_ 1635 SingleData6 IsoTpFrameType 0-0;
SG_MUL_VAL_ 1635 ConsecutiveData6 IsoTpFrameType 2-2;
SG_MUL_VAL_ 1635 UnknownData6 IsoTpFrameType 4-15;
SG_MUL_VAL_ 1635 FirstData5 IsoTpFrameType 1-1;
SG_MUL_VAL_ 1635 FlowPadding4 IsoTpFrameType 3-3;
SG_MUL_VAL_ 1635 SingleData7 IsoTpFrameType 0-0;
SG_MUL_VAL_ 1635 ConsecutiveData7 IsoTpFrameType 2-2;
SG_MUL_VAL_ 1635 UnknownData7 IsoTpFrameType 4-15;
SG_MUL_VAL_ 1635 FirstData6 IsoTpFrameType 1-1;
SG_MUL_VAL_ 1635 FlowPadding5 IsoTpFrameType 3-3;
SG_MUL_VAL_ 1636 SingleFrameLength IsoTpFrameType 0-0;
SG_MUL_VAL_ 1636 FirstFrameLength IsoTpFrameType 1-1;
SG_MUL_VAL_ 1636 ConsecutiveSequence IsoTpFrameType 2-2;
SG_MUL_VAL_ 1636 FlowStatus IsoTpFrameType 3-3;
SG_MUL_VAL_ 1636 UnknownPciLow IsoTpFrameType 4-15;
SG_MUL_VAL_ 1636 BlockSize IsoTpFrameType 3-3;
SG_MUL_VAL_ 1636 SingleData1 IsoTpFrameType 0-0;
SG_MUL_VAL_ 1636 ConsecutiveData1 IsoTpFrameType 2-2;
SG_MUL_VAL_ 1636 UnknownData1 IsoTpFrameType 4-15;
SG_MUL_VAL_ 1636 SeparationTimeRaw IsoTpFrameType 3-3;
SG_MUL_VAL_ 1636 SingleData2 IsoTpFrameType 0-0;
SG_MUL_VAL_ 1636 ConsecutiveData2 IsoTpFrameType 2-2;
SG_MUL_VAL_ 1636 UnknownData2 IsoTpFrameType 4-15;
SG_MUL_VAL_ 1636 FirstData1 IsoTpFrameType 1-1;
SG_MUL_VAL_ 1636 SingleData3 IsoTpFrameType 0-0;
SG_MUL_VAL_ 1636 ConsecutiveData3 IsoTpFrameType 2-2;
SG_MUL_VAL_ 1636 UnknownData3 IsoTpFrameType 4-15;
SG_MUL_VAL_ 1636 FirstData2 IsoTpFrameType 1-1;
SG_MUL_VAL_ 1636 FlowPadding1 IsoTpFrameType 3-3;
SG_MUL_VAL_ 1636 SingleData4 IsoTpFrameType 0-0;
SG_MUL_VAL_ 1636 ConsecutiveData4 IsoTpFrameType 2-2;
SG_MUL_VAL_ 1636 UnknownData4 IsoTpFrameType 4-15;
SG_MUL_VAL_ 1636 FirstData3 IsoTpFrameType 1-1;
SG_MUL_VAL_ 1636 FlowPadding2 IsoTpFrameType 3-3;
SG_MUL_VAL_ 1636 SingleData5 IsoTpFrameType 0-0;
SG_MUL_VAL_ 1636 ConsecutiveData5 IsoTpFrameType 2-2;
SG_MUL_VAL_ 1636 UnknownData5 IsoTpFrameType 4-15;
SG_MUL_VAL_ 1636 FirstData4 IsoTpFrameType 1-1;
SG_MUL_VAL_ 1636 FlowPadding3 IsoTpFrameType 3-3;
SG_MUL_VAL_ 1636 SingleData6 IsoTpFrameType 0-0;
SG_MUL_VAL_ 1636 ConsecutiveData6 IsoTpFrameType 2-2;
SG_MUL_VAL_ 1636 UnknownData6 IsoTpFrameType 4-15;
SG_MUL_VAL_ 1636 FirstData5 IsoTpFrameType 1-1;
SG_MUL_VAL_ 1636 FlowPadding4 IsoTpFrameType 3-3;
SG_MUL_VAL_ 1636 SingleData7 IsoTpFrameType 0-0;
SG_MUL_VAL_ 1636 ConsecutiveData7 IsoTpFrameType 2-2;
SG_MUL_VAL_ 1636 UnknownData7 IsoTpFrameType 4-15;
SG_MUL_VAL_ 1636 FirstData6 IsoTpFrameType 1-1;
SG_MUL_VAL_ 1636 FlowPadding5 IsoTpFrameType 3-3;
SG_MUL_VAL_ 1637 SingleFrameLength IsoTpFrameType 0-0;
SG_MUL_VAL_ 1637 FirstFrameLength IsoTpFrameType 1-1;
SG_MUL_VAL_ 1637 ConsecutiveSequence IsoTpFrameType 2-2;
SG_MUL_VAL_ 1637 FlowStatus IsoTpFrameType 3-3;
SG_MUL_VAL_ 1637 UnknownPciLow IsoTpFrameType 4-15;
SG_MUL_VAL_ 1637 BlockSize IsoTpFrameType 3-3;
SG_MUL_VAL_ 1637 SingleData1 IsoTpFrameType 0-0;
SG_MUL_VAL_ 1637 ConsecutiveData1 IsoTpFrameType 2-2;
SG_MUL_VAL_ 1637 UnknownData1 IsoTpFrameType 4-15;
SG_MUL_VAL_ 1637 SeparationTimeRaw IsoTpFrameType 3-3;
SG_MUL_VAL_ 1637 SingleData2 IsoTpFrameType 0-0;
SG_MUL_VAL_ 1637 ConsecutiveData2 IsoTpFrameType 2-2;
SG_MUL_VAL_ 1637 UnknownData2 IsoTpFrameType 4-15;
SG_MUL_VAL_ 1637 FirstData1 IsoTpFrameType 1-1;
SG_MUL_VAL_ 1637 SingleData3 IsoTpFrameType 0-0;
SG_MUL_VAL_ 1637 ConsecutiveData3 IsoTpFrameType 2-2;
SG_MUL_VAL_ 1637 UnknownData3 IsoTpFrameType 4-15;
SG_MUL_VAL_ 1637 FirstData2 IsoTpFrameType 1-1;
SG_MUL_VAL_ 1637 FlowPadding1 IsoTpFrameType 3-3;
SG_MUL_VAL_ 1637 SingleData4 IsoTpFrameType 0-0;
SG_MUL_VAL_ 1637 ConsecutiveData4 IsoTpFrameType 2-2;
SG_MUL_VAL_ 1637 UnknownData4 IsoTpFrameType 4-15;
SG_MUL_VAL_ 1637 FirstData3 IsoTpFrameType 1-1;
SG_MUL_VAL_ 1637 FlowPadding2 IsoTpFrameType 3-3;
SG_MUL_VAL_ 1637 SingleData5 IsoTpFrameType 0-0;
SG_MUL_VAL_ 1637 ConsecutiveData5 IsoTpFrameType 2-2;
SG_MUL_VAL_ 1637 UnknownData5 IsoTpFrameType 4-15;
SG_MUL_VAL_ 1637 FirstData4 IsoTpFrameType 1-1;
SG_MUL_VAL_ 1637 FlowPadding3 IsoTpFrameType 3-3;
SG_MUL_VAL_ 1637 SingleData6 IsoTpFrameType 0-0;
SG_MUL_VAL_ 1637 ConsecutiveData6 IsoTpFrameType 2-2;
SG_MUL_VAL_ 1637 UnknownData6 IsoTpFrameType 4-15;
SG_MUL_VAL_ 1637 FirstData5 IsoTpFrameType 1-1;
SG_MUL_VAL_ 1637 FlowPadding4 IsoTpFrameType 3-3;
SG_MUL_VAL_ 1637 SingleData7 IsoTpFrameType 0-0;
SG_MUL_VAL_ 1637 ConsecutiveData7 IsoTpFrameType 2-2;
SG_MUL_VAL_ 1637 UnknownData7 IsoTpFrameType 4-15;
SG_MUL_VAL_ 1637 FirstData6 IsoTpFrameType 1-1;
SG_MUL_VAL_ 1637 FlowPadding5 IsoTpFrameType 3-3;
SG_MUL_VAL_ 1638 SingleFrameLength IsoTpFrameType 0-0;
SG_MUL_VAL_ 1638 FirstFrameLength IsoTpFrameType 1-1;
SG_MUL_VAL_ 1638 ConsecutiveSequence IsoTpFrameType 2-2;
SG_MUL_VAL_ 1638 FlowStatus IsoTpFrameType 3-3;
SG_MUL_VAL_ 1638 UnknownPciLow IsoTpFrameType 4-15;
SG_MUL_VAL_ 1638 BlockSize IsoTpFrameType 3-3;
SG_MUL_VAL_ 1638 SingleData1 IsoTpFrameType 0-0;
SG_MUL_VAL_ 1638 ConsecutiveData1 IsoTpFrameType 2-2;
SG_MUL_VAL_ 1638 UnknownData1 IsoTpFrameType 4-15;
SG_MUL_VAL_ 1638 SeparationTimeRaw IsoTpFrameType 3-3;
SG_MUL_VAL_ 1638 SingleData2 IsoTpFrameType 0-0;
SG_MUL_VAL_ 1638 ConsecutiveData2 IsoTpFrameType 2-2;
SG_MUL_VAL_ 1638 UnknownData2 IsoTpFrameType 4-15;
SG_MUL_VAL_ 1638 FirstData1 IsoTpFrameType 1-1;
SG_MUL_VAL_ 1638 SingleData3 IsoTpFrameType 0-0;
SG_MUL_VAL_ 1638 ConsecutiveData3 IsoTpFrameType 2-2;
SG_MUL_VAL_ 1638 UnknownData3 IsoTpFrameType 4-15;
SG_MUL_VAL_ 1638 FirstData2 IsoTpFrameType 1-1;
SG_MUL_VAL_ 1638 FlowPadding1 IsoTpFrameType 3-3;
SG_MUL_VAL_ 1638 SingleData4 IsoTpFrameType 0-0;
SG_MUL_VAL_ 1638 ConsecutiveData4 IsoTpFrameType 2-2;
SG_MUL_VAL_ 1638 UnknownData4 IsoTpFrameType 4-15;
SG_MUL_VAL_ 1638 FirstData3 IsoTpFrameType 1-1;
SG_MUL_VAL_ 1638 FlowPadding2 IsoTpFrameType 3-3;
SG_MUL_VAL_ 1638 SingleData5 IsoTpFrameType 0-0;
SG_MUL_VAL_ 1638 ConsecutiveData5 IsoTpFrameType 2-2;
SG_MUL_VAL_ 1638 UnknownData5 IsoTpFrameType 4-15;
SG_MUL_VAL_ 1638 FirstData4 IsoTpFrameType 1-1;
SG_MUL_VAL_ 1638 FlowPadding3 IsoTpFrameType 3-3;
SG_MUL_VAL_ 1638 SingleData6 IsoTpFrameType 0-0;
SG_MUL_VAL_ 1638 ConsecutiveData6 IsoTpFrameType 2-2;
SG_MUL_VAL_ 1638 UnknownData6 IsoTpFrameType 4-15;
SG_MUL_VAL_ 1638 FirstData5 IsoTpFrameType 1-1;
SG_MUL_VAL_ 1638 FlowPadding4 IsoTpFrameType 3-3;
SG_MUL_VAL_ 1638 SingleData7 IsoTpFrameType 0-0;
SG_MUL_VAL_ 1638 ConsecutiveData7 IsoTpFrameType 2-2;
SG_MUL_VAL_ 1638 UnknownData7 IsoTpFrameType 4-15;
SG_MUL_VAL_ 1638 FirstData6 IsoTpFrameType 1-1;
SG_MUL_VAL_ 1638 FlowPadding5 IsoTpFrameType 3-3;
SG_MUL_VAL_ 1643 SingleFrameLength IsoTpFrameType 0-0;
SG_MUL_VAL_ 1643 FirstFrameLength IsoTpFrameType 1-1;
SG_MUL_VAL_ 1643 ConsecutiveSequence IsoTpFrameType 2-2;
SG_MUL_VAL_ 1643 FlowStatus IsoTpFrameType 3-3;
SG_MUL_VAL_ 1643 UnknownPciLow IsoTpFrameType 4-15;
SG_MUL_VAL_ 1643 BlockSize IsoTpFrameType 3-3;
SG_MUL_VAL_ 1643 SingleData1 IsoTpFrameType 0-0;
SG_MUL_VAL_ 1643 ConsecutiveData1 IsoTpFrameType 2-2;
SG_MUL_VAL_ 1643 UnknownData1 IsoTpFrameType 4-15;
SG_MUL_VAL_ 1643 SeparationTimeRaw IsoTpFrameType 3-3;
SG_MUL_VAL_ 1643 SingleData2 IsoTpFrameType 0-0;
SG_MUL_VAL_ 1643 ConsecutiveData2 IsoTpFrameType 2-2;
SG_MUL_VAL_ 1643 UnknownData2 IsoTpFrameType 4-15;
SG_MUL_VAL_ 1643 FirstData1 IsoTpFrameType 1-1;
SG_MUL_VAL_ 1643 SingleData3 IsoTpFrameType 0-0;
SG_MUL_VAL_ 1643 ConsecutiveData3 IsoTpFrameType 2-2;
SG_MUL_VAL_ 1643 UnknownData3 IsoTpFrameType 4-15;
SG_MUL_VAL_ 1643 FirstData2 IsoTpFrameType 1-1;
SG_MUL_VAL_ 1643 FlowPadding1 IsoTpFrameType 3-3;
SG_MUL_VAL_ 1643 SingleData4 IsoTpFrameType 0-0;
SG_MUL_VAL_ 1643 ConsecutiveData4 IsoTpFrameType 2-2;
SG_MUL_VAL_ 1643 UnknownData4 IsoTpFrameType 4-15;
SG_MUL_VAL_ 1643 FirstData3 IsoTpFrameType 1-1;
SG_MUL_VAL_ 1643 FlowPadding2 IsoTpFrameType 3-3;
SG_MUL_VAL_ 1643 SingleData5 IsoTpFrameType 0-0;
SG_MUL_VAL_ 1643 ConsecutiveData5 IsoTpFrameType 2-2;
SG_MUL_VAL_ 1643 UnknownData5 IsoTpFrameType 4-15;
SG_MUL_VAL_ 1643 FirstData4 IsoTpFrameType 1-1;
SG_MUL_VAL_ 1643 FlowPadding3 IsoTpFrameType 3-3;
SG_MUL_VAL_ 1643 SingleData6 IsoTpFrameType 0-0;
SG_MUL_VAL_ 1643 ConsecutiveData6 IsoTpFrameType 2-2;
SG_MUL_VAL_ 1643 UnknownData6 IsoTpFrameType 4-15;
SG_MUL_VAL_ 1643 FirstData5 IsoTpFrameType 1-1;
SG_MUL_VAL_ 1643 FlowPadding4 IsoTpFrameType 3-3;
SG_MUL_VAL_ 1643 SingleData7 IsoTpFrameType 0-0;
SG_MUL_VAL_ 1643 ConsecutiveData7 IsoTpFrameType 2-2;
SG_MUL_VAL_ 1643 UnknownData7 IsoTpFrameType 4-15;
SG_MUL_VAL_ 1643 FirstData6 IsoTpFrameType 1-1;
SG_MUL_VAL_ 1643 FlowPadding5 IsoTpFrameType 3-3;
SG_MUL_VAL_ 1644 SingleFrameLength IsoTpFrameType 0-0;
SG_MUL_VAL_ 1644 FirstFrameLength IsoTpFrameType 1-1;
SG_MUL_VAL_ 1644 ConsecutiveSequence IsoTpFrameType 2-2;
SG_MUL_VAL_ 1644 FlowStatus IsoTpFrameType 3-3;
SG_MUL_VAL_ 1644 UnknownPciLow IsoTpFrameType 4-15;
SG_MUL_VAL_ 1644 BlockSize IsoTpFrameType 3-3;
SG_MUL_VAL_ 1644 SingleData1 IsoTpFrameType 0-0;
SG_MUL_VAL_ 1644 ConsecutiveData1 IsoTpFrameType 2-2;
SG_MUL_VAL_ 1644 UnknownData1 IsoTpFrameType 4-15;
SG_MUL_VAL_ 1644 SeparationTimeRaw IsoTpFrameType 3-3;
SG_MUL_VAL_ 1644 SingleData2 IsoTpFrameType 0-0;
SG_MUL_VAL_ 1644 ConsecutiveData2 IsoTpFrameType 2-2;
SG_MUL_VAL_ 1644 UnknownData2 IsoTpFrameType 4-15;
SG_MUL_VAL_ 1644 FirstData1 IsoTpFrameType 1-1;
SG_MUL_VAL_ 1644 SingleData3 IsoTpFrameType 0-0;
SG_MUL_VAL_ 1644 ConsecutiveData3 IsoTpFrameType 2-2;
SG_MUL_VAL_ 1644 UnknownData3 IsoTpFrameType 4-15;
SG_MUL_VAL_ 1644 FirstData2 IsoTpFrameType 1-1;
SG_MUL_VAL_ 1644 FlowPadding1 IsoTpFrameType 3-3;
SG_MUL_VAL_ 1644 SingleData4 IsoTpFrameType 0-0;
SG_MUL_VAL_ 1644 ConsecutiveData4 IsoTpFrameType 2-2;
SG_MUL_VAL_ 1644 UnknownData4 IsoTpFrameType 4-15;
SG_MUL_VAL_ 1644 FirstData3 IsoTpFrameType 1-1;
SG_MUL_VAL_ 1644 FlowPadding2 IsoTpFrameType 3-3;
SG_MUL_VAL_ 1644 SingleData5 IsoTpFrameType 0-0;
SG_MUL_VAL_ 1644 ConsecutiveData5 IsoTpFrameType 2-2;
SG_MUL_VAL_ 1644 UnknownData5 IsoTpFrameType 4-15;
SG_MUL_VAL_ 1644 FirstData4 IsoTpFrameType 1-1;
SG_MUL_VAL_ 1644 FlowPadding3 IsoTpFrameType 3-3;
SG_MUL_VAL_ 1644 SingleData6 IsoTpFrameType 0-0;
SG_MUL_VAL_ 1644 ConsecutiveData6 IsoTpFrameType 2-2;
SG_MUL_VAL_ 1644 UnknownData6 IsoTpFrameType 4-15;
SG_MUL_VAL_ 1644 FirstData5 IsoTpFrameType 1-1;
SG_MUL_VAL_ 1644 FlowPadding4 IsoTpFrameType 3-3;
SG_MUL_VAL_ 1644 SingleData7 IsoTpFrameType 0-0;
SG_MUL_VAL_ 1644 ConsecutiveData7 IsoTpFrameType 2-2;
SG_MUL_VAL_ 1644 UnknownData7 IsoTpFrameType 4-15;
SG_MUL_VAL_ 1644 FirstData6 IsoTpFrameType 1-1;
SG_MUL_VAL_ 1644 FlowPadding5 IsoTpFrameType 3-3;
SG_MUL_VAL_ 1645 SingleFrameLength IsoTpFrameType 0-0;
SG_MUL_VAL_ 1645 FirstFrameLength IsoTpFrameType 1-1;
SG_MUL_VAL_ 1645 ConsecutiveSequence IsoTpFrameType 2-2;
SG_MUL_VAL_ 1645 FlowStatus IsoTpFrameType 3-3;
SG_MUL_VAL_ 1645 UnknownPciLow IsoTpFrameType 4-15;
SG_MUL_VAL_ 1645 BlockSize IsoTpFrameType 3-3;
SG_MUL_VAL_ 1645 SingleData1 IsoTpFrameType 0-0;
SG_MUL_VAL_ 1645 ConsecutiveData1 IsoTpFrameType 2-2;
SG_MUL_VAL_ 1645 UnknownData1 IsoTpFrameType 4-15;
SG_MUL_VAL_ 1645 SeparationTimeRaw IsoTpFrameType 3-3;
SG_MUL_VAL_ 1645 SingleData2 IsoTpFrameType 0-0;
SG_MUL_VAL_ 1645 ConsecutiveData2 IsoTpFrameType 2-2;
SG_MUL_VAL_ 1645 UnknownData2 IsoTpFrameType 4-15;
SG_MUL_VAL_ 1645 FirstData1 IsoTpFrameType 1-1;
SG_MUL_VAL_ 1645 SingleData3 IsoTpFrameType 0-0;
SG_MUL_VAL_ 1645 ConsecutiveData3 IsoTpFrameType 2-2;
SG_MUL_VAL_ 1645 UnknownData3 IsoTpFrameType 4-15;
SG_MUL_VAL_ 1645 FirstData2 IsoTpFrameType 1-1;
SG_MUL_VAL_ 1645 FlowPadding1 IsoTpFrameType 3-3;
SG_MUL_VAL_ 1645 SingleData4 IsoTpFrameType 0-0;
SG_MUL_VAL_ 1645 ConsecutiveData4 IsoTpFrameType 2-2;
SG_MUL_VAL_ 1645 UnknownData4 IsoTpFrameType 4-15;
SG_MUL_VAL_ 1645 FirstData3 IsoTpFrameType 1-1;
SG_MUL_VAL_ 1645 FlowPadding2 IsoTpFrameType 3-3;
SG_MUL_VAL_ 1645 SingleData5 IsoTpFrameType 0-0;
SG_MUL_VAL_ 1645 ConsecutiveData5 IsoTpFrameType 2-2;
SG_MUL_VAL_ 1645 UnknownData5 IsoTpFrameType 4-15;
SG_MUL_VAL_ 1645 FirstData4 IsoTpFrameType 1-1;
SG_MUL_VAL_ 1645 FlowPadding3 IsoTpFrameType 3-3;
SG_MUL_VAL_ 1645 SingleData6 IsoTpFrameType 0-0;
SG_MUL_VAL_ 1645 ConsecutiveData6 IsoTpFrameType 2-2;
SG_MUL_VAL_ 1645 UnknownData6 IsoTpFrameType 4-15;
SG_MUL_VAL_ 1645 FirstData5 IsoTpFrameType 1-1;
SG_MUL_VAL_ 1645 FlowPadding4 IsoTpFrameType 3-3;
SG_MUL_VAL_ 1645 SingleData7 IsoTpFrameType 0-0;
SG_MUL_VAL_ 1645 ConsecutiveData7 IsoTpFrameType 2-2;
SG_MUL_VAL_ 1645 UnknownData7 IsoTpFrameType 4-15;
SG_MUL_VAL_ 1645 FirstData6 IsoTpFrameType 1-1;
SG_MUL_VAL_ 1645 FlowPadding5 IsoTpFrameType 3-3;
